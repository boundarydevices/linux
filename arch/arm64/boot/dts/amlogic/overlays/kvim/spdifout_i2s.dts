/dts-v1/;
/plugin/;

/ {
    fragment@0 {
	target = <&aiu>;

	__overlay__ {
		pinctrl-0 = <&spdif_out_h_pins>, <&i2s_out_ch01_pins>, <&i2s_out_lr_clk_pins>, <&i2s_out_ao_clk_pins>;
		status = "okay";
	};
    };
};
