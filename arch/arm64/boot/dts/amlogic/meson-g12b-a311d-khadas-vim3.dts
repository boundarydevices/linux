// SPDX-License-Identifier: (GPL-2.0+ OR MIT)
/*
 * Copyright (c) 2019 BayLibre, SAS
 * Author: Neil Armstrong <narmstrong@baylibre.com>
 * Copyright (c) 2019 Christian Hewitt <christianshewitt@gmail.com>
 */

/dts-v1/;

#include "meson-g12b-a311d.dtsi"
#include "meson-khadas-vim3.dtsi"
#include "meson-g12b-khadas-vim3.dtsi"

/ {
	compatible = "khadas,vim3", "amlogic,a311d", "amlogic,g12b";

	reserved-memory {
		galcore_reserved:linux,galcore {
			compatible = "shared-dma-pool";
			reusable;
			size = <0x0 0x1000000>;
			alignment = <0x0 0x400000>;
			linux,contiguous-region;
		};
	};

	galcore {
		compatible = "amlogic, galcore";
		dev_name = "galcore";
		status = "okay";
		clocks = <&clkc CLKID_NNA_AXI_CLK>,
				<&clkc CLKID_NNA_CORE_CLK>;
		clock-names = "cts_vipnanoq_axi_clk_composite",
						"cts_vipnanoq_core_clk_composite";
		interrupts = <0 147 4>;
		interrupt-names = "galcore";
		reg = <0x0 0xff100000 0x0 0x800
				0x0 0xff000000 0x0 0x400000
				0x0 0xff63c10c 0x0 0x4
				0x0 0xff63c110 0x0 0x4
				0x0 0xffd01088 0x0 0x4
				0X0 0xff63c1c8 0X0 0x4
		>;
		reg-names = "NN_REG","NN_SRAM","NN_MEM0",
					"NN_MEM1","NN_RESET","NN_CLK";
		nn_power_version = <2>;
		nn_efuse = <0xff63003c 0x20>;

		memory-region = <&galcore_reserved>;
	};
};

/*
 * The VIM3 on-board  MCU can mux the PCIe/USB3.0 shared differential
 * lines using a FUSB340TMX USB 3.1 SuperSpeed Data Switch between
 * an USB3.0 Type A connector and a M.2 Key M slot.
 * The PHY driving these differential lines is shared between
 * the USB3.0 controller and the PCIe Controller, thus only
 * a single controller can use it.
 * If the MCU is configured to mux the PCIe/USB3.0 differential lines
 * to the M.2 Key M slot, uncomment the following block to disable
 * USB3.0 from the USB Complex and enable the PCIe controller.
 * The End User is not expected to uncomment the following except for
 * testing purposes, but instead rely on the firmware/bootloader to
 * update these nodes accordingly if PCIe mode is selected by the MCU.
 */
/*
&pcie {
	status = "okay";
};

&usb {
	phys = <&usb2_phy0>, <&usb2_phy1>;
	phy-names = "usb2-phy0", "usb2-phy1";
};
 */
