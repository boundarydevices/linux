/*
 * arch/arm64/boot/dts/amlogic/android_p_overlay_dt.dts
 *
 * Copyright (C) 2017 Amlogic, Inc. All rights reserved.
 *
 * This program is free software; you can redistribute it and/or modify
 * it under the terms of the GNU General Public License as published by
 * the Free Software Foundation; either version 2 of the License, or
 * (at your option) any later version.
 *
 * This program is distributed in the hope that it will be useful, but WITHOUT
 * ANY WARRANTY; without even the implied warranty of MERCHANTABILITY or
 * FITNESS FOR A PARTICULAR PURPOSE.  See the GNU General Public License for
 * more details.
 *
 */

/dts-v1/;
/plugin/;

/ {
	fragment@0 {
		//target = <&some_node>;
		target-path="/";
		__overlay__ {
			dummy-battery {
				compatible = "amlogic, dummy-battery";
				status = "okay";
			};
		};
	};

	fragment@1 {
		//target = <&some_node>;
		target-path="/";
		__overlay__ {
			dummy-charger {
				compatible = "amlogic, dummy-charger";
				status = "okay";
			};
		};
	};
};
