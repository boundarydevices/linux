// SPDX-License-Identifier: GPL-2.0
/*
 * Copyright (c) 2025 BayLibre, SAS.
 * Author: Vitor Sato Eschholz <vsatoes@baylibre.com>
 */

/dts-v1/;
/plugin/;

#include "mt8390-genio-common-android.dtsi"
