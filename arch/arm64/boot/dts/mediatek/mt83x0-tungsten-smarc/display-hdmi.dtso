/dts-v1/;
/plugin/;

/ {
	fragment@0 {
		target = <&disp_dpi1>;
		__overlay__ {
			status = "okay";
		};
	};

	fragment@1 {
		target = <&hdmi0>;
		__overlay__ {
			status = "okay";
		};
	};

	fragment@2 {
		target = <&hdmi_phy>;
		__overlay__ {
			status = "okay";
		};
	};
};
