// SPDX-License-Identifier: (GPL-2.0 OR MIT)
/*
 * Copyright (C) 2023 MediaTek Inc.
 */
/dts-v1/;
#include "mt8395-genio-1200-evk.dts"

&ufshci {
	status = "okay";
	vcc-supply = <&mt6359_vemc_1_ldo_reg>;
	vccq2-supply = <&mt6359_vufs_ldo_reg>;
};

&ufsphy {
	status = "okay";
};

&mmc0 {
	status = "disabled";
};

/ {
	model = "MediaTek Genio 1200 EVK-P1V2-UFS";
};
