// SPDX-License-Identifier: (GPL-2.0 OR MIT)
/*
 * Copyright (C) 2025 Ezurio LLC
 */
/dts-v1/;
#include "mt8188.dtsi"
#include "mt83x0-tungsten-smarc.dtsi"
#include "mt8370.dtsi"

/ {
	model = "Ezurio Tungsten510 SMARC (MT8370)";
	compatible = "ezurio,mt8370-tungsten-smarc", "mediatek,mt8370",
		     "mediatek,mt8188";
};
