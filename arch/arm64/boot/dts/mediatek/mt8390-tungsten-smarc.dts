// SPDX-License-Identifier: (GPL-2.0 OR MIT)
/*
 * Copyright (C) 2025 Ezurio LLC
 */
/dts-v1/;
#include "mt8188.dtsi"
#include "mt83x0-tungsten-smarc.dtsi"

/ {
	model = "Ezurio Tungsten700 SMARC (MT8390)";
	compatible = "ezurio,mt8390-tungsten-smarc", "mediatek,mt8390",
		     "mediatek,mt8188";
};
