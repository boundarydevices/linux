#include <dt-bindings/display/simple_panel_mipi_cmds.h>

/ {
	aliases {
		mipi_cmds_tm050jdhg33g = &mipi_cmds_tm050jdhg33g;
		//pinctrl_tm050jdhg33g = &pinctrl_mipi_tm050jdhg33g;
	};

	mipi_cmds_tm050jdhg33g: mipi-cmds-tm050jdhg33g {
		alias = <&mipi_cmds_tm050jdhg33g>;
		//aliasp = <&pinctrl_mipi_tm050jdhg33g>;
		delay-prepare = <100>;
		delay-unprepare = <2>;
		mipi-cmds-enable = /bits/ 8 <
			DELAY(2)
			DCS_L3P(0xFF,0x98,0x81,0x03)
			DCS_S1P(0x01,0x00)
			DCS_S1P(0x02,0x00)
			DCS_S1P(0x03,0x73)
			DCS_S1P(0x04,0xD3)
			DCS_S1P(0x05,0x00)
			DCS_S1P(0x06,0x0A)
			DCS_S1P(0x07,0x0E)
			DCS_S1P(0x08,0x00)
			DCS_S1P(0x09,0x01)
			DCS_S1P(0x0A,0x01)
			DCS_S1P(0x0B,0x01)
			DCS_S1P(0x0C,0x01)
			DCS_S1P(0x0D,0x01)
			DCS_S1P(0x0E,0x01)
			DCS_S1P(0x0F,0x01)
			DCS_S1P(0x10,0x01)
			DCS_S1P(0x11,0x00)
			DCS_S1P(0x12,0x00)
			DCS_S1P(0x13,0x00)
			DCS_S1P(0x14,0x00)
			DCS_S1P(0x15,0x00)
			DCS_S1P(0x16,0x00)
			DCS_S1P(0x17,0x00)
			DCS_S1P(0x18,0x00)
			DCS_S1P(0x19,0x00)
			DCS_S1P(0x1A,0x00)
			DCS_S1P(0x1B,0x00)
			DCS_S1P(0x1C,0x00)
			DCS_S1P(0x1D,0x00)
			DCS_S1P(0x1E,0x40)
			DCS_S1P(0x1F,0x80)
			DCS_S1P(0x20,0x06)
			DCS_S1P(0x21,0x01)
			DCS_S1P(0x22,0x00)
			DCS_S1P(0x23,0x00)
			DCS_S1P(0x24,0x00)
			DCS_S1P(0x25,0x00)
			DCS_S1P(0x26,0x00)
			DCS_S1P(0x27,0x00)
			DCS_S1P(0x28,0x33)
			DCS_S1P(0x29,0x03)
			DCS_S1P(0x2A,0x00)
			DCS_S1P(0x2B,0x00)
			DCS_S1P(0x2C,0x00)
			DCS_S1P(0x2D,0x00)
			DCS_S1P(0x2E,0x00)
			DCS_S1P(0x2F,0x00)
			DCS_S1P(0x30,0x00)
			DCS_S1P(0x31,0x00)
			DCS_S1P(0x32,0x00)
			DCS_S1P(0x33,0x00)
			DCS_S1P(0x34,0x03)
			DCS_S1P(0x35,0x00)
			DCS_S1P(0x36,0x03)
			DCS_S1P(0x37,0x00)
			DCS_S1P(0x38,0x00)
			DCS_S1P(0x39,0x00)
			DCS_S1P(0x3A,0x40)
			DCS_S1P(0x3B,0x40)
			DCS_S1P(0x3C,0x00)
			DCS_S1P(0x3D,0x00)
			DCS_S1P(0x3E,0x00)
			DCS_S1P(0x3F,0x00)
			DCS_S1P(0x40,0x00)
			DCS_S1P(0x41,0x00)
			DCS_S1P(0x42,0x00)
			DCS_S1P(0x43,0x00)
			DCS_S1P(0x44,0x00)

			//----------GIP_2--------------
			DCS_S1P(0x50,0x01)
			DCS_S1P(0x51,0x23)
			DCS_S1P(0x52,0x45)
			DCS_S1P(0x53,0x67)
			DCS_S1P(0x54,0x89)
			DCS_S1P(0x55,0xab)
			DCS_S1P(0x56,0x01)
			DCS_S1P(0x57,0x23)
			DCS_S1P(0x58,0x45)
			DCS_S1P(0x59,0x67)
			DCS_S1P(0x5a,0x89)
			DCS_S1P(0x5b,0xab)
			DCS_S1P(0x5c,0xcd)
			DCS_S1P(0x5d,0xef)

			//---------GIP_3--------------
			DCS_S1P(0x5e,0x11)
			DCS_S1P(0x5f,0x08)
			DCS_S1P(0x60,0x02)
			DCS_S1P(0x61,0x00)
			DCS_S1P(0x62,0x01)
			DCS_S1P(0x63,0x0D)
			DCS_S1P(0x64,0x0C)
			DCS_S1P(0x65,0x02)
			DCS_S1P(0x66,0x02)
			DCS_S1P(0x67,0x02)
			DCS_S1P(0x68,0x02)
			DCS_S1P(0x69,0x02)
			DCS_S1P(0x6a,0x02)
			DCS_S1P(0x6b,0x0F)
			DCS_S1P(0x6c,0x02)
			DCS_S1P(0x6d,0x02)
			DCS_S1P(0x6e,0x02)
			DCS_S1P(0x6f,0x02)

			DCS_S1P(0x70,0x02)
			DCS_S1P(0x71,0x02)
			DCS_S1P(0x72,0x0E)
			DCS_S1P(0x73,0x06)
			DCS_S1P(0x74,0x07)
			DCS_S1P(0x75,0x08)
			DCS_S1P(0x76,0x02)
			DCS_S1P(0x77,0x00)
			DCS_S1P(0x78,0x01)
			DCS_S1P(0x79,0x0D)
			DCS_S1P(0x7a,0x0C)
			DCS_S1P(0x7b,0x02)
			DCS_S1P(0x7c,0x02)
			DCS_S1P(0x7d,0x02)
			DCS_S1P(0x7e,0x02)
			DCS_S1P(0x7f,0x02)

			DCS_S1P(0x80,0x02)
			DCS_S1P(0x81,0x0F)
			DCS_S1P(0x82,0x02)
			DCS_S1P(0x83,0x02)
			DCS_S1P(0x84,0x02)
			DCS_S1P(0x85,0x02)
			DCS_S1P(0x86,0x02)
			DCS_S1P(0x87,0x02)
			DCS_S1P(0x88,0x0E)
			DCS_S1P(0x89,0x06)
			DCS_S1P(0x8a,0x07)

			//****************************** Page 4 Command ******************************//
			DCS_L3P(0xFF,0x98,0x81,0x04)
			DCS_S1P(0x6c,0x15)
			DCS_S1P(0x6e,0x1a)
			DCS_S1P(0x6f,0x33)
			DCS_S1P(0x8d,0x15)
			DCS_S1P(0x3a,0xa4)
			DCS_S1P(0x87,0x2a)
			DCS_S1P(0x63,0xC0)
			DCS_S1P(0x26,0x76)
			DCS_S1P(0xb2,0xd1)

			//----------- Page 1 Command -------------
			DCS_L3P(0xFF,0x98,0x81,0x01)
			DCS_S1P(0x22,0x09)
			DCS_S1P(0x31,0x00)
			DCS_S1P(0x50,0x9E)
			DCS_S1P(0x51,0x9E)
			//DCS_S1P(0x53,0x5D)
			//DCS_S1P(0x55,0x61)
			DCS_S1P(0x60,0x14)

			/*-----------------------GAMMA SETTING---------------------------------*/
			/*-------------------------Positive setting---------------------------*/
			DCS_S1P(0xA0,0x00) //255
			DCS_S1P(0xA1,0x1B) //251
			DCS_S1P(0xA2,0x2B) //247
			DCS_S1P(0xA3,0x15) //243
			DCS_S1P(0xA4,0x19) //239
			DCS_S1P(0xA5,0x2C) //231
			DCS_S1P(0xA6,0x20) //219
			DCS_S1P(0xA7,0x1D) //203
			DCS_S1P(0xA8,0x98) //175
			DCS_S1P(0xA9,0x1D) //144
			DCS_S1P(0xAA,0x29) //111
			DCS_S1P(0xAB,0x8A) //80
			DCS_S1P(0xAC,0x1D) //52
			DCS_S1P(0xAD,0x1C) //36
			DCS_S1P(0xAE,0x50) //24
			DCS_S1P(0xAF,0x24) //16
			DCS_S1P(0xB0,0x2C) //12
			DCS_S1P(0xB1,0x52) //8
			DCS_S1P(0xB2,0x60) //4
			DCS_S1P(0xB3,0x2A) //0

			/*------------------------Negative setting---------------------------*/
			DCS_S1P(0xC0,0x00) //255
			DCS_S1P(0xC1,0x1B) //251
			DCS_S1P(0xC2,0x2C) //247
			DCS_S1P(0xC3,0x16) //243
			DCS_S1P(0xC4,0x18) //239
			DCS_S1P(0xC5,0x2C) //231
			DCS_S1P(0xC6,0x20) //219
			DCS_S1P(0xC7,0x23) //203
			DCS_S1P(0xC8,0x98) //175
			DCS_S1P(0xC9,0x1D) //144
			DCS_S1P(0xCA,0x2A) //111
			DCS_S1P(0xCB,0x8A) //80
			DCS_S1P(0xCC,0x1E) //52
			DCS_S1P(0xCD,0x1D) //36
			DCS_S1P(0xCE,0x50) //24
			DCS_S1P(0xCF,0x24) //16
			DCS_S1P(0xD0,0x2C) //12
			DCS_S1P(0xD1,0x52) //8
			DCS_S1P(0xD2,0x60) //4
			DCS_S1P(0xD3,0x2A) //0

			//****************************** Page 0 Command ******************************//
			DCS_L3P(0xFF, 0x98, 0x81, 0x00)
			DCS_L2P(0x51, 0x0F, 0xFF)
			DCS_S1P(0x53, 0x24)
			DCS_S1P(0x55, 0x01)
			//DCS_S1P(0x35, 0x00)
			DCS_S0P(0x34)
			DCS_S1P(0x36, 0x03)
			DELAY(10)
			DCS_S0P(0x11)
			DELAY(120)
			DCS_S0P(0x29)
			DELAY(20)
		>;
		mipi-cmds-disable = /bits/ 8 <
			DELAY(2)
		>;
		mode-video-hfp-disable;
		mode-video-hsa-disable;
	};
};
