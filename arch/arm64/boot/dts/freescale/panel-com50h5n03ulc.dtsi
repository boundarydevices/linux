#include <dt-bindings/display/simple_panel_mipi_cmds.h>

/ {
	aliases {
		mipi_cmds_com50h5n03ulc = &mipi_cmds_com50h5n03ulc;
		pinctrl_com50h5n03ulc = &pinctrl_mipi_com50h5n03ulc;
	};

	mipi_cmds_com50h5n03ulc: mipi-cmds-com50h5n03ulc {
		alias = <&mipi_cmds_com50h5n03ulc>;
		aliasp = <&pinctrl_mipi_com50h5n03ulc>;
		min-hs-clock-multiple = <8>;
		mipi-cmds-enable = /bits/ 8 <
			DELAY(122)
			DCS_L3P(0xB9,0xFF,0x83,0x94)	/* SETEXTC */
			0x11
			  0xB1 0x7C 0x00 0x24 0x06 0x01 0x10 0x10 0x26 0x2E 0x1D 0x1D 0x57 0x12 0x01 0xE6
			  0xE2			/* SETPOWER */
			0x07
			  0xB2 0x00 0xC8 0x04 0x04 0x00 0x66	/* SETDISP */
			DCS_S0P(0x20)		/* INVOFF */
			DCS_S1P(0x36,0x00)	/* MADCTL */
			DCS_S1P(0x3A,0x70)	/* COLMOD, 24 BITS/PIXEL */
			0x1F
			  0xB4 0x00 0x04 0x32 0x10 0x00 0x32 0x10 0x00 0x32 0x10 0x08 0x27 0x01 0x53 0x03
			  0x37 0x01 0x53 0x01 0x30 0x30 0x01 0x01 0x43 0x01 0x43 0x01 0x61 0x61 0x01 /* SETCYC */
			0x05
			  0xBF 0x06 0x02 0x10 0x04
			0x05
			  0xC7 0x00 0x10 0x00 0x10
			DCS_L2P(0xC6,0x08,0x08)
			DCS_L2P(0xC0,0x0C,0x15)
			0x21
			  0xD5 0x00 0x00 0x00 0x00 0x0A 0x00 0x01 0x33 0x00 0x00 0x33 0x00 0x10 0x32 0x54
			  0x76 0x10 0x32 0x88 0x88 0x88 0x88 0x88 0x88 0x88 0x99 0x99 0x99 0x54 0x76 0x88
			  0x88		/* SETGIP */
			S_DCS_LENGTH 0x80
			  0xC1 0x01 0x00 0x06 0x0E 0x16 0x1E 0x26 0x2E 0x36 0x3E 0x46 0x4E 0x56 0x5E 0x66
			  0x6E 0x76 0x7E 0x86 0x8E 0x96 0x9E 0xA6 0xAE 0xB6 0xBE 0xC6 0xCE 0xD6 0xDE 0xE6
			  0xEE 0xF6 0xFE 0x00 0x00 0x00 0x00 0x00 0x00 0x00 0x00 0x00 0x00 0x03 0x0B 0x13
			  0x1B 0x23 0x2B 0x33 0x3B 0x43 0x4B 0x53 0x5B 0x63 0x6B 0x73 0x7B 0x83 0x8B 0x93
			  0x9B 0xA3 0xAB 0xB3 0xBB 0xC3 0xCB 0xD3 0xDB 0xE3 0xEB 0xF3 0xFB 0x00 0x00 0x00
			  0x00 0x00 0x00 0x00 0x00 0x00 0x00 0x00 0x08 0x10 0x18 0x1E 0x26 0x2E 0x36 0x3E
			  0x46 0x4E 0x56 0x5E 0x66 0x6E 0x76 0x7E 0x86 0x8E 0x96 0x9E 0xA6 0xAE 0xB6 0xBE
			  0xC6 0xCE 0xD6 0xDE 0xE6 0xED 0xF5 0x00 0x00 0x00 0x00 0x00 0x00 0x00 0x00 0x00	/* SETDGC */
			0x2B
			  0xE0 0x00 0x00 0x00 0x12 0x1D 0x34 0x13 0x2A 0x04 0x0C 0x12 0x16 0x19 0x16 0x16
			  0x0E 0x11 0x00 0x00 0x00 0x18 0x24 0x3F 0x16 0x2C 0x04 0x0D 0x10 0x16 0x18 0x16
			  0x16 0x10 0x11 0x07 0x16 0x06 0x0F 0x08 0x16 0x07 0x10	/* SETGAMMA */
			0x0A
			  0xC9 0x0F 0x00 0x1E 0x1E 0x00 0x00 0x00 0x01 0x3E	/* SETCABC */
			DCS_S1P(0x51,0xFF)	/* WRDISBV */
			DCS_S1P(0x53,0x00)	/* WRCTRLD */
			DCS_S1P(0xBC,0x07)	/* SETVDC */
			DELAY(6)
			DCS_S1P(0xCC,0x09)	/* SETPANEL */
			DELAY(52)
			DCS_S1P(0xBA,0x03)	/* SETMIPI */

			DCS_S0P(0x11)		/* Exit sleep */
			DELAY(52)
			DCS_S0P(0x29)		/* MIPI_DCS_SET_DISPLAY_ON */
			DELAY(20)
		>;
		mipi-cmds-disable = /bits/ 8 <
			DCS_S0P(0x28)		/* MIPI_DCS_SET_DISPLAY_OFF */
			DCS_S0P(0x10)		/* Enter sleep */
			DELAY(120)
		>;
	};
};
