// SPDX-License-Identifier: (GPL-2.0+ OR MIT)
/*
 * Copyright 2023 Boundary Devices
 */

#define REV20
#include "imx8mp-nitrogen8mp-enc-basler4200-ov5640.dts"

/ {
	model = "Boundary i.MX 8M Plus Nitrogen8MP Rev20 4200/ov5640 board";
	compatible = "boundary,imx8mp-nitrogen8mp_r20-enc-basler4200-ov5640", "fsl,imx8mp";
};
