
// SPDX-License-Identifier: (GPL-2.0+ OR MIT)
/*
 * Copyright 2025 Ezurio LLC
 */

#include "imx8mp-nitrogen_smarc.dts"

/ {
	model = "Ezurio Nitrogen8MP SMARC + NX611 WiFi";
	compatible = "ezurio,imx8mp-nitrogen-smarc-nx611", "fsl,imx8mp";
};

&uart1 {
	bluetooth {
		compatible = "nxp,88w8987-bt";
		fw-init-baudrate = <3000000>;
	};
};

&usdhc3 { /* WiFi / Bluetooth */
	max-frequency = <50000000>;
	cap-power-off-card;

	/delete-node/ wifi@1;
};
