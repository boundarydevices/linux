#include <dt-bindings/display/simple_panel_mipi_cmds.h>

/ {
	aliases {
		mipi_cmds_lxd_m8509a = &mipi_cmds_lxd_m8509a;
	};

	mipi_cmds_lxd_m8509a: mipi-cmds-lxd-m8509a {
		alias = <&mipi_cmds_lxd_m8509a>;
		delay-prepare = <130>;
		delay-unprepare = <2>;
		mipi-cmds-enable = /bits/ 8 <
			DELAY(2)
			GEN_S1P(0x3a,0x70)
			GEN_L5P(0xff,0x77,0x01,0x00,0x00,0x13)

			GEN_S1P(0xef,0x08)

			GEN_L5P(0xff,0x77,0x01,0x00,0x00,0x10)
			GEN_S1P(0xcd,0x08)

			GEN_L2P(0xc0,0x63,0x00)
			GEN_L2P(0xc1,0x10,0x02)
			GEN_L2P(0xc2,0x01,0x02)

			GEN_S1P(0xcc,0x10)
			0x91 0xb0 0xc0 0x0c 0x92 0x0c 0x10 0x05 0x02 0x0d 0x07 0x21 0x04 0x53 0x11 0x6a 0x32 0x1f
			0x91 0xb1 0xc0 0x87 0xcf 0x0c 0x10 0x06 0x00 0x03 0x08 0x1d 0x06 0x54 0x12 0xe6 0xec 0x0f

			GEN_S1P(0xe0,0x00)
			GEN_S1P(0xe1,0x08)
			GEN_S1P(0xe2,0x00)
			GEN_S1P(0xe3,0x01)
			GEN_S1P(0xe4,0x00)

			/* Command2, BK1 */
			GEN_L5P(0xff,0x77,0x01,0x00,0x00,0x11)
			GEN_S1P(0xb0,0x5d)
			GEN_S1P(0xb1,0x6b)
			GEN_S1P(0xb2,0x87)

			GEN_S1P(0xb5,0x4e)
			GEN_S1P(0xb7,0x85)
			GEN_S1P(0xb8,0x20)

			GEN_S1P(0xc0,0x09)
			GEN_S1P(0xc1,0x78)
			GEN_S1P(0xc2,0x78)
			GEN_S1P(0xd0,0x88)

			GEN_S1P(0xee,0x42)

			DELAY(100)
			GEN_L3P(0xe0,0x00,0x00,0x02)
			0x8c 0xe1 0x04 0xa0 0x06 0xa0 0x05 0xa0 0x07 0xa0 0x00 0x44 0x44
			0x8d 0xe2 0x00 0x00 0x33 0x33 0x01 0xa0 0x00 0x00 0x01 0xa0 0x00 0x00

			0x85 0xe3 0x00 0x00 0x33 0x33
			GEN_L2P(0xe4, 0x44, 0x44)

			0x91 0xe5 0x0c 0x30 0xa0 0xa0 0x0e 0x32 0xa0 0xa0 0x08 0x2c 0xa0 0xa0 0x0a 0x2e 0xa0 0xa0

			0x85 0xe6 0x00 0x00 0x33 0x33
			GEN_L2P(0xe7, 0x44, 0x44)

			0x91 0xe8 0x0d 0x31 0xa0 0xa0 0x0f 0x33 0xa0 0xa0 0x09 0x2d 0xa0 0xa0 0x0b 0x2f 0xa0 0xa0

			0x88 0xeb 0x00 0x01 0xe4 0xe4 0x44 0x88 0x00
			0x91 0xed 0xff 0xf5 0x47 0x6f 0x0b 0xa1 0xa2 0xbf 0xfb 0x2a 0x1a 0xb0 0xf6 0x74 0x5f 0xff

			0x87 0xef 0x08 0x08 0x08 0x40 0x3f 0x64

			/* disable Command2 */
			GEN_L5P(0xff, 0x77, 0x01, 0x00, 0x00, 0x00)

			DCS_S0P(0x11)		/* Exit sleep */
			DELAY(120)
			DCS_S0P(0x29)		/* MIPI_DCS_SET_DISPLAY_ON */
			DELAY(20)
		>;
		mipi-cmds-disable = /bits/ 8 <
			DELAY(50)
			DCS_S0P(0x28)		/* MIPI_DCS_SET_DISPLAY_OFF */
			DELAY(20)
			DCS_S0P(0x10)		/* Enter sleep */
			DELAY(1)
		>;
		mipi-delay-between-cmds = <1>;
		mode-video-hbp-disable;
		mode-video-hfp-disable;
		mode-video-hsa-disable;
	};
};
