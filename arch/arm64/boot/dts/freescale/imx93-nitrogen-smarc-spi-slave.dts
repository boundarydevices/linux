// SPDX-License-Identifier: (GPL-2.0+ OR MIT)
/*
 * Copyright 2024 Ezurio LLC
 */

#include "imx93-nitrogen-smarc.dts"

/ {
	model = "Boundary Devices Nitrogen93 SMARC + SPI Slave\"";
	compatible = "fsl,imx93-nitrogen-smarc-spi-slave", "fsl,imx93";
};

&lpspi3 {
	#address-cells = <0>;
	fsl,spi-num-chipselects = <1>;
	spi-slave;
	/delete-node/ spi0@0;
	/delete-node/ spi0@1;

	slave {
		compatible = "lwn,bk4";
		spi-max-frequency = <1000000>;
	};
};
