#include "dt-bindings/display/simple_panel_mipi_cmds.h"

/ {
	mipi_cmds_rm67191: mipi-cmds-rm67191 {
		mipi-cmds-enable = /bits/ 8 <
			DELAY(50)
			GEN_S1P(0xFE, 0x0B)
			GEN_S1P(0x28, 0x40)
			GEN_S1P(0x29, 0x4F)
			GEN_S1P(0xFE, 0x0E)
			GEN_S1P(0x4B, 0x00)
			GEN_S1P(0x4C, 0x0F)
			GEN_S1P(0x4D, 0x20)
			GEN_S1P(0x4E, 0x40)
			GEN_S1P(0x4F, 0x60)
			GEN_S1P(0x50, 0xA0)
			GEN_S1P(0x51, 0xC0)
			GEN_S1P(0x52, 0xE0)
			GEN_S1P(0x53, 0xFF)
			GEN_S1P(0xFE, 0x0D)
			GEN_S1P(0x18, 0x08)
			GEN_S1P(0x42, 0x00)
			GEN_S1P(0x08, 0x41)
			GEN_S1P(0x46, 0x02)
			GEN_S1P(0x72, 0x09)
			GEN_S1P(0xFE, 0x0A)
			GEN_S1P(0x24, 0x17)
			GEN_S1P(0x04, 0x07)
			GEN_S1P(0x1A, 0x0C)
			GEN_S1P(0x0F, 0x44)
			GEN_S1P(0xFE, 0x04)
			GEN_S1P(0x00, 0x0C)
			GEN_S1P(0x05, 0x08)
			GEN_S1P(0x06, 0x08)
			GEN_S1P(0x08, 0x08)
			GEN_S1P(0x09, 0x08)
			GEN_S1P(0x0A, 0xE6)
			GEN_S1P(0x0B, 0x8C)
			GEN_S1P(0x1A, 0x12)
			GEN_S1P(0x1E, 0xE0)
			GEN_S1P(0x29, 0x93)
			GEN_S1P(0x2A, 0x93)
			GEN_S1P(0x2F, 0x02)
			GEN_S1P(0x31, 0x02)
			GEN_S1P(0x33, 0x05)
			GEN_S1P(0x37, 0x2D)
			GEN_S1P(0x38, 0x2D)
			GEN_S1P(0x3A, 0x1E)
			GEN_S1P(0x3B, 0x1E)
			GEN_S1P(0x3D, 0x27)
			GEN_S1P(0x3F, 0x80)
			GEN_S1P(0x40, 0x40)
			GEN_S1P(0x41, 0xE0)
			GEN_S1P(0x4F, 0x2F)
			GEN_S1P(0x50, 0x1E)
			GEN_S1P(0xFE, 0x06)
			GEN_S1P(0x00, 0xCC)
			GEN_S1P(0x05, 0x05)
			GEN_S1P(0x07, 0xA2)
			GEN_S1P(0x08, 0xCC)
			GEN_S1P(0x0D, 0x03)
			GEN_S1P(0x0F, 0xA2)
			GEN_S1P(0x32, 0xCC)
			GEN_S1P(0x37, 0x05)
			GEN_S1P(0x39, 0x83)
			GEN_S1P(0x3A, 0xCC)
			GEN_S1P(0x41, 0x04)
			GEN_S1P(0x43, 0x83)
			GEN_S1P(0x44, 0xCC)
			GEN_S1P(0x49, 0x05)
			GEN_S1P(0x4B, 0xA2)
			GEN_S1P(0x4C, 0xCC)
			GEN_S1P(0x51, 0x03)
			GEN_S1P(0x53, 0xA2)
			GEN_S1P(0x75, 0xCC)
			GEN_S1P(0x7A, 0x03)
			GEN_S1P(0x7C, 0x83)
			GEN_S1P(0x7D, 0xCC)
			GEN_S1P(0x82, 0x02)
			GEN_S1P(0x84, 0x83)
			GEN_S1P(0x85, 0xEC)
			GEN_S1P(0x86, 0x0F)
			GEN_S1P(0x87, 0xFF)
			GEN_S1P(0x88, 0x00)
			GEN_S1P(0x8A, 0x02)
			GEN_S1P(0x8C, 0xA2)
			GEN_S1P(0x8D, 0xEA)
			GEN_S1P(0x8E, 0x01)
			GEN_S1P(0x8F, 0xE8)
			GEN_S1P(0xFE, 0x06)
			GEN_S1P(0x90, 0x0A)
			GEN_S1P(0x92, 0x06)
			GEN_S1P(0x93, 0xA0)
			GEN_S1P(0x94, 0xA8)
			GEN_S1P(0x95, 0xEC)
			GEN_S1P(0x96, 0x0F)
			GEN_S1P(0x97, 0xFF)
			GEN_S1P(0x98, 0x00)
			GEN_S1P(0x9A, 0x02)
			GEN_S1P(0x9C, 0xA2)
			GEN_S1P(0xAC, 0x04)
			GEN_S1P(0xFE, 0x06)
			GEN_S1P(0xB1, 0x12)
			GEN_S1P(0xB2, 0x17)
			GEN_S1P(0xB3, 0x17)
			GEN_S1P(0xB4, 0x17)
			GEN_S1P(0xB5, 0x17)
			GEN_S1P(0xB6, 0x11)
			GEN_S1P(0xB7, 0x08)
			GEN_S1P(0xB8, 0x09)
			GEN_S1P(0xB9, 0x06)
			GEN_S1P(0xBA, 0x07)
			GEN_S1P(0xBB, 0x17)
			GEN_S1P(0xBC, 0x17)
			GEN_S1P(0xBD, 0x17)
			GEN_S1P(0xBE, 0x17)
			GEN_S1P(0xBF, 0x17)
			GEN_S1P(0xC0, 0x17)
			GEN_S1P(0xC1, 0x17)
			GEN_S1P(0xC2, 0x17)
			GEN_S1P(0xC3, 0x17)
			GEN_S1P(0xC4, 0x0F)
			GEN_S1P(0xC5, 0x0E)
			GEN_S1P(0xC6, 0x00)
			GEN_S1P(0xC7, 0x01)
			GEN_S1P(0xC8, 0x10)
			GEN_S1P(0xFE, 0x06)
			GEN_S1P(0x95, 0xEC)
			GEN_S1P(0x8D, 0xEE)
			GEN_S1P(0x44, 0xEC)
			GEN_S1P(0x4C, 0xEC)
			GEN_S1P(0x32, 0xEC)
			GEN_S1P(0x3A, 0xEC)
			GEN_S1P(0x7D, 0xEC)
			GEN_S1P(0x75, 0xEC)
			GEN_S1P(0x00, 0xEC)
			GEN_S1P(0x08, 0xEC)
			GEN_S1P(0x85, 0xEC)
			GEN_S1P(0xA6, 0x21)
			GEN_S1P(0xA7, 0x05)
			GEN_S1P(0xA9, 0x06)
			GEN_S1P(0x82, 0x06)
			GEN_S1P(0x41, 0x06)
			GEN_S1P(0x7A, 0x07)
			GEN_S1P(0x37, 0x07)
			GEN_S1P(0x05, 0x06)
			GEN_S1P(0x49, 0x06)
			GEN_S1P(0x0D, 0x04)
			GEN_S1P(0x51, 0x04)

			GEN_S1P(0xFE, 0x00)	/* User Command Set table */
			DCS_S0P(0x01)		/* software reset */
			DELAY(15)

			GEN_S1P(0xc2, 0x0b)
			DCS_S1P(0x35, 0x00)	/* set_tear_on */
			GEN_L2P(0x44, 0x03, 0x80) /* tear scanline */
			DCS_S1P(0x3a, 0x77)	/* set_pixel_format */
			DCS_L2P(0x51, 0xff, 0x00)	/* display_brightness */

			DCS_S0P(0x11)		/* Exit sleep */
			DELAY(10)
			DCS_S0P(0x29)		/* MIPI_DCS_SET_DISPLAY_ON */
			DELAY(20)
		>;
		mipi-cmds-disable = /bits/ 8 <
			DCS_S0P(0x28)		/* MIPI_DCS_SET_DISPLAY_OFF */
			DELAY(20)
			DCS_S0P(0x10)		/* Enter sleep */
		>;
	};
};
