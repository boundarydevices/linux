#include <dt-bindings/display/simple_panel_mipi_cmds.h>

/ {
	aliases {
		mipi_cmds_q035_014 = &mipi_cmds_q035_014;
		pinctrl_q035_014 = &pinctrl_mipi_q035_014;
	};

	/* ST7703 controller */
	mipi_cmds_q035_014: mipi-cmds-q035-014 {
		alias = <&mipi_cmds_q035_014>;
		aliasp = <&pinctrl_mipi_q035_014>;
		delay-prepare = <100>;
		delay-unprepare = <2>;
		mipi-cmds-enable = /bits/ 8 <
			DELAY(2)
			/* SET EXTC */
			DCS_L3P(0xB9,0xF1,0x12,0x83)
			DCS_L3P(0xB2,0x78,0x23,0xF0)	/* Set RSO */
			/* SET RGB */
			0x0B
			  0xB3 0x10 0x10 0x28 0x28 0x03 0xFF 0x00 0x00 0x00 0x00
			DCS_S1P(0xB4,0x80)	/* Set Panel Inversion */
			DCS_L2P(0xB5,0x06,0x06)	/* Set BGP */
			DCS_L2P(0xB6,0xB1,0xBB)	/* Set VCOM */
			DCS_L4P(0xB8,0x26,0x22,0xF0,0x63)	/*Set ECP */
			/* Set DSI */
			0x1C
			  0xBA 0x33 0x81 0x05 0xF9 0x0E 0x0E 0x20 0x00 0x00 0x00 0x00 0x00 0x00 0x00 0x44
			  0x25 0x00 0x90 0x0A 0x00 0x00 0x01 0x4F 0x01 0x00 0x00 0x37
			DCS_S1P(0xBC,0x4F)	/* Set VDC */
  			DCS_L3P(0xBF,0x02,0x11,0x00)	/*Set PCR */
			/* Set SCR */
			0x0A
			  0xC0 0x73 0x73 0x50 0x50 0x00 0x00 0x08 0x70 0x00
			/* Set POWER */
			0x0D
			  0xC1 0x25 0xC0 0x32 0x32 0x99 0xE4 0xFF 0xFF 0xCC 0xCC 0x77 0x77
			/* Set SCR */
			0x07
			  0xC6 0x82 0x00 0x3F 0xFF 0x00 0xE0
			DCS_S1P(0xCC,0x0B)	/* Set Panel */
			/* Set Gamma2.5 */
			0x23
			  0xE0 0x00 0x15 0x19 0x2E 0x3B 0x3F 0x46 0x37 0x08 0x0D 0x0D 0x11 0x13 0x12 0x13
			  0x0F 0x15 0x00 0x15 0x19 0x2E 0x3B 0x3F 0x46 0x37 0x08 0x0D 0x0D 0x11 0x13 0x12
			  0x13 0x0F 0x15
			/* Set EQ */
			0x0F
			  0xE3 0x07 0x07 0x0B 0x0B 0x03 0x03 0x00 0x00 0x00 0x00 0xFF 0x00 0xC0 0x10
			/* Set GIP */
			S_DCS_LENGTH 0x40
			  0xE9 0xC8 0x10 0x0A 0x03 0xC5 0x80 0x38 0x12 0x31 0x23 0x4F 0x86 0x80 0x38 0x47
			  0x08 0x3C 0x00 0xE0 0x0C 0x00 0x00 0x3C 0x00 0xE0 0x0C 0x00 0x00 0x88 0x8F 0xF9
			  0x94 0x44 0x66 0x00 0x22 0x88 0xAA 0x02 0x88 0x8F 0xF9 0x94 0x55 0x77 0x11 0x33
			  0x88 0xAA 0x13 0x00 0x00 0x00 0x01 0x00 0x00 0x00 0x00 0x00 0x00 0x00 0x00 0x00
			/* Set GIP2 */
			0x3E
			  0xEA 0x00 0x1A 0x00 0x00 0x00 0x00 0x00 0x00 0x00 0x00 0x00 0x00 0x8F 0xF8 0x89
			  0x94 0x33 0x11 0x77 0x55 0x88 0xAA 0x31 0x8F 0xF8 0x89 0x94 0x22 0x00 0x66 0x44
			  0x88 0xAA 0x20 0x23 0x00 0x00 0x01 0xB0 0x00 0x00 0x00 0x00 0x00 0x00 0x00 0x00
			  0x00 0x00 0x00 0x03 0xCC 0x00 0x00 0x40 0x80 0x38 0x40 0x80 0x81 0x00

			DELAY(10)
			DCS_S0P(0x11)		/* Exit sleep */

			DELAY(250)
			DCS_S0P(0x29)		/* MIPI_DCS_SET_DISPLAY_ON */
			DELAY(50)
		>;
		mipi-cmds-disable = /bits/ 8 <
			DCS_S0P(0x28)		/* MIPI_DCS_SET_DISPLAY_OFF */
			DELAY(50)
			DCS_S0P(0x10)		/* Enter sleep */
			DELAY(100)
		>;
		mode-video-hfp-disable;
		mode-video-hsa-disable;
	};
};
