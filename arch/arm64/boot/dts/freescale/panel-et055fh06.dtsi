#include <dt-bindings/display/simple_panel_mipi_cmds.h>

/ {
	aliases {
		mipi_cmds_et055fh06 = &mipi_cmds_et055fh06;
		pinctrl_et055fh06 = &pinctrl_mipi_et055fh06;
	};

	/* hx8398 controller */
	mipi_cmds_et055fh06: mipi-cmds-et055fh06 {
		alias = <&mipi_cmds_et055fh06>;
		aliasp = <&pinctrl_mipi_et055fh06>;
		delay-prepare = <100>;
		delay-unprepare = <2>;
		mipi-cmds-enable = /bits/ 8 <
			DELAY(2)
			/* 1920 1080  60 14 20 48 16 3 15  #937Mbps */
			/* 1080 x 1920,  60 14 20 48 16 3 15  #937Mbps */
			/* SET EXTC */
			DCS_L3P(0xB9,0xFF,0x83,0x98)
			/* SET POWER */
			0x0c
			  0xB1 0x28 0x11 0x91 0x01 0x02 0x93 0x33 0x33 0xAE 0xB8 0x0D
			/* SET PANEL */
			DCS_S1P(0xD2,0x77)
			/* SET DISPLAY */
			0x0a
			  0xB2 0x40 0x80 0xAE 0x0C 0x12 0x45 0x01 0x11 0x00
			/* SET CYC */
			0x1a
			  0xB4 0x00 0xFF 0x14 0x84 0x14 0x84 0x00 0x00 0x07 0x07 0x96 0x11 0x07 0x3A 0x14
			  0x84 0x14 0x84 0x00 0x00 0x07 0x07 0x96 0x3A 0x08
			/* Set Bank */
			DCS_S1P(0xBD,0x02)
			/* SET GIP_0 */
			DCS_L3P(0xD3,0x00,0x04,0x10)
			/* Set Bank */
			DCS_S1P(0xBD,0x00)
			/* SET GIP_0 */
			0x30
			  0xD3 0x20 0x00 0x00 0x00 0x00 0x00 0x00 0x00 0x08 0x00 0x32 0x10 0x08 0x00 0x08
			  0x00 0x00 0x00 0x00 0x00 0x00 0x00 0x00 0x00 0x00 0x33 0x00 0x0B 0x0B 0x37 0x00
			  0x00 0x00 0x10 0x40 0x00 0x05 0x19 0x00 0x00 0x00 0x62 0x38 0x05 0x19 0x62 0x38
			/* SET GIP_1 */
			0x29
			  0xD5 0x39 0x39 0x22 0x23 0x20 0x21 0x1E 0x1E 0x38 0x38 0x02 0x03 0x02 0x03 0x00
			  0x01 0x00 0x01 0x06 0x07 0x06 0x07 0x04 0x05 0x04 0x05 0x1F 0x1F 0x18 0x18 0x18
			  0x18 0x18 0x18 0x18 0x18 0x18 0x18 0x18 0x18

			/* SET GIP_1 */
			0x29
			  0xD6 0x39 0x39 0x21 0x20 0x23 0x22 0x1E 0x1E 0x38 0x38 0x05 0x04 0x05 0x04 0x07
			  0x06 0x07 0x06 0x01 0x00 0x01 0x00 0x03 0x02 0x03 0x02 0x1F 0x1F 0x18 0x18 0x18
			  0x18 0x18 0x18 0x18 0x18 0x18 0x18 0x18 0x18

			/* SET PANEL */
			DCS_S1P(0xCC,0x02)
			0x3b
			  0xE0 0x0D 0x13 0x1B 0x21 0x24 0x28 0x2E 0x2B 0x5D 0x6E 0x7F 0x7E 0x84 0x97 0x98
			  0x96 0x9E 0x9C 0x96 0xA3 0xAF 0x57 0x55 0x57 0x5A 0x60 0x6A 0x76 0x78 0x07 0x13
			  0x23 0x13 0x2E 0x32 0x30 0x2F 0x5D 0x6A 0x77 0x76 0x7E 0x8D 0x92 0x96 0xA2 0xA4
			  0xA4 0xB3 0xC5 0x61 0x61 0x65 0x6A 0x6C 0x70 0x76 0x7C
			/* SET VCOM */
			DCS_L2P(0xB6,0x34,0x34)
			DELAY(10)
			DCS_S0P(0x11)		/* Exit sleep */
			DELAY(120)
			DCS_S0P(0x29)		/* MIPI_DCS_SET_DISPLAY_ON */
			DELAY(20)
		>;
		mipi-cmds-disable = /bits/ 8 <
			DCS_S0P(0x28)		/* MIPI_DCS_SET_DISPLAY_OFF */
			DELAY(50)
			DCS_S0P(0x10)		/* Enter sleep */
			DELAY(100)
		>;
		mode-video-hfp-disable;
		mode-video-hsa-disable;
	};
};
