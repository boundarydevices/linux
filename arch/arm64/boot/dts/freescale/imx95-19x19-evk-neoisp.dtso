// SPDX-License-Identifier: (GPL-2.0+ OR MIT)
/*
 * Copyright 2023 NXP
 */

#include <dt-bindings/clock/fsl,imx95-clock.h>
#include <dt-bindings/gpio/gpio.h>
#include <dt-bindings/input/input.h>
#include <dt-bindings/interrupt-controller/arm-gic.h>
#include <dt-bindings/power/fsl,imx95-power.h>

#include "imx95-pinfunc.h"

/dts-v1/;
/plugin/;

&{/} {
	#address-cells = <2>;
	#size-cells = <2>;

	neoisp0: isp@5ae00000 {
		compatible = "nxp,neoisp";
		status = "ok";
		#address-cells = <2>;
		#size-cells = <2>;
		reg = <0x0 0x5ae00000 0x0 0x8000>, <0x0 0x5afe0000 0x0 0x10000>;
		reg-names = "registers", "stats";
		interrupts = <GIC_SPI 222 IRQ_TYPE_LEVEL_HIGH>;
		interrupt-parent = <&gic>;
		clocks = <&cameramix_csr IMX95_CLK_CAMBLK_ISP_AXI>,
			    <&cameramix_csr IMX95_CLK_CAMBLK_ISP_PIXEL>,
			    <&cameramix_csr IMX95_CLK_CAMBLK_ISP>,
			    <&scmi_clk IMX95_CLK_CAMCM0>; /* internal memory */
		clock-names = "camblk_isp_axi", "camblk_isp_pixel", "camblk_isp", "camcm0";
		fsl,blk-ctrl = <&cameramix_csr>;
		power-domains = <&scmi_devpd IMX95_PD_CAMERA>;
	};
};
