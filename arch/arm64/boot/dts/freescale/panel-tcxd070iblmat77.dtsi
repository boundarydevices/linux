#include <dt-bindings/display/simple_panel_mipi_cmds.h>

/ {
	aliases {
		mipi_cmds_tcxd070iblmat77 = &mipi_cmds_tcxd070iblmat77;
		pinctrl_tcxd070iblmat77 = &pinctrl_mipi_tcxd070iblmat77;
	};

	mipi_cmds_tcxd070iblmat77: mipi-cmds-tcxd070iblmat77 {
		alias = <&mipi_cmds_tcxd070iblmat77>;
		aliasp = <&pinctrl_mipi_tcxd070iblmat77>;
		delay-prepare = <100>;
		delay-unprepare = <2>;
		mipi-cmds-enable = /bits/ 8 <
			DELAY(2)
			/* LCD driver initialization */
			/* 10=TX_CLK 30=PCLK */
			DCS_L2P(0xB7,0x50,0x02)
			DCS_L2P(0xBD,0x00,0x00)
			/* Page 3*/
			DCS_L3P(0xFF,0x98,0x81,0x03)
			/* GIP_1 */
			DCS_S1P(0x01,0x00)
			DCS_S1P(0x02,0x00)
			DCS_S1P(0x03,0x73)	/* STVA=STV1~4 */
			DCS_S1P(0x04,0x13)	/* STVB=STV0 */
			DCS_S1P(0x05,0x00)
			DCS_S1P(0x06,0x0A)	/* STVA_Rise */
			DCS_S1P(0x07,0x05)	/* STVB_Rise */
			DCS_S1P(0x08,0x00)
			DCS_S1P(0x09,0x28)	/* FTI1R(A) STV1=3.6H */
			DCS_S1P(0x0a,0x00)
			DCS_S1P(0x0b,0x00)
			DCS_S1P(0x0c,0x00)
			DCS_S1P(0x0d,0x28)	/* FTI2F(B) STV0=3.6H */
			DCS_S1P(0x0e,0x00)
			DCS_S1P(0x0f,0x28)	/* CLW1(ALR) Duty=45% */
			DCS_S1P(0x10,0x28)	/* CLW2(ARR) Duty=45% */
			DCS_S1P(0x11,0x00)
			DCS_S1P(0x12,0x00)
			DCS_S1P(0x13,0x00)
			DCS_S1P(0x14,0x00)
			DCS_S1P(0x15,0x00)
			DCS_S1P(0x16,0x00)
			DCS_S1P(0x17,0x00)
			DCS_S1P(0x18,0x00)
			DCS_S1P(0x19,0x00)
			DCS_S1P(0x1a,0x00)
			DCS_S1P(0x1b,0x00)
			DCS_S1P(0x1c,0x00)
			DCS_S1P(0x1d,0x00)
			DCS_S1P(0x1e,0x40)	/* CLKA 40自動反 C0手動反(X8參考CLKB) */
			DCS_S1P(0x1f,0x80)	/* C0 */
			DCS_S1P(0x20,0x06)	/* CLKA_Rise */
			DCS_S1P(0x21,0x01)	/* CLKA_Fall */
			DCS_S1P(0x22,0x00)
			DCS_S1P(0x23,0x00)
			DCS_S1P(0x24,0x00)
			DCS_S1P(0x25,0x00)
			DCS_S1P(0x26,0x00)
			DCS_S1P(0x27,0x00)
			DCS_S1P(0x28,0x33)	/* CLK Phase */
			DCS_S1P(0x29,0x33)	/* CLK overlap */
			DCS_S1P(0x2a,0x00)
			DCS_S1P(0x2b,0x00)
			DCS_S1P(0x2c,0x04)	/* GCH R */
			DCS_S1P(0x2d,0x04)	/* GCL R */
			DCS_S1P(0x2e,0x05)	/* GCH F */
			DCS_S1P(0x2f,0x05)	/* GCL F */
			DCS_S1P(0x30,0x00)
			DCS_S1P(0x31,0x00)
			DCS_S1P(0x32,0x31)	/* GCH/L ext2/1行為 5E 01:31 5E 00:42 */
			DCS_S1P(0x33,0x00)
			DCS_S1P(0x34,0x00)
			DCS_S1P(0x35,0x0A)	/* GCH/L 區間 00:VS前 01:VS後 10:跨VS 11:frame中 */
			DCS_S1P(0x36,0x00)
			DCS_S1P(0x37,0x08)	/* GCH/L */
			DCS_S1P(0x38,0x00)
			DCS_S1P(0x39,0x00)
			DCS_S1P(0x3a,0x00)
			DCS_S1P(0x3b,0x00)
			DCS_S1P(0x3c,0x00)
			DCS_S1P(0x3d,0x00)
			DCS_S1P(0x3e,0x00)
			DCS_S1P(0x3f,0x00)
			DCS_S1P(0x40,0x00)
			DCS_S1P(0x41,0x00)
			DCS_S1P(0x42,0x00)
			DCS_S1P(0x43,0x08)	/* GCH/L */
			DCS_S1P(0x44,0x00)
										 
		 	/* GIP_2 */
			DCS_S1P(0x50,0x01)
			DCS_S1P(0x51,0x23)
			DCS_S1P(0x52,0x44)
			DCS_S1P(0x53,0x67)
			DCS_S1P(0x54,0x89)
			DCS_S1P(0x55,0xab)
			DCS_S1P(0x56,0x01)
			DCS_S1P(0x57,0x23)
			DCS_S1P(0x58,0x45)
			DCS_S1P(0x59,0x67)
			DCS_S1P(0x5a,0x89)
			DCS_S1P(0x5b,0xab)
			DCS_S1P(0x5c,0xcd)
			DCS_S1P(0x5d,0xef)
				 
		 	/* GIP_3 */
			DCS_S1P(0x5e,0x11)
			DCS_S1P(0x5f,0x02) 	/* FW_CGOUT_L[1] */
			DCS_S1P(0x60,0x08) 	/* FW_CGOUT_L[2] STV0 */
			DCS_S1P(0x61,0x0E) 	/* FW_CGOUT_L[3] CLK1 */
			DCS_S1P(0x62,0x0F) 	/* FW_CGOUT_L[4] CLK3 */
			DCS_S1P(0x63,0x0C) 	/* FW_CGOUT_L[5] CLK5 */
			DCS_S1P(0x64,0x0D) 	/* FW_CGOUT_L[6] CLK7 */
			DCS_S1P(0x65,0x17) 	/* FW_CGOUT_L[7] GCL */
			DCS_S1P(0x66,0x01) 	/* FW_CGOUT_L[8] VDS */
			DCS_S1P(0x67,0x01) 	/* FW_CGOUT_L[9] VDS */
			DCS_S1P(0x68,0x02) 	/* FW_CGOUT_L[10] VGL */
			DCS_S1P(0x69,0x02) 	/* FW_CGOUT_L[11] VGL */
			DCS_S1P(0x6a,0x00) 	/* FW_CGOUT_L[12] VSD */
			DCS_S1P(0x6b,0x00) 	/* FW_CGOUT_L[13] VSD */
			DCS_S1P(0x6c,0x02) 	/* FW_CGOUT_L[14] */
			DCS_S1P(0x6d,0x02) 	/* FW_CGOUT_L[15] */
			DCS_S1P(0x6e,0x16) 	/* FW_CGOUT_L[16] GCH */
			DCS_S1P(0x6f,0x16) 	/* FW_CGOUT_L[17] GCH */
			DCS_S1P(0x70,0x06) 	/* FW_CGOUT_L[18] STV1 */
			DCS_S1P(0x71,0x06) 	/* FW_CGOUT_L[19] STV1 */
			DCS_S1P(0x72,0x07) 	/* FW_CGOUT_L[20] STV3 */
			DCS_S1P(0x73,0x07) 	/* FW_CGOUT_L[21] STV3 */
			DCS_S1P(0x74,0x02) 	/* FW_CGOUT_L[22] */

			DCS_S1P(0x75,0x02) 	/* BW_CGOUT_L[1] */
			DCS_S1P(0x76,0x08) 	/* BW_CGOUT_L[2] */
			DCS_S1P(0x77,0x0E) 	/* BW_CGOUT_L[3] */
			DCS_S1P(0x78,0x0F) 	/* BW_CGOUT_L[4] */
			DCS_S1P(0x79,0x0C) 	/* BW_CGOUT_L[5] */
			DCS_S1P(0x7a,0x0D) 	/* BW_CGOUT_L[6] */
			DCS_S1P(0x7b,0x17) 	/* BW_CGOUT_L[7] */
			DCS_S1P(0x7c,0x01) 	/* BW_CGOUT_L[8] */
			DCS_S1P(0x7d,0x01) 	/* BW_CGOUT_L[9] */
			DCS_S1P(0x7e,0x02) 	/* BW_CGOUT_L[10] */
			DCS_S1P(0x7f,0x02) 	/* BW_CGOUT_L[11] */
			DCS_S1P(0x80,0x00) 	/* BW_CGOUT_L[12] */
			DCS_S1P(0x81,0x00) 	/* BW_CGOUT_L[13] */
			DCS_S1P(0x82,0x02) 	/* BW_CGOUT_L[14] */
			DCS_S1P(0x83,0x02) 	/* BW_CGOUT_L[15] */
			DCS_S1P(0x84,0x16) 	/* BW_CGOUT_L[16] */
			DCS_S1P(0x85,0x16) 	/* BW_CGOUT_L[17] */
			DCS_S1P(0x86,0x06) 	/* BW_CGOUT_L[18] */
			DCS_S1P(0x87,0x06) 	/* BW_CGOUT_L[19] */
			DCS_S1P(0x88,0x07) 	/* BW_CGOUT_L[20] */
			DCS_S1P(0x89,0x07) 	/* BW_CGOUT_L[21] */
			DCS_S1P(0x8A,0x02) 	/* BW_CGOUT_L[22] */

			/* CMD_Page 4 */
			DCS_L3P(0xFF,0x98,0x81,0x04)

			DCS_S1P(0x6E,0x1A) 	/* VGH 12V */
			DCS_S1P(0x6F,0x37) 	/*  reg vcl + pumping ratio VGH=3x VGL=-3x */
			DCS_S1P(0x3A,0xA4) 	/* POWER SAVING */
			DCS_S1P(0x8D,0x1F) 	/* VGL -12V */
			DCS_S1P(0x87,0xBA) 	/* ESD */
			DCS_S1P(0xB2,0xD1)
			DCS_S1P(0x88,0x0B)
			DCS_S1P(0x38,0x01) 
			DCS_S1P(0x39,0x00)
			DCS_S1P(0xB5,0x02)	/* gamma bias */
			DCS_S1P(0x31,0x25) 	/* source bias */
			DCS_S1P(0x3B,0x98) 			
					
		 	/* CMD_Page 1 */
			DCS_L3P(0xFF,0x98,0x81,0x01)
			DCS_S1P(0x22,0x0A) 	/* BGR,0x SS */
			DCS_S1P(0x31,0x00) 	/* Column inversion */
			DCS_S1P(0x53,0x53) 	/* 3D VCOM1 20201129 */
			DCS_S1P(0x55,0x3D) 	/* VCOM2  */
			DCS_S1P(0x50,0x9E) 	/* A0 VREG1OUT 4.6V 20201203 */
			DCS_S1P(0x51,0x99) 	/* 9C VREG2OUT -4.6V 20201203 */
			DCS_S1P(0x60,0x06) 	/* SDT */
			DCS_S1P(0x62,0x20)

		 	/* ============Gamma START============= */
		 	/* Pos Register 20201203 */
			DCS_S1P(0xA0,0x00)
			DCS_S1P(0xA1,0x17)
			DCS_S1P(0xA2,0x26)
			DCS_S1P(0xA3,0x13)
			DCS_S1P(0xA4,0x16)
			DCS_S1P(0xA5,0x29)
			DCS_S1P(0xA6,0x1E)
			DCS_S1P(0xA7,0x1F)
			DCS_S1P(0xA8,0x8B)
			DCS_S1P(0xA9,0x1D)
			DCS_S1P(0xAA,0x2A)
			DCS_S1P(0xAB,0x7B)
			DCS_S1P(0xAC,0x1A)
			DCS_S1P(0xAD,0x19)
			DCS_S1P(0xAE,0x4E)
			DCS_S1P(0xAF,0x24)
			DCS_S1P(0xB0,0x29)
			DCS_S1P(0xB1,0x4F)
			DCS_S1P(0xB2,0x5C)
			DCS_S1P(0xB3,0x23)
										 
		 	/* Neg Register */
			DCS_S1P(0xC0,0x00)
			DCS_S1P(0xC1,0x17)
			DCS_S1P(0xC2,0x26)
			DCS_S1P(0xC3,0x13)
			DCS_S1P(0xC4,0x16)
			DCS_S1P(0xC5,0x29)
			DCS_S1P(0xC6,0x1E)
			DCS_S1P(0xC7,0x1F)
			DCS_S1P(0xC8,0x8B)
			DCS_S1P(0xC9,0x1D)
			DCS_S1P(0xCA,0x2A)
			DCS_S1P(0xCB,0x7B)
			DCS_S1P(0xCC,0x1A)
			DCS_S1P(0xCD,0x19)
			DCS_S1P(0xCE,0x4E)
			DCS_S1P(0xCF,0x24)
			DCS_S1P(0xD0,0x29)
			DCS_S1P(0xD1,0x4F)
			DCS_S1P(0xD2,0x5C)
			DCS_S1P(0xD3,0x23)
		 	/* ============ Gamma END=========== */

			/* CMD_Page 0 */
			DCS_L3P(0xFF,0x98,0x81,0x00)
		 	/* --- TE---- */
			DCS_S1P(0x35,0x00)
			DCS_S0P(0x11)		/* Exit sleep */
		>;
		mipi-cmds-enable2 = /bits/ 8 <
			DELAY(120)
			DCS_S0P(0x29)		/* MIPI_DCS_SET_DISPLAY_ON */
			DELAY(120)
		>;
		mipi-cmds-disable = /bits/ 8 <
			DELAY(50)
			DCS_S0P(0x28)		/* MIPI_DCS_SET_DISPLAY_OFF */
			DELAY(20)
			DCS_S0P(0x10)		/* Enter sleep */
			DELAY(1)
		>;
		mode-video-hfp-disable;
		mode-video-hsa-disable;
	};
};
