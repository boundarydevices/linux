#include <dt-bindings/display/simple_panel_mipi_cmds.h>

#ifdef H499
#define GEN_S1P_2(cmd, param_h499, param_osd) GEN_S1P(cmd, param_h499)
#define DELAY_2(ms_h499, ms_osd) DELAY(ms_h499)
#else
/* original settings for OSD050T2844-70 */
#define GEN_S1P_2(cmd, param_h499, param_osd) GEN_S1P(cmd, param_osd)
#define DELAY_2(ms_h499, ms_osd) DELAY(ms_osd)
#endif

#define VBP	8

/*  manufacturer command set page 0  registers */
#define P0_RGBCTR	0x01
#define P0_DPRSLCTR	0x0e
#define P0_STBCTR1	0x0f
#define P0_STBCTR2	0x10
#define P0_STBCTR3	0x11
#define P0_TMPSCTR1	0x12
#define P0_TMPSCTR2	0x13
#define P0_TMPSCTR3	0x14
#define P0_SDVPCTR	0x15
#define P0_SGOPCTR	0x16
#define P0_SDEQCTR1	0x17
#define P0_SDEQCTR2	0x18
#define P0_SDEQCTR3	0x19
#define P0_SDCTR	0x1a
#define P0_INVCTR	0x1b
#define P0_HSIFOPCTR1	0x1e
#define P0_HSIFOPCTR2	0x1f
#define P0_HSIFOPCTR3	0x20
#define P0_EXT_PWR_IC	0x25
#define P0_SETAVDD	0x27
#define P0_SETAVEE	0x29
#define P0_BT2CTR1	0x2b
#define P0_BT3CTR1	0x2f
#define P0_BT3CTR2	0x31
#define P0_TMPSVGHCTR1	0x32
#define P0_TMPSVGHCTR2	0x33
#define P0_BT4CTR1	0x34
#define P0_BT4CTR2	0x36
#define P0_TMPSVGLCTR1	0x37
#define P0_TMPSVGLCTR2	0x38
#define P0_BT2CTR2	0x39
#define P0_REGCTR	0x3d
#define P0_VCMCTR1	0x45
#define P0_VCMCTR2	0x46
#define P0_VCMCTR3	0x47
#define P0_VCMCTRIDM1	0x48
#define P0_VCMCTRIDM2	0x49
#define P0_SETVGN1	0x52
#define P0_SETVGN2	0x53
#define P0_SETVGP1	0x54
#define P0_SETVGP2	0x55

/ {
	osd050t3236_mipi_cmds: osd050t3236-mipi-cmds {
		mipi-cmds-init = /bits/ 8 <
			GEN_S1P(0xFE, 0x01)		/* CMD Mode Switch, manufacturer command set page 0 */

			GEN_S1P(P0_RGBCTR, VBP)	/* Vertical back porch*/
			GEN_S1P(P0_DPRSLCTR, 0x21)	/* 720 horizontal */
			GEN_S1P(P0_STBCTR1, 0xC8)	/* 1280 vertical */

			GEN_S1P_2(0x24, 0xC0, 0x00)	/* ??? */

			GEN_S1P(P0_EXT_PWR_IC, 0x53) /*  */
			GEN_S1P(0x26, 0x00)		/* ??? */
			GEN_S1P(P0_SETAVDD, 0x0A)	/*  */
			GEN_S1P(P0_SETAVEE, 0x0A)	/*  */
			GEN_S1P(P0_BT2CTR1, 0xE5)	/*  */
			GEN_S1P(P0_SGOPCTR, 0x52)	/* AVSS, */
			GEN_S1P(P0_BT3CTR1, 0x54)	/* */
			GEN_S1P(0x34, 0x59)

			GEN_S1P_2(P0_INVCTR, 0x00, 0x50)	/* 0x50- zigzag inversion*/
			GEN_S1P_2(P0_TMPSCTR1, 0x08, 0x02)	/* zigzag type */

			GEN_S1P(P0_SDCTR, 0x06)
			GEN_S1P_2(P0_VCMCTR2, 0x4F, 0x5F)

			GEN_S1P(P0_SETVGN1, 0x70)
			GEN_S1P(P0_SETVGN2, 0x00)
			GEN_S1P(P0_SETVGP1, 0x70)
			GEN_S1P(P0_SETVGP2, 0x00)

			GEN_S1P(0x5F, 0x11)		/* SELECT 2 LANES !!!! */
#ifndef H499
			/* GEN_S1P(0x5F, 0x13), */
			GEN_S1P(0x24, 0xC0)
			GEN_S1P(P0_INVCTR, 0x50)	/* INVCTR, 0x50- zigzag inversion*/
			GEN_S1P(P0_TMPSCTR1, 0x02)	/* STBCTR, zigzag type */
#endif
			DELAY_2(200, 20)

			GEN_S1P(0xFE, 0x03)		/* CMD Mode Switch, manufacturer command set page 2 */
			GEN_S1P(0x00, 0x05)
			GEN_S1P(0x01, 0x16)
			GEN_S1P(0x02, 0x0B)
			GEN_S1P(0x03, 0x0F)
			GEN_S1P(0x04, 0x7D)
			GEN_S1P(0x05, 0x00)
			GEN_S1P(0x06, 0x50)
			GEN_S1P(0x07, 0x05)
			GEN_S1P(0x08, 0x16)
			GEN_S1P(0x09, 0x0D)
			GEN_S1P(0x0A, 0x11)
			GEN_S1P(0x0B, 0x7D)
			GEN_S1P(0x0C, 0x00)
			GEN_S1P(0x0D, 0x50)
			GEN_S1P(0x0E, 0x07)
			GEN_S1P(0x0F, 0x08)
			GEN_S1P(0x10, 0x01)
			GEN_S1P(0x11, 0x02)
			GEN_S1P(0x12, 0x00)
			GEN_S1P(0x13, 0x7D)
			GEN_S1P(0x14, 0x00)
			GEN_S1P(0x15, 0x85)
			GEN_S1P(0x16, 0x08)
			GEN_S1P(0x17, 0x03)
			GEN_S1P(0x18, 0x04)
			GEN_S1P(0x19, 0x05)
			GEN_S1P(0x1A, 0x06)
			GEN_S1P(0x1B, 0x00)
			GEN_S1P(0x1C, 0x7D)
			GEN_S1P(0x1D, 0x00)
			GEN_S1P(0x1E, 0x85)
			GEN_S1P(0x1F, 0x08)
			GEN_S1P(0x20, 0x00)
			GEN_S1P(0x21, 0x00)
			GEN_S1P(0x22, 0x00)
			GEN_S1P(0x23, 0x00)
			GEN_S1P(0x24, 0x00)
			GEN_S1P(0x25, 0x00)
			GEN_S1P(0x26, 0x00)
			GEN_S1P(0x27, 0x00)
			GEN_S1P(0x28, 0x00)
			GEN_S1P(0x29, 0x00)
			GEN_S1P(0x2A, 0x07)
			GEN_S1P(0x2B, 0x08)
			GEN_S1P(0x2D, 0x01)
			GEN_S1P(0x2F, 0x02)
			GEN_S1P(0x30, 0x00)
			GEN_S1P(0x31, 0x40)
			GEN_S1P(0x32, 0x05)
			GEN_S1P(0x33, 0x08)
			GEN_S1P(0x34, 0x54)
			GEN_S1P(0x35, 0x7D)
			GEN_S1P(0x36, 0x00)
			GEN_S1P(0x37, 0x03)
			GEN_S1P(0x38, 0x04)
			GEN_S1P(0x39, 0x05)
			GEN_S1P(0x3A, 0x06)
			GEN_S1P(0x3B, 0x00)
			GEN_S1P(0x3D, 0x40)
			GEN_S1P(0x3F, 0x05)
			GEN_S1P(0x40, 0x08)
			GEN_S1P(0x41, 0x54)
			GEN_S1P(0x42, 0x7D)
			GEN_S1P(0x43, 0x00)
			GEN_S1P(0x44, 0x00)
			GEN_S1P(0x45, 0x00)
			GEN_S1P(0x46, 0x00)
			GEN_S1P(0x47, 0x00)
			GEN_S1P(0x48, 0x00)
			GEN_S1P(0x49, 0x00)
			GEN_S1P(0x4A, 0x00)
			GEN_S1P(0x4B, 0x00)
			GEN_S1P(0x4C, 0x00)
			GEN_S1P(0x4D, 0x00)
			GEN_S1P(0x4E, 0x00)
			GEN_S1P(0x4F, 0x00)
			GEN_S1P(0x50, 0x00)
			GEN_S1P(0x51, 0x00)
			GEN_S1P(0x52, 0x00)
			GEN_S1P(0x53, 0x00)
			GEN_S1P(0x54, 0x00)
			GEN_S1P(0x55, 0x00)
			GEN_S1P(0x56, 0x00)
			GEN_S1P(0x58, 0x00)
			GEN_S1P(0x59, 0x00)
			GEN_S1P(0x5A, 0x00)
			GEN_S1P(0x5B, 0x00)
			GEN_S1P(0x5C, 0x00)
			GEN_S1P(0x5D, 0x00)
			GEN_S1P(0x5E, 0x00)
			GEN_S1P(0x5F, 0x00)
			GEN_S1P(0x60, 0x00)
			GEN_S1P(0x61, 0x00)
			GEN_S1P(0x62, 0x00)
			GEN_S1P(0x63, 0x00)
			GEN_S1P(0x64, 0x00)
			GEN_S1P(0x65, 0x00)
			GEN_S1P(0x66, 0x00)
			GEN_S1P(0x67, 0x00)
			GEN_S1P(0x68, 0x00)
			GEN_S1P(0x69, 0x00)
			GEN_S1P(0x6A, 0x00)
			GEN_S1P(0x6B, 0x00)
			GEN_S1P(0x6C, 0x00)
			GEN_S1P(0x6D, 0x00)
			GEN_S1P(0x6E, 0x00)
			GEN_S1P(0x6F, 0x00)
			GEN_S1P(0x70, 0x00)
			GEN_S1P(0x71, 0x00)
			GEN_S1P(0x72, 0x20)
			GEN_S1P(0x73, 0x00)
			GEN_S1P(0x74, 0x08)
			GEN_S1P(0x75, 0x08)
			GEN_S1P(0x76, 0x08)
			GEN_S1P(0x77, 0x08)
			GEN_S1P(0x78, 0x08)
			GEN_S1P(0x79, 0x08)
			GEN_S1P(0x7A, 0x00)
			GEN_S1P(0x7B, 0x00)
			GEN_S1P(0x7C, 0x00)
			GEN_S1P(0x7D, 0x00)
			GEN_S1P(0x7E, 0xBF)
			GEN_S1P(0x7F, 0x3F)
			GEN_S1P(0x80, 0x3F)
			GEN_S1P(0x81, 0x3F)
			GEN_S1P(0x82, 0x3F)
			GEN_S1P(0x83, 0x3F)
			GEN_S1P(0x84, 0x3F)
			GEN_S1P(0x85, 0x02)
			GEN_S1P(0x86, 0x06)
			GEN_S1P(0x87, 0x3F)
			GEN_S1P(0x88, 0x14)
			GEN_S1P(0x89, 0x10)
			GEN_S1P(0x8A, 0x16)
			GEN_S1P(0x8B, 0x12)
			GEN_S1P(0x8C, 0x08)
			GEN_S1P(0x8D, 0x0C)
			GEN_S1P(0x8E, 0x0A)
			GEN_S1P(0x8F, 0x0E)
			GEN_S1P(0x90, 0x00)
			GEN_S1P(0x91, 0x04)
			GEN_S1P(0x92, 0x3F)
			GEN_S1P(0x93, 0x3F)
			GEN_S1P(0x94, 0x3F)
			GEN_S1P(0x95, 0x3F)
			GEN_S1P(0x96, 0x05)
			GEN_S1P(0x97, 0x01)
			GEN_S1P(0x98, 0x0F)
			GEN_S1P(0x99, 0x0B)
			GEN_S1P(0x9A, 0x0D)
			GEN_S1P(0x9B, 0x09)
			GEN_S1P(0x9C, 0x13)
			GEN_S1P(0x9D, 0x17)
			GEN_S1P(0x9E, 0x11)
			GEN_S1P(0x9F, 0x15)
			GEN_S1P(0xA0, 0x3F)
			GEN_S1P(0xA2, 0x07)
			GEN_S1P(0xA3, 0x03)
			GEN_S1P(0xA4, 0x3F)
			GEN_S1P(0xA5, 0x3F)
			GEN_S1P(0xA6, 0x3F)
			GEN_S1P(0xA7, 0x3F)
			GEN_S1P(0xA9, 0x3F)
			GEN_S1P(0xAA, 0x3F)
			GEN_S1P(0xAB, 0x3F)
			GEN_S1P(0xAC, 0x3F)
			GEN_S1P(0xAD, 0x3F)
			GEN_S1P(0xAE, 0x3F)
			GEN_S1P(0xAF, 0x3F)
			GEN_S1P(0xB0, 0x3F)
			GEN_S1P(0xB1, 0x3F)
			GEN_S1P(0xB2, 0x3F)
			GEN_S1P(0xB3, 0x05)
			GEN_S1P(0xB4, 0x01)
			GEN_S1P(0xB5, 0x3F)
			GEN_S1P(0xB6, 0x17)
			GEN_S1P(0xB7, 0x13)
			GEN_S1P(0xB8, 0x15)
			GEN_S1P(0xB9, 0x11)
			GEN_S1P(0xBA, 0x0F)
			GEN_S1P(0xBB, 0x0B)
			GEN_S1P(0xBC, 0x0D)
			GEN_S1P(0xBD, 0x09)
			GEN_S1P(0xBE, 0x07)
			GEN_S1P(0xBF, 0x03)
			GEN_S1P(0xC0, 0x3F)
			GEN_S1P(0xC1, 0x3F)
			GEN_S1P(0xC2, 0x3F)
			GEN_S1P(0xC3, 0x3F)
			GEN_S1P(0xC4, 0x02)
			GEN_S1P(0xC5, 0x06)
			GEN_S1P(0xC6, 0x08)
			GEN_S1P(0xC7, 0x0C)
			GEN_S1P(0xC8, 0x0A)
			GEN_S1P(0xC9, 0x0E)
			GEN_S1P(0xCA, 0x10)
			GEN_S1P(0xCB, 0x14)
			GEN_S1P(0xCC, 0x12)
			GEN_S1P(0xCD, 0x16)
			GEN_S1P(0xCE, 0x3F)
			GEN_S1P(0xCF, 0x00)
			GEN_S1P(0xD0, 0x04)
			GEN_S1P(0xD1, 0x3F)
			GEN_S1P(0xD2, 0x3F)
			GEN_S1P(0xD3, 0x3F)
			GEN_S1P(0xD4, 0x3F)
			GEN_S1P(0xD5, 0x3F)
			GEN_S1P(0xD6, 0x3F)
			GEN_S1P(0xD7, 0x3F)
			GEN_S1P(0xDC, 0x02)
			GEN_S1P(0xDE, 0x12)
			DELAY_2(200, 20)

			GEN_S1P(0xFE, 0x0E)		/* CMD Mode Switch  ?? */
			GEN_S1P(0x01, 0x75)
			DELAY_2(200, 20)

			GEN_S1P(0xFE, 0x04)	/* CMD Mode Switch, manufacturer command set page 3 */

			GEN_S1P_2(0x60, 0x09, 0x00)
			GEN_S1P_2(0x61, 0x12, 0x08)
			GEN_S1P_2(0x62, 0x18, 0x0E)

			GEN_S1P(0x63, 0x0D)

			GEN_S1P_2(0x64, 0x06, 0x05)
			GEN_S1P_2(0x65, 0x13, 0x10)
			GEN_S1P_2(0x66, 0x0F, 0x0E)
			GEN_S1P_2(0x67, 0x0B, 0x0A)

			GEN_S1P(0x68, 0x16)
			GEN_S1P(0x69, 0x0C)

			GEN_S1P_2(0x6A, 0x0E, 0x10)
			GEN_S1P_2(0x6B, 0x06, 0x07)
			GEN_S1P_2(0x6C, 0x0D, 0x0E)

			GEN_S1P(0x6D, 0x13)

			GEN_S1P_2(0x6E, 0x0E, 0x0C)

			GEN_S1P(0x6F, 0x00)

			GEN_S1P_2(0x70, 0x09, 0x00)
			GEN_S1P_2(0x71, 0x12, 0x08)
			GEN_S1P_2(0x72, 0x18, 0x0E)

			GEN_S1P(0x73, 0x0D)

			GEN_S1P_2(0x74, 0x06, 0x05)
			GEN_S1P_2(0x75, 0x13, 0x10)
			GEN_S1P_2(0x76, 0x0F, 0x0E)
			GEN_S1P_2(0x77, 0x0B, 0x0A)

			GEN_S1P(0x78, 0x16)
			GEN_S1P(0x79, 0x0C)

			GEN_S1P_2(0x7A, 0x0E, 0x10)
			GEN_S1P_2(0x7B, 0x06, 0x07)
			GEN_S1P_2(0x7C, 0x0D, 0x0E)

			GEN_S1P(0x7D, 0x13)

			GEN_S1P_2(0x7E, 0x0E, 0x0C)

			GEN_S1P(0x7F, 0x00)

			DELAY_2(200, 20)

			GEN_S1P(0xFE, 0x00)		/* CMD Mode Switch, user command set */
			GEN_S1P(0x3A, 0x77)		/* Interface pixel format, 24 BPP */
			/* GEN_S1P(0x3A, 0x66) */	/* Interface pixel format, 18 BPP */
			/* GEN_S1P(0x3A, 0x55) */	/* Interface pixel format, 16 BPP */
			/* GEN_S1P(0x36, 0xC3) */	/* Upside down dispay */
			GEN_S0P(0x11)		/* exit sleep mode */
			DELAY(200)
			GEN_S0P(0x29)		/* Set display on */

			DELAY_2(200, 20)
		>;
	};
};
