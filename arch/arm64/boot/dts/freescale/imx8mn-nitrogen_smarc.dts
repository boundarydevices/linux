// SPDX-License-Identifier: (GPL-2.0+ OR MIT)
/*
 * Copyright 2023 Boundary Devices
 */

/dts-v1/;
#ifdef CONFIG_DEFCONFIG
#define UBOOT
#endif
#define IMX8MN

#define MX8MMN(a, b)	MX8MN_##a b
#define IMX8MMN(a)	IMX8MN_##a
#define IMX8MN_CLK_LCDIF_PIXEL IMX8MN_CLK_DISP_PIXEL_ROOT
#include "imx8mn.dtsi"
#include "imx8mm-nitrogen_smarc-som.dtsi"

#ifdef UBOOT
#include "bd-universal-smarc-carrier.dtsi"
#else
#include "../bd-universal-smarc-carrier.dtsi"
#endif
/ {
	model = "Boundary i.MX8MN nitrogen_smarc board";
	compatible = "boundary,imx8mn-nitrogen-smarc", "fsl,imx8mn";

	aliases {
		rtc1 = &snvs_rtc;
	};
};

&mipi_dsi {
	pinctrl-0 = <&pinctrl_mipi_sn65dsi83>, <&pinctrl_mipi_sn65dsi83_alt>;
};
