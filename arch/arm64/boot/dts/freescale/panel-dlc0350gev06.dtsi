#include <dt-bindings/display/simple_panel_mipi_cmds.h>

#define PAGE(page) DCS_L3P(0xff, 0x98, 0x81, page)

/ {
	aliases {
		mipi_cmds_dlc0350gev06 = &mipi_cmds_dlc0350gev06;
		pinctrl_dlc0350gev06 = &pinctrl_mipi_dlc0350gev06;
	};

	mipi_cmds_dlc0350gev06: mipi-cmds-dlc0350gev06 {
		alias = <&mipi_cmds_dlc0350gev06>;
		aliasp = <&pinctrl_mipi_dlc0350gev06>;
		delay-prepare = <150>;
		mipi-cmds-enable = /bits/ 8 <
			PAGE(0)
			DCS_S1P(0x0C, 0x07)
			DCS_S1P(0x36, 0x08)

			PAGE(1)
			DCS_S1P(0x91, 0x00)
			DCS_S1P(0x92, 0x00)
			DCS_S1P(0x93, 0x78)
			DCS_S1P(0x94, 0x36)
			DCS_S1P(0x95, 0x03)
			DCS_S1P(0x96, 0x0F)
			DCS_S1P(0x97, 0x03)
			DCS_S1P(0x98, 0x0F)

			DCS_S1P(0x09, 0x00)
			DCS_S1P(0x0A, 0x00)
			DCS_S1P(0x0B, 0x00)
			DCS_S1P(0x0C, 0x0B)
			DCS_S1P(0x0D, 0x00)
			DCS_S1P(0x0E, 0x00)
			DCS_S1P(0x0F, 0x08)

			DCS_S1P(0x10, 0x08)
			DCS_S1P(0x11, 0x00)
			DCS_S1P(0x12, 0x00)
			DCS_S1P(0x13, 0x02)
			DCS_S1P(0x14, 0x00)
			DCS_S1P(0x15, 0x00)
			DCS_S1P(0x16, 0x00)
			DCS_S1P(0x17, 0x00)
			DCS_S1P(0x18, 0x00)
			DCS_S1P(0x19, 0x00)
			DCS_S1P(0x1A, 0x00)
			DCS_S1P(0x1B, 0x00)
			DCS_S1P(0x1C, 0x00)
			DCS_S1P(0x1D, 0x00)
			DCS_S1P(0x1E, 0xC0)
			DCS_S1P(0x1F, 0x40)

			DCS_S1P(0x20, 0x0D)
			DCS_S1P(0x21, 0x02)
			DCS_S1P(0x22, 0x08)
			DCS_S1P(0x23, 0x03)
			DCS_S1P(0x24, 0x8C)
			DCS_S1P(0x25, 0x8C)
			DCS_S1P(0x26, 0x00)
			DCS_S1P(0x27, 0x00)
			DCS_S1P(0x28, 0x77)
			DCS_S1P(0x29, 0x66)
			DCS_S1P(0x2A, 0x00)
			DCS_S1P(0x2B, 0x00)
			DCS_S1P(0x2C, 0x08)
			DCS_S1P(0x2D, 0x08)
			DCS_S1P(0x2E, 0x08)
			DCS_S1P(0x2F, 0x08)

			DCS_S1P(0x30, 0x00)
			DCS_S1P(0x31, 0x00)
			DCS_S1P(0x32, 0x02)
			DCS_S1P(0x33, 0x00)
			DCS_S1P(0x34, 0x03)
			DCS_S1P(0x35, 0x0A)
			DCS_S1P(0x36, 0x00)
			DCS_S1P(0x37, 0x08)
			DCS_S1P(0x38, 0x01)
			DCS_S1P(0x39, 0x07)
			DCS_S1P(0x3A, 0x00)
			DCS_S1P(0x3B, 0x00)
			DCS_S1P(0x3C, 0x00)

			DCS_S1P(0x40, 0x03)
			DCS_S1P(0x41, 0x20)
			DCS_S1P(0x42, 0x00)
			DCS_S1P(0x43, 0x40)
			DCS_S1P(0x44, 0x03)
			DCS_S1P(0x45, 0x00)
			DCS_S1P(0x46, 0x01)
			DCS_S1P(0x47, 0x08)
			DCS_S1P(0x48, 0x00)
			DCS_S1P(0x49, 0x00)
			DCS_S1P(0x4A, 0x00)
			DCS_S1P(0x4B, 0x00)
			DCS_S1P(0x4C, 0x1E)
			DCS_S1P(0x4D, 0x90)
			DCS_S1P(0x4E, 0x57)
			DCS_S1P(0x4F, 0x54)

			DCS_S1P(0x50, 0x27)
			DCS_S1P(0x51, 0xB9)
			DCS_S1P(0x52, 0xFD)
			DCS_S1P(0x53, 0x31)
			DCS_S1P(0x54, 0xDB)
			DCS_S1P(0x55, 0x22)
			DCS_S1P(0x56, 0x22)
			DCS_S1P(0x57, 0x1E)
			DCS_S1P(0x58, 0x80)
			DCS_S1P(0x59, 0x56)
			DCS_S1P(0x5A, 0x44)
			DCS_S1P(0x5B, 0x26)
			DCS_S1P(0x5C, 0xA8)
			DCS_S1P(0x5D, 0xEC)
			DCS_S1P(0x5E, 0x20)
			DCS_S1P(0x5F, 0xCA)

			DCS_S1P(0x60, 0x22)
			DCS_S1P(0x61, 0x22)
			DCS_S1P(0x62, 0x06)
			DCS_S1P(0x63, 0x0E)
			DCS_S1P(0x64, 0x01)
			DCS_S1P(0x65, 0x00)
			DCS_S1P(0x66, 0x0A)
			DCS_S1P(0x67, 0x0C)
			DCS_S1P(0x68, 0xA5)
			DCS_S1P(0x69, 0xA4)
			DCS_S1P(0x6A, 0x62)
			DCS_S1P(0x6B, 0x60)
			DCS_S1P(0x6C, 0x02)
			DCS_S1P(0x6D, 0x5E)
			DCS_S1P(0x6E, 0x5C)
			DCS_S1P(0x6F, 0x5A)

			DCS_S1P(0x70, 0x58)
			DCS_S1P(0x71, 0x96)
			DCS_S1P(0x72, 0x94)
			DCS_S1P(0x73, 0x08)
			DCS_S1P(0x74, 0x06)
			DCS_S1P(0x75, 0x02)
			DCS_S1P(0x76, 0x02)
			DCS_S1P(0x77, 0x02)
			DCS_S1P(0x78, 0x02)
			DCS_S1P(0x79, 0x0E)
			DCS_S1P(0x7A, 0x01)
			DCS_S1P(0x7B, 0x00)
			DCS_S1P(0x7C, 0x0B)
			DCS_S1P(0x7D, 0x0D)
			DCS_S1P(0x7E, 0xA5)
			DCS_S1P(0x7F, 0xA4)

			DCS_S1P(0x80, 0x63)
			DCS_S1P(0x81, 0x61)
			DCS_S1P(0x82, 0x02)
			DCS_S1P(0x83, 0x5F)
			DCS_S1P(0x84, 0x5D)
			DCS_S1P(0x85, 0x5B)
			DCS_S1P(0x86, 0x59)
			DCS_S1P(0x87, 0x97)
			DCS_S1P(0x88, 0x95)
			DCS_S1P(0x89, 0x09)
			DCS_S1P(0x8A, 0x07)
			DCS_S1P(0x8B, 0x02)
			DCS_S1P(0x8C, 0x02)
			DCS_S1P(0x8D, 0x02)
			DCS_S1P(0x8E, 0x02)

			DCS_S1P(0xA0, 0x35)
			DCS_S1P(0xA1, 0x00)
			DCS_S1P(0xA2, 0x00)
			DCS_S1P(0xA3, 0x00)
			DCS_S1P(0xA4, 0x00)
			DCS_S1P(0xA5, 0x10)
			DCS_S1P(0xA6, 0x08)
			DCS_S1P(0xA7, 0x00)
			DCS_S1P(0xA8, 0x00)
			DCS_S1P(0xA9, 0x00)
			DCS_S1P(0xAA, 0x00)
			DCS_S1P(0xAB, 0x00)
			DCS_S1P(0xAC, 0x00)
			DCS_S1P(0xAD, 0x00)
			DCS_S1P(0xAE, 0xFF)
			DCS_S1P(0xAF, 0x00)

			DCS_S1P(0xB0, 0x00)

			PAGE(2)
			DCS_S1P(0x0A, 0x1D)
			DCS_S1P(0x0F, 0x1D)
			DCS_S1P(0x10, 0x23)
			DCS_S1P(0x11, 0x22)
			DCS_S1P(0x12, 0x22)
			DCS_S1P(0x13, 0x51)
			DCS_S1P(0x40, 0x00)
			DCS_S1P(0x08, 0x11)

			21 0xA0 0x00 0x1F 0x2E 0x14 0x1B 0x2D 0x20 0x1F 0x98 0x1C 0x29 0x85 0x1B 0x1C 0x51 0x27 0x2A 0x51 0x5F 0x2E
			21 0xC0 0x00 0x1F 0x2E 0x14 0x1B 0x2D 0x20 0x1F 0x98 0x1C 0x29 0x85 0x1B 0x1C 0x51 0x27 0x2A 0x51 0x5F 0x2E

			PAGE(4)
			DCS_S1P(0x5D, 0x83)	/* 7B */
			DCS_S1P(0x5E, 0x83)	/* 7B */
			DCS_S1P(0x60, 0x46)	/* VCOM1 69 */
			DCS_S1P(0x62, 0x46)	/* VCOM2 65 */
			DCS_S1P(0x82, 0x38)
			DCS_S1P(0x84, 0x38)
			DCS_S1P(0x86, 0x20)
			DCS_S1P(0x66, 0x04)
			DCS_S1P(0xC1, 0x70)
			DCS_S1P(0x70, 0x60)
			DCS_S1P(0x71, 0x00)

			PAGE(5)
			DCS_S1P(0xB6, 0x03)
			DCS_S1P(0x22, 0x32)
			DCS_S1P(0x5B, 0x33)
			DCS_S1P(0x6C, 0x10)
			DCS_S1P(0x77, 0x03)
			DCS_S1P(0x7B, 0x02)

			PAGE(1)
			DCS_S1P(0xF0, 0x00)
			DCS_S1P(0xF1, 0x78)

			PAGE(0)
			DCS_S1P(0x36, 0x08)
			DCS_S1P(0x35, 0x00)

			DCS_S0P(0x11)	/* Exit sleep */
			DELAY(200)
			DCS_S0P(0x29)	/* MIPI_DCS_SET_DISPLAY_ON */
			DELAY(40)
		>;
		mipi-cmds-disable = /bits/ 8 <
			DCS_S0P(0x28)		/* MIPI_DCS_SET_DISPLAY_OFF */
			DELAY(20)
			DCS_S0P(0x10)		/* Enter sleep */
		>;
		mode-video-hbp-disable;
		mode-video-hfp-disable;
		mode-video-hsa-disable;
	};
};
