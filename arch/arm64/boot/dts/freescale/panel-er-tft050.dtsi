#include <dt-bindings/display/simple_panel_mipi_cmds.h>

/* TC358767: mipi to rgb bridge */
/*
 * 54-66 fps, 800 x 480
 * hsync width >=1, hbp 2-126, hfp >=2,  Hsync+hbp+hfp >= 2Us, if pclk is 40MHz, Hsync+hbp+hfp >= 80 cycles
 * vsync width 1-126, vbp 1-126, vfp 1-255, pixel clk 16.6 - 41.7 MHz
 * Chip 0f or 68 is the Toshiba TC358767
 * PLLD_REF should be 13, 26, 19.2, or 38.4 MHz
 * Hardware says DP PLL ref is DSI_CLK/2/7 so
 * x14 = DSI_CLK should be 182 MHz, 364 MHz, 268.8 MHz, or 537.6MHz
 * x18 = DSI_CLK should be 234 MHz, 468 MHz, 345.6 MHz, or 691.2MHz
 */
/ {
	aliases {
		mipi_cmds_er_tft050 = &mipi_cmds_er_tft050;
		pinctrl_er_tft050 = &pinctrl_mipi_er_tft050;
	};

	mipi_cmds_er_tft050: mipi-cmds-er-tft050 {
		alias = <&mipi_cmds_er_tft050>;
		aliasp = <&pinctrl_mipi_er_tft050>;
		delay-prepare = <130>;
#if 0
#if LANES==1
		min-hs-clock-multiple = <24>;	/* HSCLK(ddr)=384MHz = 32(PCLK)*12, 1 lane */
#elif LANES==2
		min-hs-clock-multiple = <12>;	/* HSCLK(ddr)=192MHz = 32(PCLK)*6, 2 lanes */
#else
		min-hs-clock-multiple = <6>;	/* HSCLK(ddr)=96MHz = 32(PCLK)*3, 4 lanes */
#endif
#endif

#if 0
		mipi-dsi-multiple = <26000000>;	/* needed for display port, but we don't use */
#endif
		i2c-address = <0x68>;
		i2c-bus = <&tc358767_bus>;
		i2c-cmds-enable = /bits/ 8 <
#if 0
/* 2 lanes */
i2c dev 7
mw.l 0x40100000 0x2 ;i2c write 0x40100000 68 908.2 4 -s
mw.l 0x40100000 0x210; i2c write 0x40100000 68 918.2 4 -s
mw.l 0x40100000 0x00138505; i2c write 0x40100000 68 914.2 4 -s
mw.l 0x40100000 0x00050006; i2c write 0x40100000 68 13c.2 4 -s
mw.l 0x40100000 4; i2c write 0x40100000 68 114.2 4 -s
mw.l 0x40100000 0x7 ;i2c write 0x40100000 68 164.2 4 -s
mw.l 0x40100000 0x7 ;i2c write 0x40100000 68 168.2 4 -s
mw.l 0x40100000 0x7 ;i2c write 0x40100000 68 16c.2 4 -s
mw.l 0x40100000 0x7 ;i2c write 0x40100000 68 170.2 4 -s
#endif
			GEN_L5P(0x08,0x09, 0x02,0x00,0x00,0x00)	/* PXL_PLLCTRL(0x0908) - bypass 0x00000002  */
			GEN_L5P(0x18,0x09, 0x10,0x02,0x00,0x00)	/* SYS_PLLPARAM(0x0918) - 0x00000210  */
			/*
			 * PCLK = ref * FBD / (EXT_PREV_DIV * PRE_DIV * EXT_POST_DIV)
			 *      = (99MHz/1 or 198/2 or 396/4) * 5 /(1 * 5 * 3) = 33 MHz
			 */
			S_IF_1_LANE  GEN_L5P(0x14,0x09, 0x05,0xc5,0x13,0x00)	/* PXL_PLLPARAM(0x0914) - 0x0013c505  */
			S_IF_2_LANES GEN_L5P(0x14,0x09, 0x05,0x85,0x13,0x00)	/* PXL_PLLPARAM(0x0914) - 0x00138505  */
			S_IF_4_LANES GEN_L5P(0x14,0x09, 0x05,0x45,0x13,0x00)	/* PXL_PLLPARAM(0x0914) - 0x00134505  */

			S_IF_1_LANE  GEN_L5P(0x3c,0x01, 0x0e,0x00,0x0b,0x00)	/* PPI_TX_RX_TA(0x013c) 0x000b000e */
			S_IF_1_LANE  GEN_L5P(0x14,0x01, 0x09,0x00,0x00,0x00)	/* PPI_LPTXTIMECNT(0x0114) - 0x9  */
			S_IF_1_LANE  GEN_L5P(0x64,0x01, 0x12,0x00,0x00,0x00)	/* PPI_D0S_CLRSIPOCOUNT(0x0164) - 0x12, default 0x19  */
			S_IF_1_LANE  GEN_L5P(0x68,0x01, 0x12,0x00,0x00,0x00)	/* PPI_D1S_CLRSIPOCOUNT(0x0168) - 0x12  */
			S_IF_1_LANE  GEN_L5P(0x6c,0x01, 0x12,0x00,0x00,0x00)	/* PPI_D2S_CLRSIPOCOUNT(0x016c) - 0x12  */
			S_IF_1_LANE  GEN_L5P(0x70,0x01, 0x12,0x00,0x00,0x00)	/* PPI_D3S_CLRSIPOCOUNT(0x0170) - 0x12  */
			/* 1 data lane, 1 clock lane*/
			S_IF_1_LANE  GEN_L5P(0x34,0x01, 0x03,0x00,0x00,0x00)	/* PPI_LANEENABLE(0x0134) - 0x03  */
			/* 1 data lane, 1 clock lane*/
			S_IF_1_LANE  GEN_L5P(0x10,0x02, 0x03,0x00,0x00,0x00)	/* DSI_LANEENABLE(0x0210) - 0x03  */

			S_IF_2_LANES GEN_L5P(0x3c,0x01, 0x06,0x00,0x05,0x00)	/* PPI_TX_RX_TA(0x013c) 0x00050006 */
			S_IF_2_LANES GEN_L5P(0x14,0x01, 0x04,0x00,0x00,0x00)	/* PPI_LPTXTIMECNT(0x0114) - 0x4  */
			S_IF_2_LANES GEN_L5P(0x64,0x01, 0x07,0x00,0x00,0x00)	/* PPI_D0S_CLRSIPOCOUNT(0x0164) - 0x07, default 0x19  */
			S_IF_2_LANES GEN_L5P(0x68,0x01, 0x07,0x00,0x00,0x00)	/* PPI_D1S_CLRSIPOCOUNT(0x0168) - 0x07  */
			S_IF_2_LANES GEN_L5P(0x6c,0x01, 0x07,0x00,0x00,0x00)	/* PPI_D2S_CLRSIPOCOUNT(0x016c) - 0x07  */
			S_IF_2_LANES GEN_L5P(0x70,0x01, 0x07,0x00,0x00,0x00)	/* PPI_D3S_CLRSIPOCOUNT(0x0170) - 0x07  */
			/* 2 data lanes, 1 clock lane*/
			S_IF_2_LANES GEN_L5P(0x34,0x01, 0x07,0x00,0x00,0x00)	/* PPI_LANEENABLE(0x0134) - 0x07  */
			/* 2 data lanes, 1 clock lane*/
			S_IF_2_LANES GEN_L5P(0x10,0x02, 0x07,0x00,0x00,0x00)	/* DSI_LANEENABLE(0x0210) - 0x07  */

			S_IF_4_LANES GEN_L5P(0x3c,0x01, 0x02,0x00,0x01,0x00)	/* PPI_TX_RX_TA(0x013c) 0x00010002 */
			S_IF_4_LANES GEN_L5P(0x14,0x01, 0x01,0x00,0x00,0x00)	/* PPI_LPTXTIMECNT(0x0114) - 0x1  */
			S_IF_4_LANES GEN_L5P(0x64,0x01, 0x00,0x00,0x00,0x00)	/* PPI_D0S_CLRSIPOCOUNT(0x0164) - 0x00, default 0x19  */
			S_IF_4_LANES GEN_L5P(0x68,0x01, 0x00,0x00,0x00,0x00)	/* PPI_D1S_CLRSIPOCOUNT(0x0168) - 0x00  */
			S_IF_4_LANES GEN_L5P(0x6c,0x01, 0x00,0x00,0x00,0x00)	/* PPI_D2S_CLRSIPOCOUNT(0x016c) - 0x00  */
			S_IF_4_LANES GEN_L5P(0x70,0x01, 0x00,0x00,0x00,0x00)	/* PPI_D3S_CLRSIPOCOUNT(0x0170) - 0x00  */
			/* 4 data lanes, 1 clock lane*/
			S_IF_4_LANES GEN_L5P(0x34,0x01, 0x1f,0x00,0x00,0x00)	/* PPI_LANEENABLE(0x0134) - 0x1f  */
			/* 4 data lanes, 1 clock lane*/
			S_IF_4_LANES GEN_L5P(0x10,0x02, 0x1f,0x00,0x00,0x00)	/* DSI_LANEENABLE(0x0210) - 0x1f  */
			GEN_L5P(0x18,0x09, 0x10,0x02,0x00,0x00)	/* SYS_PLLPARAM(0x0918) - 0x00000210  */
			DELAY(10)
			GEN_L5P(0x08,0x09, 0x05,0x00,0x00,0x00)	/* PXL_PLLCTRL(0x0908) - 0x00000005  */
			DELAY(10)
			GEN_L5P(0x00,0x08, 0x00,0x11,0x00,0x00)	/* DP_PHY_CTRL(0x0800) - 0x00001100  */
			GEN_L5P(0xa0,0x06, 0x82,0x30,0x00,0x00)	/* DP0_SRCCTRL(0x06a0)  0x00003082  */
			GEN_L5P(0x48,0x04, 0x8e,0x00,0x00,0x00)	/* POCTRL(0x0448) - 0x0000008e  */
			GEN_L5P(0x00,0x09, 0x02,0x00,0x00,0x00)	/* DP0_PLLCTRL(0x0900) - bypass - 0x00000002  */
#if 0
			GEN_L5P(0x00,0x09, 0x05,0x00,0x00,0x00)	/* DP0_PLLCTRL(0x0900) - 0x00000005  */
			DELAY(10)
			GEN_L5P(0x04,0x09, 0x00,0x00,0x00,0x00)	/* DP1_PLLCTRL(0x0904) - 0x00000000  */
#endif

#if 0
			S_IF_1_LANE  GEN_L5P(0x10,0x01, 0x31,0x8e,0x00,0x00)	/* PPI_LININITCNT(0x0110) - 0x8e31  */
			S_IF_2_LANES GEN_L5P(0x10,0x01, 0x19,0x47,0x00,0x00)	/* PPI_LININITCNT(0x0110) - 0x4719  */
#endif
#if 0
		>;
		mipi-cmds-enable = /bits/ 8 <
#endif
			GEN_L5P(0x04,0x01, 0x01,0x00,0x00,0x00)	/* PPI_STARTPPI(0x0104) - 0x1  */
			GEN_L5P(0x04,0x02, 0x01,0x00,0x00,0x00)	/* DSI_STARTDSI(0x0204) - 0x1  */

			GEN_L5P(0x50,0x04, 0x00,0x01,0x00,0x03)	/* VPCTRL(0x0450) - 0x03000100 */

			S_BUF_CONST(0, 144, 0x54, 0x04, 0x00, 0x00) /* HTIM01(0x0454)-VTIM01(0x0460) */
			S_BUF_SET(S_HSYNC, 16, 9, 0)
			S_BUF_SET(S_HBP, 32, 9, 0)
			S_BUF_SET(S_HACTIVE, 48, 11, 0)
			S_BUF_SET(S_HFP, 64, 9, 0)
			S_BUF_SET(S_VSYNC, 80, 8, 0)
			S_BUF_SET(S_VBP, 96, 8, 0)
			S_BUF_SET(S_VACTIVE, 112, 11, 0)
			S_BUF_SET(S_VFP, 128, 8, 0)
			GEN_BUF(18)

			GEN_L5P(0x64,0x04, 0x01,0x00,0x00,0x00)	/* VFUEN0(0x0464) - 0x1  */
			GEN_L5P(0x10,0x05, 0x01,0x00,0x00,0x00)	/* SYSCTRL(0x0510) - 0x1  */
		>;
		mipi-cmds-disable = /bits/ 8 <
			GEN_L5P(0xa0,0x06, 0x01,0x00,0x00,0x00)	/* DP0CTRL(0x0600)  0x00000001  */
			DELAY(20)
			GEN_L5P(0xa0,0x06, 0x00,0x00,0x00,0x00)	/* DP0CTRL(0x0600)  0x00000000  */
			DELAY(20)
		>;
		mode-video-hbp-disable;
		mode-video-hfp-disable;
		mode-video-hsa-disable;
	};
};
