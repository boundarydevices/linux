// SPDX-License-Identifier: (GPL-2.0 OR MIT)
/*
 * Copyright 2023 Boundary Devices LLC
 */

#define REV20
#include "imx8mp-nitrogen8mp-m4.dts"

/ {
	model = "Boundary i.MX 8M Plus Nitrogen8MP Rev20 board (M-core)";
	compatible = "boundary,imx8mp-nitrogen8mp_r20-m4", "fsl,imx8mp";
};
