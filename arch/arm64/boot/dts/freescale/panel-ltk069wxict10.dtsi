#include <dt-bindings/display/simple_panel_mipi_cmds.h>

/ {
	aliases {
		mipi_cmds_ltk069wxict10 = &mipi_cmds_ltk069wxict10;
		pinctrl_ltk069wxict10 = &pinctrl_mipi_ltk069wxict10;
	};

	mipi_cmds_ltk069wxict10: mipi-cmds-ltk069wxict10 {
		alias = <&mipi_cmds_ltk069wxict10>;
		aliasp = <&pinctrl_mipi_ltk069wxict10>;
		mipi-cmds-enable = /bits/ 8 <
			DELAY(150)
			GEN_L2P(0xF0,0x5A,0x59)
			GEN_L2P(0xF1,0xA5,0xA6)
			0x8f
			  0xB0 0x54 0x32 0x23 0x45 0x44 0x44 0x44 0x44 0x9F 0x00 0x01 0x9F 0x00 0x01
			0x8b
			  0xB1 0x32 0x84 0x02 0x83 0x29 0x06 0x06 0x72 0x06 0x06
			GEN_S1P(0xB2,0x73)
			0x95
			  0xB3 0x0B 0x09 0x13 0x11 0x0F 0x0D 0x00 0x00 0x00 0x03 0x00 0x03 0x03 0x03 0x03
			  0x03 0x03 0x03 0x05 0x07
			0x95
			  0xB4 0x0A 0x08 0x12 0x10 0x0E 0x0C 0x00 0x00 0x00 0x03 0x00 0x03 0x03 0x03 0x03
			  0x03 0x03 0x03 0x04 0x06
			GEN_L2P(0xB6,0x13,0x13)
			GEN_L4P(0xB8,0xB4,0x43,0x02,0xCC)
			GEN_L4P(0xB9,0xA5,0x20,0xFF,0xC8)
#if 0
			GEN_L2P(0xBA,0x88,0x23)
#endif
			GEN_L2P(0xBA,0x27,0x63)
			0x8b
			  0xBD 0x43 0x0E 0x0E 0x50 0x50 0x29 0x10 0x03 0x44 0x03
			0x89
			  0xC1 0x00 0x0C 0x16 0x04 0x00 0x30 0x10 0x04
			GEN_L2P(0xC2,0x21,0x81)
			GEN_L2P(0xC3,0x02,0x30)
			GEN_L2P(0xC7,0x25,0x6A)
			0xa7
			  0xC8 0x7C 0x68 0x59 0x4E 0x4B 0x3C 0x41 0x2B 0x44 0x43 0x43 0x60 0x4E 0x55 0x47
			  0x44 0x38 0x27 0x06 0x7C 0x68 0x59 0x4E 0x4B 0x3C 0x41 0x2B 0x44 0x43 0x43 0x60
			  0x4E 0x55 0x47 0x44 0x38 0x27 0x06	//GAMMA2.2
#if 0
			0xa7
			  0xC8 0x7C 0x66 0x56 0x4A 0x46 0x37 0x3B 0x24 0x3D 0x3C 0x3A 0x56 0x42 0x48 0x39
			  0x38 0x2C 0x17 0x06 0x7C 0x66 0x56 0x4A 0x46 0x37 0x3B 0x24 0x3D 0x3C 0x3A 0x56
			  0x42 0x48 0x39 0x38 0x2C 0x17 0x06	//GAMMA2.5
			0xa7
			  0xC8 0x7C 0x69 0x5B 0x50 0x4E 0x40 0x46 0x31 0x4A 0x49 0x49 0x67 0x56 0x5E 0x51
			  0x4E 0x41 0x2F 0x06 0x7C 0x69 0x5B 0x50 0x4E 0x40 0x46 0x31 0x4A 0x49 0x49 0x67
			  0x56 0x5E 0x51 0x4E 0x41 0x2F 0x06	//GAMMA2.0
			0xa7
			  0xC8 0x7C 0x6D 0x60 0x56 0x54 0x47 0x4c 0x37 0x50 0x4e 0x4e 0x6d 0x5c 0x66 0x59
			  0x56 0x4A 0x36 0x06 0x7C 0x6D 0x60 0x56 0x54 0x47 0x4c 0x37 0x50 0x4e 0x4e 0x6d
			  0x5c 0x66 0x59 0x56 0x4A 0x36 0x06	//GAMMA1.8
			0xa7
			  0xC8 0x7C 0x6e 0x62 0x59 0x58 0x4b 0x52 0x3d 0x57 0x56 0x56 0x75 0x66 0x71 0x66
			  0x64 0x55 0x44 0x06 0x7C 0x6e 0x62 0x59 0x58 0x4b 0x52 0x3d 0x57 0x56 0x56 0x75
			  0x66 0x71 0x66 0x64 0x55 0x44 0x06	//GAMMA1.6
#endif
			0x87
			  0xD4 0x00 0x00 0x00 0x32 0x04 0x51
			GEN_L2P(0xF1,0x5A,0x59)
			GEN_L2P(0xF0,0xA5,0xA6)
			GEN_S1P(0x36,0x14)
			GEN_S1P(0x35,0x00)
			DCS_S0P(0x11)		/* Exit sleep */
			DELAY(120)
			DCS_S0P(0x29)		/* MIPI_DCS_SET_DISPLAY_ON */
			DELAY(20)
		>;
		mipi-cmds-disable = /bits/ 8 <
			DCS_S0P(0x28)		/* MIPI_DCS_SET_DISPLAY_OFF */
			DELAY(20)
			DCS_S0P(0x10)		/* Enter sleep */
		>;
		mipi-delay-between-cmds = <1>;
		mode-video-hfp-disable;
		mode-video-hsa-disable;
	};
};
