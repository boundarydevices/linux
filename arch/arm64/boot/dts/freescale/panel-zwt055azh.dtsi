#include <dt-bindings/display/simple_panel_mipi_cmds.h>

/ {
	aliases {
		mipi_cmds_zwt055azh = &mipi_cmds_zwt055azh;
		pinctrl_zwt055azh = &pinctrl_mipi_zwt055azh;
	};

	/* hx8399c controller */
	mipi_cmds_zwt055azh: mipi-cmds-zwt055azh {
		alias = <&mipi_cmds_zwt055azh>;
		aliasp = <&pinctrl_mipi_zwt055azh>;
		delay-prepare = <100>;
		delay-unprepare = <2>;
		mipi-cmds-enable = /bits/ 8 <
			DELAY(2)
			/* SET EXTC */
			DCS_L3P(0xB9,0xFF,0x83,0x99)
			/* SET POWER */
			0x10
			  0xB1 0x02 0x04 0x6C 0x8C 0x01 0x32 0x33 0x11 0x11 0x52 0x57 0x56 0x73 0x02 0x02
			/* SET DISPLAY */
			0x10
			  0xB2 0x00 0x80 0x80 0xAE 0x05 0x07 0x5A 0x11 0x10 0x10 0x00 0x1E 0x70 0x03 0xD4
			/* SET DISPLAY */
			0x0c
			  0xB2 0x00 0x80 0x80 0xAE 0x05 0x07 0x5A 0x11 0x10 0x10 0x00
			/* SET CYC */
			0x2d
			  0xB4 0x00 0xFF 0x56 0x3C 0x00 0xAB 0x00 0x00 0x04 0x00 0x00 0x02 0x00 0x2A 0x02
			  0x07 0x09 0x21 0x03 0x01 0x00 0x00 0xAC 0x84 0x56 0x3C 0x00 0xAB 0x00 0x00 0x04
			  0x00 0x00 0x02 0x00 0x2A 0x02 0x07 0x09 0x01 0x00 0x00 0xAC 0x12
			/* SET GIP_0 */
			0x22
			  0xD3 0x00 0x00 0x01 0x01 0x00 0x00 0x10 0x10 0x00 0x00 0x03 0x00 0x03 0x00 0x07
			  0x88 0x07 0x88 0x00 0x00 0x00 0x00 0x00 0x24 0x02 0x05 0x05 0x03 0x00 0x00 0x00
			  0x05 0x40
			/* SET GIP_1 */
			0x21
			  0xD5 0x20 0x20 0x19 0x19 0x18 0x18 0x02 0x03 0x00 0x01 0x24 0x24 0x18 0x18 0x18
			  0x18 0x24 0x24 0x00 0x00 0x00 0x00 0x00 0x00 0x00 0x00 0x2F 0x2F 0x30 0x30 0x31
			  0x31
			/* SET GIP_1 */
			0x21
			  0xD6 0x24 0x24 0x18 0x18 0x19 0x19 0x01 0x00 0x03 0x02 0x24 0x24 0x18 0x18 0x18
			  0x18 0x20 0x20 0x40 0x40 0x40 0x40 0x40 0x40 0x40 0x40 0x2F 0x2F 0x30 0x30 0x31
			  0x31
			/* SET GIP_1 */
			0x11
			  0xD8 0xAA 0xAA 0xAA 0xAA 0xAA 0xAA 0xAA 0xAA 0xAA 0xBA 0xAA 0xAA 0xAA 0xBA 0xAA
			  0xAA
			/* Set Bank */
			DCS_S1P(0xBD,0x01)
			/* SET GIP_1 */
			0x11
			  0xD8 0x00 0x00 0x00 0x00 0x00 0x00 0x00 0x00 0x82 0xEA 0xAA 0xAA 0x82 0xEA 0xAA
			  0xAA
			/* Set Bank */
			DCS_S1P(0xBD,0x02)
			/* SET GIP_1 */
			0x09
			  0xD8 0xFF 0xFF 0xC0 0x3F 0xFF 0xFF 0xC0 0x3F
			/* Set Bank */
			DCS_S1P(0xBD,0x00)
			/* SET GAMMA */
			0x37
			  0xE0 0x15 0x1F 0x27 0x1F 0x45 0x4A 0x54 0x4C 0x52 0x59 0x5F 0x63 0x67 0x6C 0x73
			  0x78 0x7B 0x84 0x8A 0x95 0x8C 0x9F 0xA6 0x58 0x55 0x61 0x6C 0x15 0x1F 0x27 0x1F
			  0x45 0x4A 0x54 0x4C 0x52 0x59 0x5F 0x63 0x66 0x6D 0x73 0x77 0x7B 0x84 0x88 0x94
			  0x8B 0x9E 0xA5 0x57 0x54 0x61 0x6C
			/* SET PANEL */
			DCS_S1P(0xCC,0x08)
			/* SET VCOM */
			DCS_L2P(0xB6,0x7D,0x7D)
			/* SET PANEL */
			DCS_S1P(0xD2,0x33)

			DELAY(10)
			DCS_S0P(0x11)		/* Exit sleep */
			DELAY(120)
			DCS_S1P(0xD0,0x39)
			DCS_S0P(0x29)		/* MIPI_DCS_SET_DISPLAY_ON */
			DELAY(20)
		>;
		mipi-cmds-disable = /bits/ 8 <
			DCS_S0P(0x28)		/* MIPI_DCS_SET_DISPLAY_OFF */
			DELAY(50)
			DCS_S0P(0x10)		/* Enter sleep */
			DELAY(100)
		>;
		mode-video-hfp-disable;
		mode-video-hsa-disable;
	};
};
