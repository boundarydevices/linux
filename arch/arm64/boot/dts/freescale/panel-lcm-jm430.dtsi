#include <dt-bindings/display/simple_panel_mipi_cmds.h>

/* TC358762: mipi to rgb bridge */
/ {
	mipi_cmds_lcm_jm430: mipi-cmds-lcm-jm430 {
		mipi-cmds-enable = /bits/ 8 <
			DELAY(1)

			/* 1 data lane, 1 clock lane*/
			S_IF_1_LANE  GEN_L5P(0x10,0x02, 0x03,0x00,0x00,0x00)	/* TC_DSI_LANEENABLE - 0x03  */
			/* 2 data lanes, 1 clock lane*/
			S_IF_2_LANES GEN_L5P(0x10,0x02, 0x07,0x00,0x00,0x00)	/* TC_DSI_LANEENABLE - 0x07  */
			GEN_L5P(0x44,0x01, 0x00,0x00,0x00,0x00)	/* TC_PPI_D0S_ATMR - 0x0  */
			GEN_L5P(0x48,0x01, 0x00,0x00,0x00,0x00)	/* TC_PPI_D1S_ATMR - 0x0  */
			GEN_L5P(0x64,0x01, 0x05,0x00,0x00,0x00)	/* TC_PPI_D0S_CLRSIPOCOUNT - 0x5  */
			GEN_L5P(0x68,0x01, 0x05,0x00,0x00,0x00)	/* TC_PPI_D1S_CLRSIPOCOUNT - 0x5  */
			GEN_L5P(0x14,0x01, 0x03,0x00,0x00,0x00)	/* TC_LPTXTIMECNT - 0x3  */
			GEN_L5P(0x04,0x02, 0x01,0x00,0x00,0x00)	/* TC_DSI_STARTDSI - 0x1  */
			/* TC358762 errata needs mipi clock >=99.992 Mhz for /2 to work. */
			/* HS byte clock divider(or PLL) [11:8] */
			S_IF_1_LANE GEN_L5P(0x64,0x04, 0x00,0x04,0x00,0x00)	/* TC_SYSCTRL - 0x0400 (divide by 3) */
			/*
			 * For 2 Lane RGB24, HS byte clock must be 2x pixel clock,
			 * Cannot specify 1.5x as divisor must be 1, 2, or 3.
			 */
			S_IF_2_LANES GEN_L5P(0x64,0x04, 0x00,0x02,0x00,0x00)	/* TC_SYSCTRL - 0x0200 (divide by 2) */

			GEN_L5P(0x14,0x04, 0x77,0x00,0x00,0x00)	/* TC_PXLFMT - 0x77  */
#if 0
			/* VTGEN off */
			GEN_L5P(0x20,0x04, 0x50,0x01,0x10,0x00)	/* TC_LCDCTRL_PORT - 0x100150  */
#else
			/* VTGEN on */
			GEN_L5P(0x20,0x04, 0x52,0x01,0x10,0x00)	/* TC_LCDCTRL_PORT - 0x100152  */
#if 0
#define HSYNC	0x02	/* Only used for test image */
#define HBP	0x28
			GEN_L5P(0x24,0x04, HSYNC,0x00,HBP,0x00)	/* TC_HSR_HBPR - 0x280002  */
			GEN_L5P(0x28,0x04, 0xe0,0x01,0x04,0x00)	/* TC_HDISPR_HFPR - 0x0401e0  */
			GEN_L5P(0x2c,0x04, 0x01,0x00,0x08,0x00)	/* TC_VSR_VBPR - 0x080001  */
			GEN_L5P(0x30,0x04, 0x10,0x01,0x08,0x00)	/* TC_VDISPR_VFPR - 0x080110  */
#else
			S_BUF_CONST(0, 48, 0x24, 0x04, 0x00, 0x00)
			S_BUF_SET(S_HSYNC, 16, 9, 0)
			S_BUF_SET(S_HBP, 32, 9, 0)
			GEN_BUF(6)

			S_BUF_CONST(0, 48, 0x28, 0x04, 0x00, 0x00)
			S_BUF_SET(S_HACTIVE, 16, 11, 0)
			S_BUF_SET(S_HFP, 32, 9, 0)
			GEN_BUF(6)

			S_BUF_CONST(0, 48, 0x2c, 0x04, 0x00, 0x00)
			S_BUF_SET(S_VSYNC, 16, 8, 0)
			S_BUF_SET(S_VBP, 32, 8, 0)
			GEN_BUF(6)

			S_BUF_CONST(0, 48, 0x30, 0x04, 0x00, 0x00)
			S_BUF_SET(S_VACTIVE, 16, 11, 0)
			S_BUF_SET(S_VFP, 32, 8, 0)
			GEN_BUF(6)
#endif
#endif
			GEN_L5P(0x34,0x04, 0x01,0x00,0x00,0x00)	/* TC_VFUEN - 0x01  */
			GEN_L5P(0x04,0x01, 0x01,0x00,0x00,0x00)	/* TC_PPI_STARTPPI - 0x1  */
#if 0
			MRPS(3)
			GEN_READ4(0x20,0x04, 0x52,0x01,0x10,0x00)
			GEN_READ4(0x24,0x04, 0x18,0x00,0x16,0x00)
			GEN_READ4(0x28,0x04, 0x20,0x03,0xd0,0x00)
			GEN_READ4(0x2c,0x04, 0x08,0x00,0x0f,0x00)
			GEN_READ4(0x30,0x04, 0xe0,0x01,0x16,0x00)
#endif
#if 0
			GEN_READ4(0xa0,0x04, 0x00,0x62,0x00,0x00) /* ChipID */
#endif
#if 0
			DCS_S0P(0x11)		/* Exit sleep */
			DELAY(5)
#endif
		>;
#if 0
		mipi-cmds-disable = /bits/ 8 <
			DCS_S0P(0x10)		/* Enter sleep */
		>;
		min-hs-clock-multiple = <16>;
#endif
	};
};
