#include <dt-bindings/display/simple_panel_mipi_cmds.h>

/* TC358867: mipi to rgb bridge */
/*
 * 54-66 fps, 480 x 864
 * hsync width >=1, hbp 2-126, hfp >=2,  Hsync+hbp+hfp >= 2Us, if pclk is 40MHz, Hsync+hbp+hfp >= 80 cycles
 * vsync width 1-126, vbp 1-126, vfp 1-255, pixel clk 16.6 - 41.7 MHz
 * Chip 0f is the Toshiba TC35876x
 * Chip 2F is the i2c to SPI adaptor NXP sc18is602B
 * Chip 14 is the GT911 touch screen
 * PLLD_REF should be 13, 26, 19.2, or 38.4 MHz
 * Hardware says DP PLL ref is DSI_CLK/2/7 so
 * x14 = DSI_CLK should be 182 MHz, 364 MHz, 268.8 MHz, or 537.6MHz
 * x18 = DSI_CLK should be 234 MHz, 468 MHz, 345.6 MHz, or 691.2MHz
 */
/ {
	aliases {
		mipi_cmds_dmt050wvnxcmi = &mipi_cmds_dmt050wvnxcmi;
#if 0
		pinctrl_dmt050wvnxcmi = &pinctrl_mipi_dmt050wvnxcmi;
#endif
	};

#define LANES 4
	mipi_cmds_dmt050wvnxcmi: mipi-cmds-dmt050wvnxcmi {
		a1 = <&mipi_cmds_dmt050wvnxcmi>;
		delay-prepare = <130>;
#if 0
#if LANES==1
		min-hs-clock-multiple = <24>;	/* HSCLK(ddr)=384MHz = 32(PCLK)*12, 1 lane */
#elif LANES==2
		min-hs-clock-multiple = <12>;	/* HSCLK(ddr)=192MHz = 32(PCLK)*6, 2 lanes */
#else
		min-hs-clock-multiple = <6>;	/* HSCLK(ddr)=96MHz = 32(PCLK)*3, 4 lanes */
#endif
#endif

#if 0
		mipi-dsi-multiple = <26000000>;	/* needed for display port, but we don't use */
#endif
		i2c-address = <0x0f>;
#ifndef TC358867_I2C_BUS
#error Please define TC358867_I2C_BUS
#endif
		i2c-bus = TC358867_I2C_BUS;
		i2c-cmds-enable = /bits/ 8 <
			GEN_L5P(0x08,0x09, 0x02,0x00,0x00,0x00)	/* PXL_PLLCTRL - bypass 0x00000002  */
			GEN_L5P(0x18,0x09, 0x10,0x02,0x00,0x00)	/* SYS_PLLPARAM - 0x00000210  */
			S_IF_1_LANE  GEN_L5P(0x14,0x09, 0x05,0xc5,0x13,0x00)	/* PXL_PLLPARAM - 0x0013c505  */
			S_IF_2_LANES GEN_L5P(0x14,0x09, 0x05,0x85,0x13,0x00)	/* PXL_PLLPARAM - 0x00138505  */
			S_IF_4_LANES GEN_L5P(0x14,0x09, 0x05,0x45,0x13,0x00)	/* PXL_PLLPARAM - 0x00134505  */

			S_IF_1_LANE  GEN_L5P(0x3c,0x01, 0x0e,0x00,0x0b,0x00)	/* PPI_TX_RX_TA: 0x000b000e */
			S_IF_1_LANE  GEN_L5P(0x14,0x01, 0x09,0x00,0x00,0x00)	/* PPI_LPTXTIMECNT - 0x9  */
			S_IF_1_LANE  GEN_L5P(0x64,0x01, 0x12,0x00,0x00,0x00)	/* PPI_D0S_CLRSIPOCOUNT - 0x12, default 0x19  */
			S_IF_1_LANE  GEN_L5P(0x68,0x01, 0x12,0x00,0x00,0x00)	/* PPI_D1S_CLRSIPOCOUNT - 0x12  */
			S_IF_1_LANE  GEN_L5P(0x6c,0x01, 0x12,0x00,0x00,0x00)	/* PPI_D2S_CLRSIPOCOUNT - 0x12  */
			S_IF_1_LANE  GEN_L5P(0x70,0x01, 0x12,0x00,0x00,0x00)	/* PPI_D3S_CLRSIPOCOUNT - 0x12  */
			/* 1 data lane, 1 clock lane*/
			S_IF_1_LANE  GEN_L5P(0x34,0x01, 0x03,0x00,0x00,0x00)	/* PPI_LANEENABLE - 0x03  */
			/* 1 data lane, 1 clock lane*/
			S_IF_1_LANE  GEN_L5P(0x10,0x02, 0x03,0x00,0x00,0x00)	/* DSI_LANEENABLE - 0x03  */

			S_IF_2_LANES GEN_L5P(0x3c,0x01, 0x06,0x00,0x05,0x00)	/* PPI_TX_RX_TA: 0x00050006 */
			S_IF_2_LANES GEN_L5P(0x14,0x01, 0x04,0x00,0x00,0x00)	/* PPI_LPTXTIMECNT - 0x4  */
			S_IF_2_LANES GEN_L5P(0x64,0x01, 0x07,0x00,0x00,0x00)	/* PPI_D0S_CLRSIPOCOUNT - 0x07, default 0x19  */
			S_IF_2_LANES GEN_L5P(0x68,0x01, 0x07,0x00,0x00,0x00)	/* PPI_D1S_CLRSIPOCOUNT - 0x07  */
			S_IF_2_LANES GEN_L5P(0x6c,0x01, 0x07,0x00,0x00,0x00)	/* PPI_D2S_CLRSIPOCOUNT - 0x07  */
			S_IF_2_LANES GEN_L5P(0x70,0x01, 0x07,0x00,0x00,0x00)	/* PPI_D3S_CLRSIPOCOUNT - 0x07  */
			/* 2 data lanes, 1 clock lane*/
			S_IF_2_LANES GEN_L5P(0x34,0x01, 0x07,0x00,0x00,0x00)	/* PPI_LANEENABLE - 0x07  */
			/* 2 data lanes, 1 clock lane*/
			S_IF_2_LANES GEN_L5P(0x10,0x02, 0x07,0x00,0x00,0x00)	/* DSI_LANEENABLE - 0x07  */

			S_IF_4_LANES GEN_L5P(0x3c,0x01, 0x03,0x00,0x02,0x00)	/* PPI_TX_RX_TA: 0x00020003 */
			S_IF_4_LANES GEN_L5P(0x14,0x01, 0x02,0x00,0x00,0x00)	/* PPI_LPTXTIMECNT - 0x2  */
			S_IF_4_LANES GEN_L5P(0x64,0x01, 0x01,0x00,0x00,0x00)	/* PPI_D0S_CLRSIPOCOUNT - 0x01, default 0x19  */
			S_IF_4_LANES GEN_L5P(0x68,0x01, 0x01,0x00,0x00,0x00)	/* PPI_D1S_CLRSIPOCOUNT - 0x01  */
			S_IF_4_LANES GEN_L5P(0x6c,0x01, 0x01,0x00,0x00,0x00)	/* PPI_D2S_CLRSIPOCOUNT - 0x01  */
			S_IF_4_LANES GEN_L5P(0x70,0x01, 0x01,0x00,0x00,0x00)	/* PPI_D3S_CLRSIPOCOUNT - 0x01  */
			/* 4 data lanes, 1 clock lane*/
			S_IF_4_LANES GEN_L5P(0x34,0x01, 0x1f,0x00,0x00,0x00)	/* PPI_LANEENABLE - 0x1f  */
			/* 4 data lanes, 1 clock lane*/
			S_IF_4_LANES GEN_L5P(0x10,0x02, 0x1f,0x00,0x00,0x00)	/* DSI_LANEENABLE - 0x1f  */
		>;
		mipi-cmds-enable = /bits/ 8 <
#if 0
			GEN_L5P(0x08,0x09, 0x01,0x00,0x00,0x00)	/* PXL_PLLCTRL - 0x00000001  */
			DELAY(1)
			GEN_L5P(0x08,0x09, 0x05,0x00,0x00,0x00)	/* PXL_PLLCTRL - 0x00000005  */
#endif
			GEN_L5P(0xa0,0x06, 0x82,0x30,0x00,0x00)	/* DP0_SRCCTRL  0x00003082  */
			GEN_L5P(0x48,0x04, 0x88,0x00,0x00,0x00)	/* POCTRL - 0x00000088  */
#if 0
			GEN_L5P(0x00,0x09, 0x02,0x00,0x00,0x00)	/* DP0_PLLCTRL - bypass - 0x00000002  */
#endif
#if 0
			GEN_L5P(0x00,0x09, 0x01,0x00,0x00,0x00)	/* DP0_PLLCTRL - 0x00000001  */
			DELAY(1)
			GEN_L5P(0x00,0x09, 0x05,0x00,0x00,0x00)	/* DP0_PLLCTRL - 0x00000005  */
			DELAY(1)
			GEN_L5P(0x04,0x09, 0x00,0x00,0x00,0x00)	/* DP1_PLLCTRL - 0x00000000  */
			DELAY(1)
			GEN_L5P(0x04,0x09, 0x04,0x00,0x00,0x00)	/* DP1_PLLCTRL - 0x00000004  */
#endif
			GEN_L5P(0x18,0x09, 0x10,0x02,0x00,0x00)	/* SYS_PLLPARAM - 0x00000210  */
			GEN_L5P(0x00,0x08, 0x00,0x11,0x00,0x00)	/* DP_PHY_CTRL 0x1100  */

#if 0
			S_IF_1_LANE  GEN_L5P(0x10,0x01, 0x31,0x8e,0x00,0x00)	/* PPI_LININITCNT - 0x8e31  */
			S_IF_2_LANES GEN_L5P(0x10,0x01, 0x19,0x47,0x00,0x00)	/* PPI_LININITCNT - 0x4719  */
#endif


			GEN_L5P(0x04,0x01, 0x01,0x00,0x00,0x00)	/* PPI_STARTPPI - 0x1  */
			GEN_L5P(0x04,0x02, 0x01,0x00,0x00,0x00)	/* DSI_STARTDSI - 0x1  */

			GEN_L5P(0x50,0x04, 0x00,0x01,0x00,0x03)	/* VPCTRL - 0x03000100 */

#define HSYNC		0x08	/* 8  */
#define HBP		0x08	/* 8  */
#define HFP		0x40	/* 64 */
#define HACTIVE_L	0xe0	/* 480 = 0x01e0 */
#define HACTIVE_H	0x01

#define VSYNC		0x01
#define VBP		0x14
#define VFP		0x14
#define VACTIVE_L	0x56	/* 854 = 0x0356 */
#define VACTIVE_H	0x03
#if 0
			GEN_L5P(0x54,0x04, HSYNC,0x00,HBP,0x00)			/* HTIM01 - 0x00080008  */
			GEN_L5P(0x58,0x04, HACTIVE_L,HACTIVE_H,HFP,0x00)	/* HTIM02 - 0x004001e0  */
			GEN_L5P(0x5c,0x04, VSYNC,0x00,VBP,0x00)			/* VTIM01 - 0x00140001  */
			GEN_L5P(0x60,0x04, VACTIVE_L,VACTIVE_H,VFP,0x00)	/* VTIM02 - 0x00140356  */
#else
			S_BUF_CONST(0, 144, 0x54, 0x04, 0x00, 0x00)
			S_BUF_SET(S_HSYNC, 16, 9, 0)
			S_BUF_SET(S_HBP, 32, 9, 0)
			S_BUF_SET(S_HACTIVE, 48, 11, 0)
			S_BUF_SET(S_HFP, 64, 9, 0)
			S_BUF_SET(S_VSYNC, 80, 8, 0)
			S_BUF_SET(S_VBP, 96, 8, 0)
			S_BUF_SET(S_VACTIVE, 112, 11, 0)
			S_BUF_SET(S_VFP, 128, 8, 0)
			GEN_BUF(18)
#endif

			GEN_L5P(0x64,0x04, 0x01,0x00,0x00,0x00)	/* VFUEN0 - 0x1  */
			GEN_L5P(0x10,0x05, 0x01,0x00,0x00,0x00)	/* SYSCTRL - 0x1  */

#if 0
			MRPS(3)		/* chip bug, 3 will read 4 bytes */
			GEN_READ4(0x00,0x05, 0x01,0x66,0x00,0x00) /* TC_IDREG - ChipID */
			GEN_READ4(0x04,0x05, 0x22,0x00,0x00,0x00) /* SYSBOOT */
			GEN_READ4(0x08,0x05, 0x00,0x00,0x00,0x00) /* SYSSTAT */
			GEN_READ4(0x50,0x04, 0x00,0x01,0x00,0x03) /* VPCTRL0 */
			GEN_READ4(0x54,0x04, 0x08,0x00,0x28,0x00) /* HTIM01 */
			GEN_READ4(0x58,0x04, 0xe0,0x01,0x28,0x00) /* HTIM02 */
			GEN_READ4(0x5c,0x04, 0x01,0x00,0x28,0x00) /* VTIM01 */
			GEN_READ4(0x60,0x04, 0x56,0x03,0x28,0x00) /* VTIM02 */
			S_IF_1_LANE GEN_READ4(0x14,0x09, 0x01,0x81,0x17,0x00) /* PXL_PLLPARAM */
			S_IF_2_LANES GEN_READ4(0x14,0x09, 0x01,0x41,0x13,0x00) /* PXL_PLLPARAM */
			S_IF_4_LANES GEN_READ4(0x14,0x09, 0x01,0xc1,0x11,0x00) /* PXL_PLLPARAM */
#endif
		>;
#if 1
		mode-video-hbp-disable;
		mode-video-hfp-disable;
		mode-video-hsa-disable;
#endif
		spi = <&spidev_lcd>;
		spi-9-bit;
		spi-cmds-disable = /bits/ 8 <
			DCS_S0P(0x10)		/* Enter sleep */
		>;
		spi-cmds-enable =  /bits/ 8 <
			DCS_S0P(0x11)		/* Exit sleep */
			DELAY(120)

			DCS_S0P(0x29)		/* SET_DISPLAY_ON */
			DELAY(25)
		>;
		spi-cmds-init =  /bits/ 8 <
			GEN_L5P(0xFF,0xFF, 0x98, 0x06, 0x04, 0x01) /* Change to Page 1 */
			GEN_S1P(0x08, 0x18)	/* Output SDI/SDO */
			GEN_S1P(0x20, 0x00)	/* set us DE not hsync/vsync */
			GEN_S1P(0x21, 0x03)	/* DE = 1 Active, pclk sample falling edge */
#if 0
			GEN_S1P(0x25, VFP)	/* VFP */
			GEN_S1P(0x26, VBP)	/* VBP */
			GEN_S1P(0x27, HBP)	/* HBP (low) */
			GEN_S1P(0x28, 0x00)	/* HBP (high) */
#else
			S_BUF_CONST(0, 16, 0x25, 0x00, 0x00, 0x00)
			S_BUF_SET(S_VFP, 8, 8, 0)
			GEN_BUF(2)
			S_BUF_CONST(0, 16, 0x26, 0x00, 0x00, 0x00)
			S_BUF_SET(S_VBP, 8, 8, 0)
			GEN_BUF(2)
			S_BUF_CONST(0, 16, 0x27, 0x00, 0x00, 0x00)
			S_BUF_SET(S_HBP, 8, 8, 0)
			GEN_BUF(2)
			S_BUF_CONST(0, 16, 0x28, 0x00, 0x00, 0x00)
			S_BUF_SET(S_HBP, 8, 8, 8)
			GEN_BUF(2)
#endif
			GEN_S1P(0x30, 0x01)	/* Resolution setting 480 X 854 */
			GEN_S1P(0x31, 0x00)	/* Inversion setting 2-dot */
			GEN_S1P(0x40, 0x16)	/* BT  AVDD,AVDD 2.5-3.0V */
			GEN_S1P(0x41, 0x33)	/* 5.2V, (5.0V)0x22 was default*/
			GEN_S1P(0x42, 0x03)	/* VGL = DDVDL - DDVDH, VGH = 2DDVDH - DDVDL */
			GEN_S1P(0x43, 0x09)	/* SET VGH clamp level */
			GEN_S1P(0x44, 0x06)	/* SET VGL clamp level */
			GEN_S1P(0x50, 0x88)	/* VREG1 4.7V */
			GEN_S1P(0x51, 0x88)	/* VREG2 -4.7V */
			GEN_S1P(0x52, 0x00)	/* VCOM MSB */
			GEN_S1P(0x53, 0x49)	/* VCOM LSB, -1.1V */
			GEN_S1P(0x55, 0x49)	/* VCOM2 -1.1V */
			GEN_S1P(0x60, 0x07)	/* SDTI adjust */
			GEN_S1P(0x61, 0x00)	/* CRTI */
			GEN_S1P(0x62, 0x07)	/* EQTI */
			GEN_S1P(0x63, 0x00)	/* PCTI */
			/* ++++++++++++++++++ Gamma Setting ++++++++++++++++++ */
			GEN_S1P(0xA0, 0x00)	/* Positive Gamma */
			GEN_S1P(0xA1, 0x09)
			GEN_S1P(0xA2, 0x11)
			GEN_S1P(0xA3, 0x0B)
			GEN_S1P(0xA4, 0x05)
			GEN_S1P(0xA5, 0x08)
			GEN_S1P(0xA6, 0x06)
			GEN_S1P(0xA7, 0x04)
			GEN_S1P(0xA8, 0x09)
			GEN_S1P(0xA9, 0x0C)
			GEN_S1P(0xAA, 0x15)
			GEN_S1P(0xAB, 0x08)
			GEN_S1P(0xAC, 0x0F)
			GEN_S1P(0xAD, 0x12)
			GEN_S1P(0xAE, 0x09)
			GEN_S1P(0xAF, 0x00)
			/* Negative */
			GEN_S1P(0xC0, 0x00)	/* Negative Gamma */
			GEN_S1P(0xC1, 0x09)
			GEN_S1P(0xC2, 0x10)
			GEN_S1P(0xC3, 0x0C)
			GEN_S1P(0xC4, 0x05)
			GEN_S1P(0xC5, 0x08)
			GEN_S1P(0xC6, 0x06)
			GEN_S1P(0xC7, 0x04)
			GEN_S1P(0xC8, 0x08)
			GEN_S1P(0xC9, 0x0C)
			GEN_S1P(0xCA, 0x14)
			GEN_S1P(0xCB, 0x08)
			GEN_S1P(0xCC, 0x0F)
			GEN_S1P(0xCD, 0x11)
			GEN_S1P(0xCE, 0x09)
			GEN_S1P(0xCF, 0x00)
#if 0
			DCS_READ1(0x26, 0x14) /* VBP */
			DCS_READ1(0x00, 0xff) /* RDID4 */
			DCS_READ1(0x01, 0xff) /* RDID4 */
			DCS_READ1(0x02, 0xff) /* RDID4 */
#endif
			GEN_L5P(0xFF, 0xFF, 0x98, 0x06, 0x04, 0x06)	 /* Change to Page 6 CMD for GIP timing */
			GEN_S1P(0x00, 0x20)
			GEN_S1P(0x01, 0x0A)
			GEN_S1P(0x02, 0x00)
			GEN_S1P(0x03, 0x00)
			GEN_S1P(0x04, 0x01)
			GEN_S1P(0x05, 0x01)
			GEN_S1P(0x06, 0x98)
			GEN_S1P(0x07, 0x06)
			GEN_S1P(0x08, 0x01)
			GEN_S1P(0x09, 0x80)
			GEN_S1P(0x0A, 0x00)
			GEN_S1P(0x0B, 0x00)
			GEN_S1P(0x0C, 0x01)
			GEN_S1P(0x0D, 0x01)
			GEN_S1P(0x0E, 0x05)
			GEN_S1P(0x0F, 0x00)
			GEN_S1P(0x10, 0xF0)
			GEN_S1P(0x11, 0xF4)
			GEN_S1P(0x12, 0x01)
			GEN_S1P(0x13, 0x00)
			GEN_S1P(0x14, 0x00)
			GEN_S1P(0x15, 0xC0)
			GEN_S1P(0x16, 0x08)
			GEN_S1P(0x17, 0x00)
			GEN_S1P(0x18, 0x00)
			GEN_S1P(0x19, 0x00)
			GEN_S1P(0x1A, 0x00)
			GEN_S1P(0x1B, 0x00)
			GEN_S1P(0x1C, 0x00)
			GEN_S1P(0x1D, 0x00)
			GEN_S1P(0x20, 0x01)
			GEN_S1P(0x21, 0x23)
			GEN_S1P(0x22, 0x45)
			GEN_S1P(0x23, 0x67)
			GEN_S1P(0x24, 0x01)
			GEN_S1P(0x25, 0x23)
			GEN_S1P(0x26, 0x45)
			GEN_S1P(0x27, 0x67)
			GEN_S1P(0x30, 0x11)
			GEN_S1P(0x31, 0x11)
			GEN_S1P(0x32, 0x00)
			GEN_S1P(0x33, 0xEE)
			GEN_S1P(0x34, 0xFF)
			GEN_S1P(0x35, 0xBB)
			GEN_S1P(0x36, 0xAA)
			GEN_S1P(0x37, 0xDD)
			GEN_S1P(0x38, 0xCC)
			GEN_S1P(0x39, 0x66)
			GEN_S1P(0x3A, 0x77)
			GEN_S1P(0x3B, 0x22)
			GEN_S1P(0x3C, 0x22)
			GEN_S1P(0x3D, 0x22)
			GEN_S1P(0x3E, 0x22)
			GEN_S1P(0x3F, 0x22)
			GEN_S1P(0x40, 0x22)
			GEN_L5P(0xFF, 0xFF, 0x98, 0x06, 0x04, 0x07)	/* Change to Page 7 CMD for GIP timing */
			GEN_S1P(0x17, 0x22)	/* VGLREG - disabled */
			GEN_S1P(0x02, 0x77)
			GEN_S1P(0x26, 0xB2)
			GEN_L5P(0xFF, 0xFF, 0x98, 0x06, 0x04, 0x00)	/* Change to Page 0 CMD for Normal command */

			GEN_S1P(0x3A, 0x70)	/* Interface pixel format, 24 BPP */
#if 0
			DCS_READ1(0xda, 0xff) /* RDID1 */
			DCS_READ1(0xdb, 0xff) /* RDID2 */
			DCS_READ1(0xdc, 0xff) /* RDID3 */
#endif
#if 0
			DCS_S1P(0x5e, 0x55)
			DCS_READ1(0x5f, 0x55)
#endif
		>;
		spi-max-frequency = <5000000>;
	};
};
