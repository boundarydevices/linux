// SPDX-License-Identifier: (GPL-2.0+ OR MIT)
/*
 * Copyright 2023 Boundary Devices
 */

#define REV20
#include "imx8mp-nitrogen8mp.dts"

/ {
	model = "Boundary i.MX 8M Plus Nitrogen8MP Rev20 ENC board";
};
