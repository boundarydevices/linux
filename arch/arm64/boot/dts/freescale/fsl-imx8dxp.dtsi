// SPDX-License-Identifier: GPL-2.0+
/*
 * Copyright 2018 NXP
 *
 * This program is free software; you can redistribute it and/or
 * modify it under the terms of the GNU General Public License
 * as published by the Free Software Foundation; either version 2
 * of the License, or (at your option) any later version.
 *
 * This program is distributed in the hope that it will be useful,
 * but WITHOUT ANY WARRANTY; without even the implied warranty of
 * MERCHANTABILITY or FITNESS FOR A PARTICULAR PURPOSE.  See the
 * GNU General Public License for more details.
 */


#include "fsl-imx8dx.dtsi"

/ {
    model = "Freescale i.MX8DXP";
    compatible = "fsl,imx8dxp", "fsl,imx8qxp";

    vpu_decoder: vpu_decoder@2c000000 {
        compatible = "nxp,imx8qm-b0-vpudec", "nxp,imx8qxp-b0-vpudec";
        boot-region = <&decoder_boot>;
        rpc-region = <&decoder_rpc>;
        reg = <0x0 0x2c000000 0x0 0x1000000>;
        reg-names = "vpu_regs";
        clocks = <&clk IMX8QXP_VPU_DEC_CLK>;
        clock-names = "vpu_clk";
        assigned-clocks = <&clk IMX8QXP_VPU_DEC_CLK>;
        power-domains = <&pd_vpu_dec>;
        status = "disabled";
    };
};

&gpu_3d0 {
    assigned-clock-rates = <700000000>, <850000000>;
};
