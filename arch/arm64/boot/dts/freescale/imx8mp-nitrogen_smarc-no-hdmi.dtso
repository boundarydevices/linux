// SPDX-License-Identifier: (GPL-2.0+ OR MIT)
/*
 * Copyright 2026 Ezurio LLC
 */

/dts-v1/;
/plugin/;

#include <dt-bindings/gpio/gpio.h>
#include "imx8mp-pinfunc.h"

&sound_hdmi {
	status = "disabled";
};

&lcdif3 {
	status = "disabled";
};

