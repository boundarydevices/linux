// SPDX-License-Identifier: (GPL-2.0+ OR MIT)
/*
 * Copyright 2026 Ezurio LLC
 */

/dts-v1/;
/plugin/;

&uart1 {
	bluetooth {
		compatible = "nxp,88w8987-bt";
		fw-init-baudrate = <3000000>;
	};
};

&usdhc3 { /* WiFi / Bluetooth */
	max-frequency = <50000000>;
	cap-power-off-card;
};

&wifi {
	status = "disabled";
};
