#include <dt-bindings/display/simple_panel_mipi_cmds.h>

/ {
	aliases {
		mipi_cmds_dmt055fhnmcmi = &mipi_cmds_dmt055fhnmcmi;
#if 0
		pinctrl_dmt055fhnmcmi = &pinctrl_mipi_dmt055fhnmcmi;
#endif
	};

#ifndef MIPI_COMMANDS_DONE
	/* hx8399a controller */
	mipi_cmds_dmt055fhnmcmi: mipi-cmds-dmt055fhnmcmi {
		alias = <&mipi_cmds_dmt055fhnmcmi>;
#if 0
		aliasp = <&pinctrl_mipi_dmt055fhnmcmi>;
#endif
		delay-prepare = <130>;
		delay-unprepare = <2>;
		mipi-cmds-enable = /bits/ 8 <
			/* SET EXTC */
			DCS_L3P(0xB9,0xFF,0x83,0x99)
			DCS_S1P(0xBA,0x43)
			/* SET PANEL */
			DCS_S1P(0xD2,0x44)
			/* SET POWER */
			0x0d
			  0xB1 0x00 0x7C 0x34 0x34 0x44 0x09 0x22 0x22 0x71 0xF1 0xB2 0x4A
			/* SET DISPLAY */
			0x0b
			  0xB2 0x00 0x80 0x00 0x7F 0x05 0x07 0x23 0x4D 0x02 0x01
			/* SET CYC */
			0x29
			  0xB4 0x00 0xFF 0x02 0x40 0x02 0x40 0x00 0x00 0x06 0x00 0x01 0x02 0x00 0x0F 0x01
			  0x02 0x05 0x20 0x00 0x04 0x44 0x02 0x40 0x02 0x40 0x00 0x00 0x06 0x00 0x01 0x02
			  0x00 0x0F 0x01 0x02 0x05 0x00 0x00 0x04 0x44
			/* SET GIP_0 */
			0x20
			  0xD3 0x00 0x01 0x00 0x00 0x00 0x06 0x00 0x00 0x10 0x04 0x00 0x04 0x00 0x00 0x00
			  0x00 0x00 0x00 0x00 0x00 0x00 0x00 0x01 0x05 0x05 0x07 0x00 0x00 0x00 0x05 0x08
			/* SET GIP_1 */
			0x21
			  0xD5 0x18 0x18 0x19 0x19 0x18 0x18 0x21 0x20 0x01 0x00 0x07 0x06 0x05 0x04 0x03
			  0x02 0x18 0x18 0x18 0x18 0x18 0x18 0x30 0x30 0x31 0x31 0x32 0x32 0x18 0x18 0x18
			  0x18
			/* SET GIP_1 */
			0x21
			  0xD6 0x18 0x18 0x19 0x19 0x40 0x40 0x20 0x21 0x06 0x07 0x00 0x01 0x02 0x03 0x04
			  0x05 0x40 0x40 0x40 0x40 0x40 0x40 0x30 0x30 0x31 0x31 0x32 0x32 0x40 0x40 0x40
			  0x40
			/* SET GIP_1 */
			0x31
			  0xD8 0xA2 0xAA 0x02 0xA0 0xA2 0xA8 0x02 0xA0 0xB0 0x00 0x00 0x00 0xB0 0x00 0x00
			  0x00 0xB0 0x00 0x00 0x00 0xB0 0x00 0x00 0x00 0xE2 0xAA 0x03 0xF0 0xE2 0xAA 0x03
			  0xF0 0x00 0x00 0x00 0x00 0x00 0x00 0x00 0x00 0xE2 0xAA 0x03 0xF0 0xE2 0xAA 0x03
			  0xF0
			0x2b
			  0xE0 0x01 0x11 0x17 0x2E 0x30 0x35 0x2F 0x47 0x07 0x0D 0x10 0x14 0x16 0x14 0x15
			  0x13 0x19 0x0B 0x18 0x08 0x15 0x01 0x11 0x17 0x2E 0x30 0x35 0x2F 0x47 0x07 0x0D
			  0x10 0x14 0x16 0x14 0x15 0x13 0x19 0x0B 0x18 0x08 0x15
			/* SET VCOM */
			DCS_L2P(0xB6,0x14,0x18)
			/* SET lcd */
			DCS_S1P(0xCC,0x08)
			DCS_S0P(0x11)		/* Exit sleep */
			DELAY(120)
			DCS_S0P(0x29)		/* MIPI_DCS_SET_DISPLAY_ON */
			DELAY(50)
		>;
		mipi-cmds-disable = /bits/ 8 <
			DCS_S0P(0x28)		/* MIPI_DCS_SET_DISPLAY_OFF */
			DELAY(10)
			DCS_S0P(0x10)		/* Enter sleep */
			DELAY(120)
		>;
		mode-video-hfp-disable;
		mode-video-hsa-disable;
	};
#endif
};
