#include <dt-bindings/display/simple_panel_mipi_cmds.h>

/ {
	aliases {
		mipi_cmds_m101nwwb = &mipi_cmds_m101nwwb;
	};

#ifndef MIPI_COMMANDS_DONE
	mipi_cmds_m101nwwb: mipi-cmds-m101nwwb {
		alias = <&mipi_cmds_m101nwwb>;
	};
#endif
};
