#include <dt-bindings/display/simple_panel_mipi_cmds.h>

#define VBPD   8
#define VFPD  16
#define VSPW   2
#define HBPD  30
#define HFPD  24
#define HSPW  2
#define HDP   480
#define VDP   1280

/ {
	aliases {
		mipi_cmds_ltk069wxict11 = &mipi_cmds_ltk069wxict11;
		pinctrl_ltk069wxict11 = &pinctrl_mipi_ltk069wxict11;
	};

	mipi_cmds_ltk069wxict11: mipi-cmds-ltk069wxict11 {
		alias = <&mipi_cmds_ltk069wxict11>;
		aliasp = <&pinctrl_mipi_ltk069wxict11>;
		mipi-cmds-enable = /bits/ 8 <
			GEN_S1P(0xFF,0x30)
			GEN_S1P(0xFF,0x52)
			GEN_S1P(0xFF,0x01)
			GEN_S1P(0xE3,0x00)
			GEN_S1P(0x25,0x0A)
			GEN_S1P(0x28,0xFF)
			GEN_S1P(0x29,0x44)
			GEN_S1P(0x2C,0x22)
			GEN_S1P(0x37,0x74)
			GEN_S1P(0x38,0x7F)
			GEN_S1P(0x39,0x33)	/* VCOM */
			GEN_S1P(0x49,0x3C)
			GEN_S1P(0x5C,0x00)
			GEN_S1P(0x80,0x20)	/* 2POWER */
			GEN_S1P(0x91,0x77)
			GEN_S1P(0x92,0x77)
			GEN_S1P(0xA0,0x55)
			GEN_S1P(0xA1,0x50)
			GEN_S1P(0xA3,0xD8)
			GEN_S1P(0xA4,0x9C)
			GEN_S1P(0xA7,0x02)
			GEN_S1P(0xA8,0x01)
			GEN_S1P(0xA9,0x21)
			GEN_S1P(0xAA,0xA8)
			GEN_S1P(0xAB,0x28)
			GEN_S1P(0xAC,0xE0)
			GEN_S1P(0xAD,0xE2)
			GEN_S1P(0xAE,0xE2)
			GEN_S1P(0xAF,0x02)
			GEN_S1P(0xB0,0xE2)
			GEN_S1P(0xB1,0x26)
			GEN_S1P(0xB2,0x28)
			GEN_S1P(0xB3,0x28)
			GEN_S1P(0xB4,0x22)
			GEN_S1P(0xB5,0xE2)
			GEN_S1P(0xB6,0x26)
			GEN_S1P(0xB7,0xE2)
			GEN_S1P(0xB8,0x26)

			GEN_S1P(0xFF,0x30)
			GEN_S1P(0xFF,0x52)
			GEN_S1P(0xFF,0x02)
			GEN_S1P(0xB1,0x05)
			GEN_S1P(0xD1,0x05)
			GEN_S1P(0xB4,0x2C)
			GEN_S1P(0xD4,0x2A)
			GEN_S1P(0xB2,0x01)
			GEN_S1P(0xD2,0x01)
			GEN_S1P(0xB3,0x29)
			GEN_S1P(0xD3,0x27)
			GEN_S1P(0xB6,0x07)
			GEN_S1P(0xD6,0x05)
			GEN_S1P(0xB7,0x2C)
			GEN_S1P(0xD7,0x2A)
			GEN_S1P(0xC1,0x05)
			GEN_S1P(0xE1,0x05)
			GEN_S1P(0xB8,0x0A)
			GEN_S1P(0xD8,0x0A)
			GEN_S1P(0xB9,0x01)
			GEN_S1P(0xD9,0x01)
			GEN_S1P(0xBD,0x14)
			GEN_S1P(0xDD,0x14)
			GEN_S1P(0xBC,0x12)
			GEN_S1P(0xDC,0x12)
			GEN_S1P(0xBB,0x10)
			GEN_S1P(0xDB,0x10)
			GEN_S1P(0xBA,0x10)
			GEN_S1P(0xDA,0x10)
			GEN_S1P(0xBE,0x17)
			GEN_S1P(0xDE,0x19)
			GEN_S1P(0xBF,0x0E)
			GEN_S1P(0xDF,0x10)
			GEN_S1P(0xC0,0x17)
			GEN_S1P(0xE0,0x19)
			GEN_S1P(0xB5,0x37)
			GEN_S1P(0xD5,0x32)
			GEN_S1P(0xB0,0x02)
			GEN_S1P(0xD0,0x05)

			GEN_S1P(0xFF,0x30)
			GEN_S1P(0xFF,0x52)
			GEN_S1P(0xFF,0x03)
			GEN_S1P(0x00,0x00)
			GEN_S1P(0x01,0x00)
			GEN_S1P(0x02,0x00)
			GEN_S1P(0x03,0x00)
			GEN_S1P(0x08,0x8d)
			GEN_S1P(0x09,0x8c)
			GEN_S1P(0x0A,0x8b)
			GEN_S1P(0x0B,0x8a)
			GEN_S1P(0x30,0x00)
			GEN_S1P(0x31,0x00)
			GEN_S1P(0x32,0x00)
			GEN_S1P(0x33,0x00)
			GEN_S1P(0x34,0x81)
			GEN_S1P(0x35,0x26)
			GEN_S1P(0x36,0x66)
			GEN_S1P(0x37,0x13)
			GEN_S1P(0x40,0x8a)
			GEN_S1P(0x41,0x8b)
			GEN_S1P(0x42,0x88)
			GEN_S1P(0x43,0x89)
			GEN_S1P(0x45,0x00)
			GEN_S1P(0x46,0x01)
			GEN_S1P(0x48,0x02)
			GEN_S1P(0x49,0x03)
			GEN_S1P(0x50,0x86)
			GEN_S1P(0x51,0x87)
			GEN_S1P(0x52,0x84)
			GEN_S1P(0x53,0x85)
			GEN_S1P(0x55,0x04)
			GEN_S1P(0x56,0x05)
			GEN_S1P(0x58,0x06)
			GEN_S1P(0x59,0x07)
			GEN_S1P(0x80,0x0f)
			GEN_S1P(0x81,0x0f)
			GEN_S1P(0x82,0x0e)
			GEN_S1P(0x83,0x0f)
			GEN_S1P(0x84,0x04)
			GEN_S1P(0x85,0x05)
			GEN_S1P(0x86,0x06)
			GEN_S1P(0x87,0x07)
			GEN_S1P(0x88,0x0f)
			GEN_S1P(0x89,0x0e)
			GEN_S1P(0x8A,0x00)
			GEN_S1P(0x8B,0x01)

			GEN_S1P(0x96,0x0f)
			GEN_S1P(0x97,0x0f)
			GEN_S1P(0x98,0x0e)
			GEN_S1P(0x99,0x0f)
			GEN_S1P(0x9a,0x04)
			GEN_S1P(0x9b,0x05)
			GEN_S1P(0x9c,0x06)
			GEN_S1P(0x9d,0x07)
			GEN_S1P(0x9e,0x0f)
			GEN_S1P(0x9f,0x0e)
			GEN_S1P(0xA0,0x00)
			GEN_S1P(0xA1,0x01)

			GEN_S1P(0xFF,0x30)
			GEN_S1P(0xFF,0x52)
			GEN_S1P(0xFF,0x00)
			GEN_S1P(0x36,0x02)

			DCS_S0P(0x11)		/* Exit sleep */
			DELAY(200)
			DCS_S0P(0x29)		/* MIPI_DCS_SET_DISPLAY_ON */
			DELAY(100)
		>;
		mipi-cmds-disable = /bits/ 8 <
			DCS_S0P(0x28)		/* MIPI_DCS_SET_DISPLAY_OFF */
			DELAY(20)
			DCS_S0P(0x10)		/* Enter sleep */
		>;
		mipi-delay-between-cmds = <1>;
		mode-video-hfp-disable;
		mode-video-hsa-disable;
	};
};
