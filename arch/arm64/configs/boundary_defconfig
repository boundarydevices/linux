## drivers/amlogic/Kconfig
```kconfig
#
# Amlogic driver configuration
#
config AMLOGIC_DRIVER
	bool "Amlogic Peripheral drivers"
	default n
	help
		this option is provided for control amlogic
		drivers, if you want to use amlogic driver
		please open it

config AMLOGIC_MODIFY
	bool "Amlogic modify for kernel code"
	default n
	help
		this option is set up for AMLOGIC modify of
		standard kernel source code. All modify of kernel
		standard code should be wrapped by this config

if AMLOGIC_DRIVER
menu "Amlogic Device Drivers"

source "drivers/amlogic/cpufreq/Kconfig"

source "drivers/amlogic/uart/Kconfig"

source "drivers/amlogic/iomap/Kconfig"

source "drivers/amlogic/pinctrl/Kconfig"

source "drivers/amlogic/usb/Kconfig"

source "drivers/amlogic/i2c/Kconfig"

source "drivers/amlogic/spicc/Kconfig"

source "drivers/amlogic/secmon/Kconfig"

source "drivers/amlogic/cpu_version/Kconfig"

source "drivers/amlogic/cpu_info/Kconfig"

source "drivers/amlogic/mailbox/Kconfig"

source "drivers/amlogic/reg_access/Kconfig"

source "drivers/amlogic/clocksource/Kconfig"

source "drivers/amlogic/clk/Kconfig"

source "drivers/amlogic/crypto/Kconfig"

source "drivers/amlogic/input/Kconfig"

source "drivers/amlogic/efuse/Kconfig"

source "drivers/amlogic/reboot/Kconfig"

source "drivers/amlogic/ethernet/phy/Kconfig"

source "drivers/amlogic/cpu_hotplug/Kconfig"

source "drivers/amlogic/pwm/Kconfig"

source "drivers/amlogic/media/Kconfig"

source "drivers/amlogic/mmc/Kconfig"

source "drivers/amlogic/mtd/Kconfig"

source "drivers/amlogic/mtd_meson8b/Kconfig"

source "drivers/amlogic/vrtc/Kconfig"

source "drivers/amlogic/smartcard/Kconfig"

source "drivers/amlogic/cec/Kconfig"

source "drivers/amlogic/unifykey/Kconfig"

source "drivers/amlogic/thermal/Kconfig"

source "drivers/amlogic/audiodsp/Kconfig"

source "drivers/amlogic/audioinfo/Kconfig"

source "drivers/amlogic/pm/Kconfig"

source "drivers/amlogic/led/Kconfig"

source "drivers/amlogic/jtag/Kconfig"

source "drivers/amlogic/watchdog/Kconfig"

source "drivers/amlogic/esm/Kconfig"

source "drivers/amlogic/wifi/Kconfig"

source "drivers/amlogic/bluetooth/Kconfig"

source "drivers/amlogic/dvb/Kconfig"

source "drivers/amlogic/power/Kconfig"

source "drivers/amlogic/pci/Kconfig"

source "drivers/amlogic/irblaster/Kconfig"

source "drivers/amlogic/iio/Kconfig"

source "drivers/amlogic/ddr_window/Kconfig"

source "drivers/amlogic/drm/Kconfig"

source "drivers/amlogic/secure_monitor/Kconfig"

source "drivers/amlogic/tee/Kconfig"
endmenu
endif
```

## drivers/amlogic/amaudio/Kconfig
```kconfig
# AML AUDIO control drivers

menu "Audio Interface"
config	AMLOGIC_AMAUDIO
	bool "Amlogic Audio Interface"
    default n
    depends on SOUND
    depends on SND_SOC
    depends on SND
    depends on AMLOGIC_AUDIO_DSP
    #depends on SND_AMLOGIC_SOC
    #depends on SWITCH
	help
		"Amlogic Audio Interface"

endmenu
```

## drivers/amlogic/amaudio2/Kconfig
```kconfig
# AML AUDIO V2 control drivers

menu "Amlogic Audio Interface V2"

config	AMLOGIC_AMAUDIO2
	bool "Amlogic Audio Interface V2"
	default n
	help
		"Amlogic Audio Interface V2, The interface different from amaudio"

endmenu
```

## drivers/amlogic/atv_demod/Kconfig
```kconfig
#
# ATV driver configuration
#

menu "Amlogic ATV driver"

config AMLOGIC_ATV_DEMOD
	tristate "Amlogic ATVDEMOD device driver"
	default n
	help
		ATVDEMOD device driver.
		Y: enable
		N: disable
		M: build as module

endmenu
```

## drivers/amlogic/audiodsp/Kconfig
```kconfig
# audio dsp  configuration
#
menu "AMLOGIC Audio DSP process"

config AMLOGIC_AUDIO_DSP
	tristate "audio dsp control support"
	default n
	help
		support the amlogic audio dsp;

endmenu
```

## drivers/amlogic/audioinfo/Kconfig
```kconfig
# audio info  configuration
#
menu "AMLOGIC Audio Info"

config AMLOGIC_AUDIO_INFO
	tristate "audio info"
	default n
	help
		support the amlogic audio info;

endmenu
```

## drivers/amlogic/battery/Kconfig
```kconfig
config AMLOGIC_BATTERY_DUMMY
	tristate "Dummy battery driver for Amlogic"
	help
	  Say Y to enable generic support for battery charging according
	  to common Android policies.
	  This driver adds periodic battery level and health monitoring,
	  kernel log reporting and other debugging features, common board
	  battery file glue logic for battery/case temperature sensors,
	  etc.

config AMLOGIC_CHARGER_DUMMY
	tristate "Dummy charger driver for Amlogic"
	help
	  Say Y to enable dummy support for battery charging according
	  to common Android policies
```

## drivers/amlogic/bluetooth/Kconfig
```kconfig
config AMLOGIC_BT_DEVICE
    bool "BT Device support"
    depends on BT && RFKILL
    default n
    ---help---
      Say Y here if you want to use the BT device.
```

## drivers/amlogic/cec/Kconfig
```kconfig
menuconfig AMLOGIC_CEC
	bool "AMLOGIC CEC Support"
	depends on AMLOGIC_DRIVER
	default n
	help
		HDMI cec driver provide cec support on Amlogic SOC chips,
		you can use this driver to implement cec features on TV/MBOX

choice
	prompt "Amlogic cec chip driver select"
	depends on AMLOGIC_CEC
	default AMLOGIC_AO_CEC

config AMLOGIC_AO_CEC
	bool "HDMI AO cec driver support for gx/gxl/gxm/txl/txlx"
	depends on AMLOGIC_CEC
	help
		HDMI cec driver provide cec support for gx/gxl/gxm/txl/txlx chips
		select if your chip belongs

config AMLOGIC_M8B_CEC
	bool "HDMI CEC driver support for m8/m8b"
	depends on MACH_MESON8B && AMLOGIC_CEC
	help
		HDMI CEC driver support for m8/m8b chips
		Select if your chip belongs

endchoice	#AMLOGIC_CEC
```

## drivers/amlogic/clk/Kconfig
```kconfig
config AMLOGIC_CLK
	bool "Amlogic clock driver  support"
	depends on OF
	select COMMON_CLK
	select AMLOGIC_MHU_MBOX
	help
		This is the Amlogic Clock  driver
		Say Y if you want peripherals
		and CPU frequency scaling to work
		.

config AMLOGIC_RESET
        bool "Meson Reset Driver"
        default AMLOGIC_CLK
        help
		This enables the reset driver for Amlogic Meson SoCs.

config AMLOGIC_COMMON_CLK_SCPI
	tristate "Clock driver controlled via SCPI interface"
	depends on ARM_SCPI_PROTOCOL || COMPILE_TEST
	  ---help---
	  This driver provides support for clocks that are controlled
	  by firmware that implements the SCPI interface.

	  This driver uses SCPI Message Protocol to interact with the
	  firmware providing all the clock controls.

config AMLOGIC_M8B_CLK
	bool "Amlogic meson8b clock driver support"
	depends on AMLOGIC_CLK
	help
	  Support for the clock controller on AmLogic S805 devices, aka
	  meson8b. Say Y if you want peripherals and CPU frequency scaling to
	  work.

config AMLOGIC_GX_CLK
	bool "Amlogic gx clock driver support"
	depends on AMLOGIC_CLK
	help
	  Support for the clock controller on AmLogic S905 devices, aka gxbb.
	  Say Y if you want peripherals and CPU frequency scaling to work.
```

## drivers/amlogic/clocksource/Kconfig
```kconfig
menuconfig AMLOGIC_TIMER
    bool "Amlogic Meson timer driver"
    default n
    help
      This is the Amlogic Meson driver interface driver
if AMLOGIC_TIMER
config AMLOGIC_LOCAL_TIMER
	bool "meson local timer support"
	def_bool n
	depends on AMLOGIC_TIMER
	select CLKSRC_OF if OF
	help
	  This is a new clocksource driver for amlogic timer
config AMLOGIC_BC_TIMER
	bool "meson broadcast timer support"
	def_bool n
	depends on AMLOGIC_TIMER
	select CLKSRC_OF if OF
	help
	  This is a new clocksource driver for amlogic timer
endif
```

## drivers/amlogic/cpu_hotplug/Kconfig
```kconfig
config	AMLOGIC_CPU_HOTPLUG
	bool "Amlogic cpu freq"
	default n
	help
	  say y to enable Amlogic chipid driver.
```

## drivers/amlogic/cpu_info/Kconfig
```kconfig
config	AMLOGIC_CPU_INFO
	bool "Amlogic chipid"
	default n
	help
	  say y to enable Amlogic chipid driver.
```

## drivers/amlogic/cpu_version/Kconfig
```kconfig
menuconfig AMLOGIC_CPU_VERSION
    bool "Amlogic cpu version support"
    default n
    help
      This is the Amlogic CPU version interface driver

if AMLOGIC_CPU_VERSION

config	AMLOGIC_MESON64_VERSION
	bool "Amlogic Meson64 cpu version"
	default n
	help
	  say y to enable
	  Amlogic gx-X
	  cpu version driver
	  .

config	AMLOGIC_M8B_MESON32_VERSION
	bool "Amlogic M8b Meson32 cpu version"
	default n
	help
	  say y to enable
	  Amlogic M8b
	  cpu version driver

endif
```

## drivers/amlogic/cpufreq/Kconfig
```kconfig
menuconfig AMLOGIC_CPUFREQ
	bool "AMLOGIC CPU frequency driver support"
	depends on AMLOGIC_DRIVER
	depends on CPU_FREQ
	select PM_OPP
	default n
	help
		CPU DVFS driver support for Amlogic SOC chips;
		You can use this driver to change cpu frequency.

config AMLOGIC_M8B_CPUFREQ
	bool "Meson CPU Frequency scaling support for m8/m8b"
	depends on MACH_MESON8B && AMLOGIC_CPUFREQ
	default n
	help
		cpufreq driver support for m8/m8b, select
		it if your chip belongs this group

config AMLOGIC_MESON_CPUFREQ
	bool  "MESON based CPUfreq driver"
	depends on AMLOGIC_CPUFREQ
	default n
        help
          This adds the CPUfreq driver support for ARM big.LITTLE platforms
          using MESON dt for CPU power management.

          This driver uses meson cpufreq driver to interact with the
          firmware providing the CPU DVFS functionality.

config AMLOGIC_INPUT_BOOST
    bool "Meson BOOST cpufreq when key input"
    depends on CPU_FREQ_GOV_INTERACTIVE
    help
        This adds boost cpuferq support when key input detected.
        This adds boost cpuferq support when key input detected.
        When key input, cpufreq is boosted.
        And boost_duration is decideded by AMLOGIC_INPUT_BOOST_DURATION

config AMLOGIC_INPUT_BOOST_DURATION
    int "Input boost duration"
    range 0 5000
    default 1000
    depends on AMLOGIC_INPUT_BOOST
    help
        This set boost cpuferq duration.
        unit is ms.
```

## drivers/amlogic/crypto/Kconfig
```kconfig
menu "Amlogic Crypto Support"

config AMLOGIC_CRYPTO
  bool "amlogic HW CRYPTO module"
	select CRYPTO_ALGAPI
	select CRYPTO_BLKCIPHER
	select CRYPTO_HASH
	default n

config AMLOGIC_CRYPTO_DMA
  bool "amlogic HW CRYPTO module based on DMA"
	depends on AMLOGIC_CRYPTO
	default n
	help
		New Crypto DMA engine starting from S905-X
		Current supported Socs are S905-X, S905-D, S912
		Drivers using new dma engine are in file name
		such aml-xxx-dma.c

config AMLOGIC_CRYPTO_BLKMV
  bool "amlogic HW CRYPTO module based on BLKMV"
	depends on AMLOGIC_CRYPTO
	default n
	help
		Legacy Crypto engine based on module BLKMV
		Drivers using new dma engine are in file name
		such aml-xxx-blkmv.c

endmenu
```

## drivers/amlogic/ddr_tool/Kconfig
```kconfig
config AMLOGIC_DDR_TOOL
	bool "Meson cpu ddr tool"
	depends on AMLOGIC_DRIVER
	default n
	help
	  This config add some debug tools for DDR, including test ddr
	  bandwidth, ddr window and other configs.
	  For more information.
	  Please see folllowing configs

config AMLOGIC_DDR_WINDOW_TOOL
	tristate "Meson ddr window tool"
	default m
	depends on AMLOGIC_DDR_TOOL
	help
	  This config enables test for ddr window.
	  This driver acts as a kernel agent which set different ddr window
	  register value from user space, user space can generate large ddr
	  loading to test each value are stable.

config AMLOGIC_DDR_BANDWIDTH
	bool "Meson ddr bandwidth"
	default n
	depends on AMLOGIC_DDR_TOOL
	help
	  This config enables ddr bandwidth measure.
	  If open it, this driver will export interface to get ddr total
	  bandwidth, it can be used for ddr DVFS/devfreq system.

config AMLOGIC_DMC_MONITOR
       bool "Amlogic dmc monitor"
       depends on AMLOGIC_DDR_TOOL
       default y
       help
               DMC monitor for hardware connected to DMC master. Using it can
               set up an address range and assign R/W permission for each
               hardware. If hardware violated R/W permission, then interrupt
               will generated and can help to debug memory pollution.
```

## drivers/amlogic/ddr_window/Kconfig
```kconfig
config AMLOGIC_DDR_WINDOW_TOOL
	tristate "Meson cpu ddr window test tool"
	default n
	help
	  This add ddr window test tools
```

## drivers/amlogic/debug/Kconfig
```kconfig
menuconfig AMLOGIC_DEBUG
	bool "AMLOGIC kernel debug"
	default n
	help
		Amlogic kernel debug

config AMLOGIC_DEBUG_LOCKUP
	bool "Amlogic Kernel Lockup debug"
	depends on AMLOGIC_DEBUG
	depends on HARDLOCKUP_DETECTOR
	default n
	help
		Debug lockup in isr and deaklock whit irq disabled.
		When enable this config, Watchdog should be disabled.

config AMLOGIC_DEBUG_ATRACE
	bool "Amlogic Kernel ATrace"
	depends on AMLOGIC_DEBUG
	default y
	help
		Add android atrace compatible function
```

## drivers/amlogic/defendkey/Kconfig
```kconfig
#
# amlogic encrypt img judge
#

menu "Amlogic defend img file update support"

config AMLOGIC_DEFENDKEY
	bool "defend img update"
	default n
	help
		defend update system for board, when system is encrypted, the system img
		must be encrypted with same key in board

endmenu
```

## drivers/amlogic/dolby_fw/Kconfig
```kconfig
config DOLBY_FW
	tristate "Dolby FW kernel driver"
	default n
	help
	This is Dolby FW Driver.
```

## drivers/amlogic/drm/Kconfig
```kconfig
config DRM_MESON
	tristate "DRM Support for Amlogic Meson Display Controller"
	depends on DRM && OF && (ARM || ARM64)
	select DRM_KMS_HELPER
	select DRM_KMS_CMA_HELPER
	select DRM_GEM_CMA_HELPER
	select VIDEOMODE_HELPERS
	select REGMAP_MMIO

config DRM_MESON_VPU
	tristate "support drm vpu function for meson drm display."
	default y
	depends on DRM_MESON
	help
		add drm vpu support.
		Choose this option if you have a aMLOGIC soc chipset.
		This driver provides KMS.
		This driver also provides crtcs and planes management.

config DRM_MESON_HDMI
	tristate "support drm hdmi function for meson drm display."
	default y
	depends on DRM_MESON
	depends on AMLOGIC_HDMITX
	help
		add drm hdmi support.
		use internal amlogic media vout hdmi driver.
		We should confirm AMLOGIC_HDMITX is configured if
		DRM_MESON_HDMI is selected.

config DRM_MESON_PANEL
	tristate "support drm panel function for meson drm display."
	default y
	depends on DRM_MESON
	depends on AMLOGIC_LCD
	select DRM_PANEL
	select DRM_MIPI_DSI
	help
		add drm panel support.
		use internal amlogic media vout lcd driver.
		We should confirm AMLOGIC_LCD is configured if
		DRM_MESON_PANEL is selected.

config DRM_MESON_USE_ION
	bool "gem use ion to alloc/free graphic buffer."
	default y
	depends on DRM_MESON
	help
		MESON DRM use CMA HELPER to manage framebuffer.
		It need reserve memory in CMA pool.
		We implement GEM to allocate/free framebuffer from ion.
		For dumb used by displaycontrol we alloc from the ION CMA HEAP.
		For dumb used by app, we can alloc from the ION.
		SYSTEM HEAP which dont need reserve memory.

config DRM_MESON_EMULATE_FBDEV
	bool "emulate framebuffer dev by drm."
	default n
	depends on DRM_MESON && DRM_MESON_USE_ION
	help
		Emulate framebuffer device for device which need use fbdev api.
```
