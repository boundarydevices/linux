/*
 * Copyright 2017 Boundary Devices
 *
 * The code contained herein is licensed under the GNU General Public
 * License. You may obtain a copy of the GNU General Public License
 * Version 2 or later at the following locations:
 *
 * http://www.opensource.org/licenses/gpl-license.html
 * http://www.gnu.org/copyleft/gpl.html
 */

/dts-v1/;

#include <dt-bindings/interrupt-controller/irq.h>
#include "imx6q.dtsi"

/ {
	model = "Freescale i.MX6 Quad CID2 Board";
	compatible = "fsl,imx6q-cid", "fsl,imx6q";
};

&iomuxc {
	pinctrl-names = "default";
	pinctrl-0 = <&pinctrl_hog>;

	iomuxc_imx6q_cid: iomuxc-imx6q-cidgrp {
		status = "okay";
	};
};

&iomuxc_imx6q_cid {
	pinctrl_leds: ledsgrp {
		fsl,pins = <
#define GP_LED_VIBRATOR		<&gpio5 8 GPIO_ACTIVE_HIGH>
			MX6QDL_PAD_DISP0_DAT14__GPIO5_IO08	0x030b0
#define GP_LED_BLUE		<&gpio4 26 GPIO_ACTIVE_HIGH>
			MX6QDL_PAD_DISP0_DAT5__GPIO4_IO26	0x130b0
#define GP_LED_GREEN		<&gpio4 25 GPIO_ACTIVE_LOW>
			MX6QDL_PAD_DISP0_DAT4__GPIO4_IO25	0x1b0b0
#define GP_LED_CTRL_GREEN	<&gpio3 7 GPIO_ACTIVE_HIGH>
			MX6QDL_PAD_EIM_DA7__GPIO3_IO07		0x100b0
#define GP_LED_RED		<&gpio4 27 GPIO_ACTIVE_HIGH>
			MX6QDL_PAD_DISP0_DAT6__GPIO4_IO27	0x130b0
#define GP_LED_CTRL_RED		<&gpio2 30 GPIO_ACTIVE_HIGH>
			MX6QDL_PAD_EIM_EB2__GPIO2_IO30		0x100b0
		>;
	};
};

#include "imx6qdl-cid.dtsi"
