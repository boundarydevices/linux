#include <dt-bindings/display/simple_panel_mipi_cmds.h>

#define Width 480
#define Height 1280
#define HFP 50
#define HBP 50
#define HSA 4
#define VFP 16
#define VBP 16
#define VSA 4

/ {
	aliases {
		mipi_cmds_ltk069wxbct02 = &mipi_cmds_ltk069wxbct02;
	};

	mipi_cmds_ltk069wxbct02: mipi-cmds-ltk069wxbct02 {
		alias = <&mipi_cmds_ltk069wxbct02>;

		mipi-cmds-init = /bits/ 8 <
			DELAY(50)
			GEN_L2P(0xF0,0x5A,0x59)
			GEN_L2P(0xF1,0xA5,0xA6)

			0x90
			  0xB0 0x76 0x67 0x00 0x00 0x33 0x33 0x33 0x33 0x31 0x00 0x00 0x9B 0x00 0x00 0x0F
			0x8c
			  0xB1 0x53 0x80 0x00 0x85 0x21 0x00 0x00 0x8B 0x00 0x00 0x5F

			/* FORWARD */
			0x99
			  0xB3 0x23 0x1D 0x05 0x00 0x1C 0x1E 0x1F 0x0F 0x0D 0x13 0x11 0x00 0x00 0x00 0x00
			  0x00 0x00 0x00 0x00 0x00 0x00 0x00 0x00 0x00
			0x99
			  0xB4 0x23 0x1D 0x04 0x00 0x1C 0x1E 0x1F 0x0E 0x0C 0x12 0x10 0x00 0x00 0x00 0x00
			  0x00 0x00 0x00 0x00 0x00 0x00 0x00 0x00 0x00

#if 0
			/* BACKWARD */
			GEN_S1P(0x36,0x04)
			0x99
			  0xB3 0x23 0x1C 0x04 0x00 0x1D 0x1E 0x1F 0x10 0x12 0x0C 0x0E 0x00 0x00 0x00 0x00
			  0x00 0x00 0x00 0x00 0x00 0x00 0x00 0x00 0x00
			0x99
			  0xB4 0x23 0x1C 0x05 0x00 0x1D 0x1E 0x1F 0x11 0x13 0x0D 0x0F 0x00 0x00 0x00 0x00
			  0x00 0x00 0x00 0x00 0x00 0x00 0x00 0x00 0x00
#endif

			0x8b
			  0xB2 0x37 0x0A 0x08 0x8B 0x08 0x00 0x22 0x00 0x44 0xD9

			GEN_L2P(0xB6,0x3C,0x3C)				/* Vcom OTP Vcom */

			0x93
			  0xB7 0x01 0x01 0x09 0x0D 0x11 0x19 0x1D 0x15 0x00 0x25 0x21 0x00 0x00 0x00 0x00
			  0x02 0xF7 0x38

			0x85
			  0xB8 0xB4 0x52 0x02 0xCC			/* 3x VGH, 3x VGL */

			GEN_L2P(0xBA,0x27,0xD3)				/* 2 Power mode */

			0x88
			  0xBD 0x43 0x0E 0x0E 0x7D 0x7D 0x23 0x1E	/* VGMP=VGMN=5.5V, VGH=15V, VGL=-14V */
#if 0
			GEN_S1P(0xC0,0x11)				/* bist mode */
#endif

			0x89
			  0xC1 0x00 0x10 0x10 0x04 0x00 0x32 0x32 0x04	/* PORCH VBP=VFP=16, HBP=HFP=50, HS=VS=4 */

			GEN_L2P(0xC2,0x21,0x81)				/* 600*1282 ??? */

			GEN_L2P(0xC3,0x22,0x30)

			0x89
			  0xC6 0x00 0x00 0xFF 0x00 0x00 0xFF 0x00 0x00

			/* GAMMA 2.2 */
			0xa7
			  0xC8 0x7C 0x6A 0x5C 0x51 0x4E 0x40 0x47 0x32 0x4E 0x4F 0x51 0x6F 0x5D 0x62 0x53
			  0x4D 0x3E 0x2A 0x06 0x7C 0x69 0x5C 0x51 0x4E 0x40 0x47 0x32 0x4E 0x4F 0x51 0x6F
			  0x5D 0x62 0x53 0x4D 0x3E 0x2A 0x06

#if 0
			/* GAMMA 2.0 */
			0xa7
			  0xC8 0x7C 0x6B 0x5F 0x54 0x52 0x44 0x4B 0x37 0x53 0x54 0x56 0x76 0x65 0x6C 0x5E
			  0x58 0x49 0x34 0x06 0x7C 0x6B 0x5F 0x54 0x52 0x44 0x4B 0x37 0x53 0x54 0x56 0x76
			  0x65 0x6C 0x5E 0x58 0x49 0x34 0x06

			/* GAMMA 2.5 */
			0xa7
			  0xC8 0x7C 0x67 0x59 0x4D 0x49 0x3B 0x40 0x2C 0x47 0x48 0x49 0x65 0x50 0x52 0x43
			  0x3D 0x30 0x1C 0x06 0x7C 0x67 0x59 0x4D 0x49 0x3B 0x40 0x2C 0x47 0x48 0x49 0x65
			  0x50 0x52 0x43 0x3D 0x30 0x1C 0x06
#endif

			0x85
			  0xD2 0x63 0x0B 0x08 0x88
#if 0
#ifdef TWO_LANE
			GEN_S1P(0x63,0x24)
#else
			GEN_S1P(0x63,0x04)
#endif
#endif
			0x87
			  0xD4 0x00 0x00 0x00 0x32 0x04 0x51

			GEN_L2P(0xF1,0x5A,0x59)
			GEN_L2P(0xF0,0xA5,0xA6)
		>;
		mipi-cmds-enable = /bits/ 8 <
			DCS_S0P(0x11)		/* Exit sleep */
			DELAY(120)		/* 5 is what spec says */
			DCS_S0P(0x29)		/* MIPI_DCS_SET_DISPLAY_ON */
			DELAY(20)
		>;
		mipi-cmds-disable = /bits/ 8 <
			DCS_S0P(0x28)		/* MIPI_DCS_SET_DISPLAY_OFF */
			DELAY(20)
			DCS_S0P(0x10)		/* Enter sleep */
		>;
	};
};
