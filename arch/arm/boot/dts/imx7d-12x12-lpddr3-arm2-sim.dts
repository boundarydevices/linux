/*
 * Copyright (C) 2015 Freescale Semiconductor, Inc.
 *
 * This program is free software; you can redistribute it and/or modify
 * it under the terms of the GNU General Public License version 2 as
 * published by the Free Software Foundation.
 */

#include "imx7d-12x12-lpddr3-arm2.dts"

/*
 * The sim1 has pin conflicts with flexcan1,flexcan2 and sai1.
 * Need to rework the pin and disable the conflict modules.
 */
&flexcan1 {
        status = "disabled";
};

&flexcan2 {
        status = "disabled";
};

&sai1 {
        status = "disabled";
};

&sim1 {
	status = "okay";
};
