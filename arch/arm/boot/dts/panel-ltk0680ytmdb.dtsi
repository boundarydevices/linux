#include <dt-bindings/display/simple_panel_mipi_cmds.h>

/ {
#ifdef TWO_LANE
	mipi_cmds_ltk0680ytmdb_2lane: mipi-cmds-ltk0680ytmdb_2lane {
#else
	mipi_cmds_ltk0680ytmdb: mipi-cmds-ltk0680ytmdb {
#endif
		mipi-cmds-init = /bits/ 8 <
			DELAY(50)
			GEN_S1P(0xCD,0xAA)
			GEN_S1P(0x65,0x08)
			GEN_S1P(0x3A,0x14)
			GEN_S1P(0x32,0x00)
			GEN_S1P(0x36,0x02)
			GEN_S1P(0x67,0x82)
			GEN_S1P(0x69,0x20)
			GEN_S1P(0x6D,0x01)
			GEN_S1P(0x68,0x00)
			0x94 0x53 0x1F 0x19 0x17 0x09 0x09 0x10 0x14 0x14 0x14 0x09 0x0A 0x06 0x05 0x08 0x07 0x09 0x06 0x05 0x04
			0x94 0x54 0x1F 0x19 0x16 0x17 0x17 0x12 0x11 0x14 0x14 0x16 0x08 0x08 0x07 0x07 0x0A 0x0B 0x08 0x06 0x06
			GEN_S1P(0x29,0x10)
			GEN_S1P(0x2A,0x0C)
			GEN_S1P(0x6C,0x81)
			0x89 0x55 0x00 0x0f 0x00 0x0f 0x00 0x0f 0x00 0x0f
			0x91 0x56 0x12 0x1F 0x12 0x1F 0x12 0x1F 0x12 0x1F 0x12 0x1F 0x12 0x1F 0x12 0x1F 0x12 0x1F
			0x85 0x57 0x00 0x00 0x00 0x00
			GEN_S1P(0x30,0x00)
			GEN_S1P(0x39,0x11)
			GEN_S1P(0x33,0x08)
			GEN_S1P(0x35,0x25)
			GEN_S1P(0x4F,0x51)
			GEN_S1P(0x4E,0x45)
			GEN_S1P(0x41,0x4E)
			GEN_S1P(0x73,0x30)
			GEN_S1P(0x74,0x10)
			GEN_S1P(0x76,0x40)
			GEN_S1P(0x77,0x00)
			GEN_S1P(0x28,0x31)
			GEN_S1P(0x7C,0x80)
			GEN_S1P(0x2E,0x04)
			GEN_S1P(0x4C,0x80)
			GEN_S1P(0x47,0x16)
			GEN_S1P(0x48,0x6C)
			GEN_S1P(0x50,0xC0)
			GEN_S1P(0x78,0x6E)
			GEN_S1P(0x2D,0x31)
#ifdef TWO_LANE
			GEN_S1P(0x63,0x24)
#else
			GEN_S1P(0x63,0x04)
#endif
			GEN_S1P(0x4D,0x00)
		>;
		mipi-cmds-enable = /bits/ 8 <
			DCS_S0P(0x11)		/* Exit sleep */
			DELAY(120)		/* 5 is what spec says */
			DCS_S0P(0x29)		/* MIPI_DCS_SET_DISPLAY_ON */
			DELAY(20)
		>;
		mipi-cmds-disable = /bits/ 8 <
			DCS_S0P(0x28)		/* MIPI_DCS_SET_DISPLAY_OFF */
			DELAY(20)
			DCS_S0P(0x10)		/* Enter sleep */
		>;
	};
};
