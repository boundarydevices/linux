#include <dt-bindings/display/simple_panel_mipi_cmds.h>

#ifdef H499
#define GEN_S1P_2(cmd, param_h499, param_osd) GEN_S1P(cmd, param_h499)
#define DELAY_2(ms_h499, ms_osd) DELAY(ms_h499)
#else
/* original settings for OSD050T2844-70 */
#define GEN_S1P_2(cmd, param_h499, param_osd) GEN_S1P(cmd, param_osd)
#define DELAY_2(ms_h499, ms_osd) DELAY(ms_osd)
#endif

#define VBP	1
/* P0_0 - page 0, no parameters */
#define P0_0_NOP				0x00
#define P0_0_RESET				0x01
#define P0_1_READ_ERRORS			0x05
#define P0_1_READ_DISPLAY_POWER_MODE		0x0a
#define P0_1_READ_DISPLAY_MADCTL		0x0b
#define P0_1_READ_PIXEL_FORMAT			0x0c
#define P0_1_READ_DISPLAY_MODE			0x0d
#define P0_1_READ_DISPLAY_SIGNAL_MODE		0x0e
#define P0_1_READ_DISPLAY_DIAG			0x0f
#define P0_0_SLEEP_IN				0x10
#define P0_0_SLEEP_OUT				0x11
#define P0_0_NORMAL_DISPLAY_MODE_ON		0x13
#define P0_0_ALL_PIXEL_OFF			0x22
#define P0_0_ALL_PIXEL_ON			0x23
#define P0_1_GAMMA_CURVE_SET			0x26
#define P0_0_DISPLAY_OFF			0x28
#define P0_0_DISPLAY_ON				0x29
#define P0_4_COLUMN_ADDRESS_SET			0x2a
#define P0_1_MEMORY_WRITE			0x2c
#define P0_0_TEARING_EFFECT_LINE_OFF		0x34
#define P0_1_TEARING_EFFECT_LINE_ON		0x35
#define P0_1_MEMORY_ACCESS_CONTROL		0x36
#define P0_0_IDLE_MODE_OFF			0x38
#define P0_0_IDLE_MODE_ON			0x39
#define P0_1_INTERFACE_PIXEL_FORMAT		0x3a
#define P0_1_MEMORY_WRITE_CONTINUE		0x3c
#define P0_2_SET_TEAR_SCAN_LINE			0x44
#define P0_2_GET_TEAR_SCAN_LINE			0x45
#define P0_2_WRITE_DISPLAY_BRIGHTNESS		0x51
#define P0_2_READ_DISPLAY_BRIGHTNESS		0x52
#define P0_1_WRITE_CTRL_DISPLAY			0x53
#define P0_1_READ_CTRL_DISPLAY			0x54
#define P0_1_WRITE_POWER_SAVE			0x55
#define P0_1_READ_POWER_SAVE			0x56
#define P0_0_STOP_TRANSITION			0x59
#define P0_2_WRITE_CABC_MINIMUM_BRIGHTNESS	0x5e
#define P0_2_READ_CABC_MINIMUM_BRIGHTNESS	0x5f
#define P0_2_SET_TRANSITION_TIME		0x68
#define P0_2_GET_TRANSITION_TIME		0x69
#define P0_1_WRITE_IDLE_MODE_COLOR		0x80
#define P0_1_READ_IDLE_MODE_COLOR		0x81
#define P0_1_READ_ID1				0xda
#define P0_1_READ_ID2				0xdb
#define P0_1_READ_ID3				0xdc
#define PN_3_GCS_PAGE_SELECT			0xff

/* Set Maximum return packest size */
#define PS_SMRPS				0x37



/ {
	mipi_cmds_osd050t3872: mipi-cmds-osd050t3872 {
		mipi-cmds-init = /bits/ 8 <
			GEN_L3P(PN_3_GCS_PAGE_SELECT, 0x98, 0x81, 0x03)		/* GCS set page 3 */
			GEN_S1P(0x01, 0x00)	/* Page 3 is not documented */
			GEN_S1P(0x02, 0x00)
			GEN_S1P(0x03, 0x56)
			GEN_S1P(0x04, 0x13)
			GEN_S1P(0x05, 0x00)
			GEN_S1P(0x06, 0x06)
			GEN_S1P(0x07, 0x01)
			GEN_S1P(0x08, 0x00)
			GEN_S1P(0x09, 0x30)
			GEN_S1P(0x0A, 0x01)
			GEN_S1P(0x0B, 0x00)
			GEN_S1P(0x0C, 0x30)
			GEN_S1P(0x0D, 0x01)
			GEN_S1P(0x0E, 0x00)
			GEN_S1P(0x0F, 0x1B)
			GEN_S1P(0x10, 0x1B)
			GEN_S1P(0x11, 0x00)
			GEN_S1P(0x12, 0x00)
			GEN_S1P(0x13, 0x00)
			GEN_S1P(0x14, 0x00)
			GEN_S1P(0x15, 0x08)
			GEN_S1P(0x16, 0x08)
			GEN_S1P(0x17, 0x00)
			GEN_S1P(0x18, 0x08)
			GEN_S1P(0x19, 0x00)
			GEN_S1P(0x1A, 0x00)
			GEN_S1P(0x1B, 0x00)
			GEN_S1P(0x1C, 0x00)
			GEN_S1P(0x1D, 0x00)
			GEN_S1P(0x1E, 0x40)
			GEN_S1P(0x1F, 0xC0)
			GEN_S1P(0x20, 0x02)
			GEN_S1P(0x21, 0x05)
			GEN_S1P(0x22, 0x02)
			GEN_S1P(0x23, 0x00)
			GEN_S1P(0x24, 0x87)
			GEN_S1P(0x25, 0x86)
			GEN_S1P(0x26, 0x00)
			GEN_S1P(0x27, 0x00)
			GEN_S1P(0x28, 0x3B)
			GEN_S1P(0x29, 0x03)
			GEN_S1P(0x2A, 0x00)
			GEN_S1P(0x2B, 0x00)
			GEN_S1P(0x2C, 0x00)
			GEN_S1P(0x2D, 0x00)
			GEN_S1P(0x2E, 0x00)
			GEN_S1P(0x2F, 0x00)
			GEN_S1P(0x30, 0x00)
			GEN_S1P(0x31, 0x00)
			GEN_S1P(0x32, 0x00)
			GEN_S1P(0x33, 0x00)
			GEN_S1P(0x34, 0x00)
			GEN_S1P(0x35, 0x00)
			GEN_S1P(0x36, 0x00)
			GEN_S1P(0x37, 0x00)
			GEN_S1P(0x38, 0x00)
			GEN_S1P(0x39, 0x35)
			GEN_S1P(0x3A, 0x01)
			GEN_S1P(0x3B, 0x40)
			GEN_S1P(0x3C, 0x00)
			GEN_S1P(0x3D, 0x01)
			GEN_S1P(0x3E, 0x00)
			GEN_S1P(0x3F, 0x00)
			GEN_S1P(0x40, 0x35)
			GEN_S1P(0x41, 0x88)
			GEN_S1P(0x42, 0x00)
			GEN_S1P(0x43, 0x00)
			GEN_S1P(0x44, 0x1F)
			GEN_S1P(0x50, 0x01)
			GEN_S1P(0x51, 0x23)
			GEN_S1P(0x52, 0x45)
			GEN_S1P(0x53, 0x67)
			GEN_S1P(0x54, 0x89)
			GEN_S1P(0x55, 0xAB)
			GEN_S1P(0x56, 0x01)
			GEN_S1P(0x57, 0x23)
			GEN_S1P(0x58, 0x45)
			GEN_S1P(0x59, 0x67)
			GEN_S1P(0x5A, 0x89)
			GEN_S1P(0x5B, 0xAB)
			GEN_S1P(0x5C, 0xCD)
			GEN_S1P(0x5D, 0xEF)
			GEN_S1P(0x5E, 0x13)
			GEN_S1P(0x5f, 0x06)
			GEN_S1P(0x60, 0x0C)
			GEN_S1P(0x61, 0x0D)
			GEN_S1P(0x62, 0x0E)
			GEN_S1P(0x63, 0x0F)
			GEN_S1P(0x64, 0x02)
			GEN_S1P(0x65, 0x02)
			GEN_S1P(0x66, 0x02)
			GEN_S1P(0x67, 0x02)
			GEN_S1P(0x68, 0x02)
			GEN_S1P(0x69, 0x02)
			GEN_S1P(0x6a, 0x02)
			GEN_S1P(0x6b, 0x02)
			GEN_S1P(0x6c, 0x02)
			GEN_S1P(0x6d, 0x02)
			GEN_S1P(0x6e, 0x05)
			GEN_S1P(0x6f, 0x05)
			GEN_S1P(0x70, 0x05)
			GEN_S1P(0x71, 0x02)
			GEN_S1P(0x72, 0x01)
			GEN_S1P(0x73, 0x00)
			GEN_S1P(0x74, 0x08)
			GEN_S1P(0x75, 0x08)
			GEN_S1P(0x76, 0x0C)
			GEN_S1P(0x77, 0x0D)
			GEN_S1P(0x78, 0x0E)
			GEN_S1P(0x79, 0x0F)
			GEN_S1P(0x7a, 0x02)
			GEN_S1P(0x7b, 0x02)
			GEN_S1P(0x7c, 0x02)
			GEN_S1P(0x7d, 0x02)
			GEN_S1P(0x7e, 0x02)
			GEN_S1P(0x7f, 0x02)
			GEN_S1P(0x80, 0x02)
			GEN_S1P(0x81, 0x02)
			GEN_S1P(0x82, 0x02)
			GEN_S1P(0x83, 0x02)
			GEN_S1P(0x84, 0x05)
			GEN_S1P(0x85, 0x05)
			GEN_S1P(0x86, 0x05)
			GEN_S1P(0x87, 0x02)
			GEN_S1P(0x88, 0x01)
			GEN_S1P(0x89, 0x00)
			GEN_S1P(0x8A, 0x06)
			GEN_L3P(PN_3_GCS_PAGE_SELECT, 0x98, 0x81, 0x04)		/* GCS set page 4 */
			GEN_S1P(0x68, 0xDB)
			GEN_S1P(0x6D, 0x08)
			GEN_S1P(0x70, 0x00)	/* Charge Pump Clock Division */
			GEN_S1P(0x71, 0x00)	/* Charge Pump Clock Division */
			GEN_S1P(0x66, 0xFE)	/* VGH ratio setting */
			GEN_S1P(0x6F, 0x05)
			GEN_S1P(0x82, 0x14)	/* Power control 1 */
			GEN_S1P(0x84, 0x14)	/* Power control 2 */
			GEN_S1P(0x85, 0x14)	/* Power control 3 */
			GEN_S1P(0x32, 0xAC)	/* Source negative channel precharge */
			GEN_S1P(0x8C, 0x80)	/* VCOM control */
			GEN_S1P(0x3C, 0xF5)	/* Regulator Bias control */
			GEN_S1P(0x3A, 0x24)	/* Power saving control */
			GEN_S1P(0xB5, 0x02)	/* Gamma Amplifier Bias control */
			GEN_S1P(0x31, 0x25)	/* Source Amplifier Bias control */
			GEN_S1P(0x88, 0x33)
			GEN_L3P(PN_3_GCS_PAGE_SELECT, 0x98, 0x81, 0x01)		/* GCS set page 1 */
			GEN_S1P(0xb7, 0x03)	/* Select 2 data lanes */
			GEN_S1P(0x22, 0x0A)	/* Set panel operation mode */
			GEN_S1P(0x31, 0x00)	/* Display inversion control */
			GEN_S1P(0x50, 0x73)	/* Power control 1 */
			GEN_S1P(0x51, 0x73)	/* Power control 1 */
			GEN_S1P(0x53, 0xB2)	/* VCOM */
			GEN_S1P(0x55, 0xC3)	/* VCOM */
			GEN_S1P(0x60, 0x1C)	/* Source Timing Adjust */
			GEN_S1P(0x61, 0x00)	/* Source Timing Adjust */
			GEN_S1P(0x62, 0x0D)	/* Source Timing Adjust */
			GEN_S1P(0x63, 0x00)	/* Source Timing Adjust */
			GEN_S1P(0xA0, 0x00)	/* Positive gamma correction */
			GEN_S1P(0xA1, 0x14)	/* Positive gamma correction */
			GEN_S1P(0xA2, 0x27)	/* Positive gamma correction */
			GEN_S1P(0xA3, 0x12)	/* Positive gamma correction */
			GEN_S1P(0xA4, 0x16)	/* Positive gamma correction */
			GEN_S1P(0xA5, 0x2A)	/* Positive gamma correction */
			GEN_S1P(0xA6, 0x1E)	/* Positive gamma correction */
			GEN_S1P(0xA7, 0x1E)	/* Positive gamma correction */
			GEN_S1P(0xA8, 0x99)	/* Positive gamma correction */
			GEN_S1P(0xA9, 0x15)	/* Positive gamma correction */
			GEN_S1P(0xAA, 0x22)	/* Positive gamma correction */
			GEN_S1P(0xAB, 0x87)	/* Positive gamma correction */
			GEN_S1P(0xAC, 0x19)	/* Positive gamma correction */
			GEN_S1P(0xAD, 0x17)	/* Positive gamma correction */
			GEN_S1P(0xAE, 0x4B)	/* Positive gamma correction */
			GEN_S1P(0xAF, 0x1E)	/* Positive gamma correction */
			GEN_S1P(0xB0, 0x26)	/* Positive gamma correction */
			GEN_S1P(0xB1, 0x51)	/* Positive gamma correction */
			GEN_S1P(0xB2, 0x63)	/* Positive gamma correction */
			GEN_S1P(0xB3, 0x39)	/* Positive gamma correction */
			GEN_S1P(0xC0, 0x00)	/* Negative gamma correction */
			GEN_S1P(0xC1, 0x35)	/* Negative gamma correction */
			GEN_S1P(0xC2, 0x44)	/* Negative gamma correction */
			GEN_S1P(0xC3, 0x15)	/* Negative gamma correction */
			GEN_S1P(0xC4, 0x1A)	/* Negative gamma correction */
			GEN_S1P(0xC5, 0x2B)	/* Negative gamma correction */
			GEN_S1P(0xC6, 0x1D)	/* Negative gamma correction */
			GEN_S1P(0xC7, 0x20)	/* Negative gamma correction */
			GEN_S1P(0xC8, 0xAE)	/* Negative gamma correction */
			GEN_S1P(0xC9, 0x23)	/* Negative gamma correction */
			GEN_S1P(0xCA, 0x30)	/* Negative gamma correction */
			GEN_S1P(0xCB, 0xA4)	/* Negative gamma correction */
			GEN_S1P(0xCC, 0x1F)	/* Negative gamma correction */
			GEN_S1P(0xCD, 0x1E)	/* Negative gamma correction */
			GEN_S1P(0xCE, 0x54)	/* Negative gamma correction */
			GEN_S1P(0xCF, 0x28)	/* Negative gamma correction */
			GEN_S1P(0xD0, 0x2B)	/* Negative gamma correction */
			GEN_S1P(0xD1, 0x66)	/* Negative gamma correction */
			GEN_S1P(0xD2, 0x70)	/* Negative gamma correction */
			GEN_S1P(0xD3, 0x39)	/* Negative gamma correction */
			GEN_L3P(PN_3_GCS_PAGE_SELECT, 0x98, 0x81, 0x00)		/* GCS set page 0 */
			GEN_S1P(P0_1_TEARING_EFFECT_LINE_ON, 0x00)


			GEN_S1P(P0_1_INTERFACE_PIXEL_FORMAT, 0x77)		/* Interface pixel format, 24 BPP */
			/* GEN_S1P(P0_1_INTERFACE_PIXEL_FORMAT, 0x66) */	/* Interface pixel format, 18 BPP */
			/* GEN_S1P(P0_1_INTERFACE_PIXEL_FORMAT, 0x55) */	/* Interface pixel format, 16 BPP */
			/* GEN_S1P(P0_1_INTERFACE_PIXEL_FORMAT, 0xC3) */	/* Upside down dispay */
		>;
		mipi-cmds-enable = /bits/ 8 <
			GEN_S0P(P0_0_SLEEP_OUT)		/* Exit sleep */
			DELAY(120)
			GEN_S0P(P0_0_DISPLAY_ON)
			DELAY(10)
		>;
		mipi-cmds-disable = /bits/ 8 <
			GEN_S0P(P0_0_DISPLAY_OFF)
			DELAY(20)
			GEN_S0P(P0_0_SLEEP_IN)		/* Enter sleep */
		>;
		mipi-cmds-detect = /bits/ 8 <
			MRPS(1)
			GEN_L3P(PN_3_GCS_PAGE_SELECT, 0x98, 0x81, 0x04)		/* GCS set page 4 */
			DCS_READ(0xc5, 0x7b)
		>;
	};
};
