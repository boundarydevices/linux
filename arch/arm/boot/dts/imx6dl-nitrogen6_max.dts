/*
 * Copyright 2016 Boundary Devices
 * Copyright 2012 Freescale Semiconductor, Inc.
 * Copyright 2011 Linaro Ltd.
 *
 * The code contained herein is licensed under the GNU General Public
 * License. You may obtain a copy of the GNU General Public License
 * Version 2 or later at the following locations:
 *
 * http://www.opensource.org/licenses/gpl-license.html
 * http://www.gnu.org/copyleft/gpl.html
 */

/dts-v1/;

#include <dt-bindings/interrupt-controller/irq.h>
#include "imx6dl.dtsi"
#include "imx6qdl-nitrogen6_max.dtsi"

/ {
	model = "Freescale i.MX6 DualLite Nitrogen6 Max Board";
	compatible = "fsl,imx6dl-nitrogen6_max", "fsl,imx6dl";
};

&hdmi_core {
	ipu_id = <0>;
};

&ov5640 {
	ipu_id = <0>;
};

&pinctrl_i2c3_ov5640 { /* parallel camera */
	fsl,pins = <
		MX6QDL_PAD_EIM_A17__IPU1_CSI1_DATA12	0xb0b1
		MX6QDL_PAD_EIM_A18__IPU1_CSI1_DATA13	0xb0b1
		MX6QDL_PAD_EIM_A19__IPU1_CSI1_DATA14	0xb0b1
		MX6QDL_PAD_EIM_A20__IPU1_CSI1_DATA15	0xb0b1
		MX6QDL_PAD_EIM_A21__IPU1_CSI1_DATA16	0xb0b1
		MX6QDL_PAD_EIM_A22__IPU1_CSI1_DATA17	0xb0b1
		MX6QDL_PAD_EIM_A23__IPU1_CSI1_DATA18	0xb0b1
		MX6QDL_PAD_EIM_EB2__IPU1_CSI1_DATA19	0xb0b1
		MX6QDL_PAD_EIM_DA10__IPU1_CSI1_DATA_EN	0xb0b1
		MX6QDL_PAD_EIM_A16__IPU1_CSI1_PIXCLK	0xb0b1
		MX6QDL_PAD_EIM_DA11__IPU1_CSI1_HSYNC	0xb0b1
		MX6QDL_PAD_EIM_DA12__IPU1_CSI1_VSYNC	0xb0b1
	>;
};
