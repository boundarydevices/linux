/*
 * Copyright 2018 Boundary Devices, Inc.
 *
 * The code contained herein is licensed under the GNU General Public
 * License. You may obtain a copy of the GNU General Public License
 * Version 2 or later at the following locations:
 *
 * http://www.opensource.org/licenses/gpl-license.html
 * http://www.gnu.org/copyleft/gpl.html
 */
/dts-v1/;

#include "imx6q.dtsi"
#include "imx6qdl-ltch.dtsi"

/ {
	model = "Boundary Devices i.MX6 Quad ltch Board";
	compatible = "boundary,imx6q-ltch", "fsl,imx6q";
};
