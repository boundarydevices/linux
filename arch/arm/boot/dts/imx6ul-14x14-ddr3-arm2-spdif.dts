/*
 * Copyright (C) 2015 Freescale Semiconductor, Inc.
 *
 * This program is free software; you can redistribute it and/or modify
 * it under the terms of the GNU General Public License version 2 as
 * published by the Free Software Foundation.
 */

#include "imx6ul-14x14-ddr3-arm2.dts"

/ {
	sound-spdif {
		compatible = "fsl,imx-audio-spdif";
		model = "imx-spdif";
		spdif-controller = <&spdif>;
		spdif-in;
		spdif-out;
	};
};

&pinctrl_hog {
	/* Pin conflict with SPDIF */
	fsl,pins = <
		MX6UL_PAD_UART1_RTS_B__GPIO1_IO19       0x17059 /* SD1 CD */
		MX6UL_PAD_UART1_CTS_B__GPIO1_IO18       0x17059 /* SD1 WP */
		MX6UL_PAD_GPIO1_IO05__USDHC1_VSELECT    0x17059 /* SD1 VSELECT */
		MX6UL_PAD_CSI_MCLK__GPIO4_IO17          0x17059 /* SD2 CD */
		MX6UL_PAD_CSI_PIXCLK__GPIO4_IO18        0x17059 /* SD2 WP */
		MX6UL_PAD_NAND_ALE__GPIO4_IO10          0x17059 /* SD2 RESECT */

		MX6UL_PAD_GPIO1_IO08__SPDIF_OUT		0x1b0b0 /* SPDIF OUT */
		MX6UL_PAD_GPIO1_IO09__SPDIF_IN		0x1b0b0 /* SPDIF IN */
	>;
};

&spdif {
	pinctrl-names = "default";
	pinctrl-0 = <&pinctrl_spdif>;
	status = "okay";
};
