/*
 * Copyright 2015 Boundary Devices
 *
 * The code contained herein is licensed under the GNU General Public
 * License. You may obtain a copy of the GNU General Public License
 * Version 2 or later at the following locations:
 *
 * http://www.opensource.org/licenses/gpl-license.html
 * http://www.gnu.org/copyleft/gpl.html
 */

/dts-v1/;

#include <dt-bindings/interrupt-controller/irq.h>
#include "imx6dl.dtsi"
#include "imx6qdl-mcs.dtsi"

/ {
	model = "Freescale i.MX6 DualLite MCS Board";
	compatible = "fsl,imx6dl-mcs", "fsl,imx6dl";
};
