/*
 * Copyright 2015 Boundary Devices
 * Copyright 2012 Freescale Semiconductor, Inc.
 * Copyright 2011 Linaro Ltd.
 *
 * The code contained herein is licensed under the GNU General Public
 * License. You may obtain a copy of the GNU General Public License
 * Version 2 or later at the following locations:
 *
 * http://www.opensource.org/licenses/gpl-license.html
 * http://www.gnu.org/copyleft/gpl.html
 */

/dts-v1/;

#include <dt-bindings/interrupt-controller/irq.h>
#include "imx6q.dtsi"
#include "imx6qdl-nitrogen6_som2.dtsi"

/ {
	model = "Freescale i.MX6 Quad Nitrogen6 som2 Board";
	compatible = "fsl,imx6q-nitrogen6_som2", "fsl,imx6q";
};

&sata {
	status = "okay";
};

&v4l2_cap_2 {
	ipu_id = <1>;
};
