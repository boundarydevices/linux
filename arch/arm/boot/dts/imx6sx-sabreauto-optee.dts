/*
 * Copyright 2017 NXP
 *
 * This program is free software; you can redistribute it and/or modify
 * it under the terms of the GNU General Public License version 2 as
 * published by the Free Software Foundation.
 */

#include "imx6sx-sabreauto.dts"

&ocram {
	reg = <0x905000 0x1b000>;
};

&ocrams_ddr {
	reg = <0x904000 0x1000>;
};
