/*
 * Copyright 2016 Boundary Devices
 *
 * The code contained herein is licensed under the GNU General Public
 * License. You may obtain a copy of the GNU General Public License
 * Version 2 or later at the following locations:
 *
 * http://www.opensource.org/licenses/gpl-license.html
 * http://www.gnu.org/copyleft/gpl.html
 */

/dts-v1/;

#include <dt-bindings/interrupt-controller/irq.h>
#include "imx6dl.dtsi"
#include "imx6qdl-hp.dtsi"

/ {
	model = "Freescale i.MX6 DualLite hp Board";
	compatible = "fsl,imx6dl-hp", "fsl,imx6dl";
};
