/*
 * Copyright (C) 2015 Freescale Semiconductor, Inc.
 *
 * This program is free software; you can redistribute it and/or modify
 * it under the terms of the GNU General Public License version 2 as
 * published by the Free Software Foundation.
 */

#include "imx7d-12x12-arm2.dts"


/ {
	sound {
		compatible = "fsl,imx7d-12x12-arm2-wm8958",
			    "fsl,imx-audio-wm8958";
		model = "wm8958-audio";
		cpu-dai = <&sai1>;
		audio-codec = <&codec>;
		codec-master;
		hp-det-gpios = <&gpio1 12 1>;
	};
};

&pinctrl_hog_1{
	/* Pin conflict with SAI */
	fsl,pins = <
			MX7D_PAD_GPIO1_IO12__GPIO1_IO12  0x59
			MX7D_PAD_GPIO1_IO13__GPIO1_IO13  0x59
		>;
};

&sai1 {
	status = "okay";
};
