/*
 * Copyright (C) 2015 Freescale Semiconductor, Inc.
 *
 * This program is free software; you can redistribute it and/or modify
 * it under the terms of the GNU General Public License version 2 as
 * published by the Free Software Foundation.
 */

#include "imx7d-19x19-arm2.dts"

&pinctrl_hog_1{
	/* Pin conflict with SAI */
	fsl,pins = <
			MX7D_PAD_GPIO1_IO13__GPIO1_IO13  0x59
			MX7D_PAD_SD3_STROBE__GPIO6_IO10  0x59
		>;
};

&sai2 {
	status = "okay";
};
