/*
 * Copyright (C) 2015 Freescale Semiconductor, Inc.
 *
 * This program is free software; you can redistribute it and/or modify
 * it under the terms of the GNU General Public License version 2 as
 * published by the Free Software Foundation.
 */

#include "imx7d-sdb.dts"

&sai1{
	status = "disabled";
};

&usdhc3{
	status = "disabled";
};

&uart5{
	status = "disabled";
};

&gpmi{
	status = "okay";
};
