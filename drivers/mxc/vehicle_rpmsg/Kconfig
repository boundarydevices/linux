## drivers/mxc/vehicle_rpmsg/Kconfig
```kconfig
#
# vehicle rpmsg configuration
#

menu "MXC vehicle rpmsg setting"

config VEHICLE_RPMSG
       tristate "NXP RPMSG VEHICLE support"
       select EXTCON
       help
          If you say yes here you get support for the NXP RPMSG
          vehicle module.

config VEHICLE_DRIVER_OREO
	tristate "NXP vehicle driver for android o"
	help
	   If you say yes here, you can get support for vehicle protocol
	   in android o, otherwise it support android p.

endmenu
```

## drivers/net/ethernet/micrel/Kconfig
```kconfig
#
# Micrel device configuration
#

config NET_VENDOR_MICREL
	bool "Micrel devices"
	default y
	depends on (HAS_IOMEM && DMA_ENGINE) || SPI || PCI || HAS_IOMEM || \
		   (ARM && ARCH_KS8695)
	---help---
	  If you have a network (Ethernet) card belonging to this class, say Y.

	  Note that the answer to this question doesn't directly affect the
	  kernel: saying N will just cause the configurator to skip all
	  the questions about Micrel devices. If you say Y, you will be asked
	  for your specific card in the following questions.

if NET_VENDOR_MICREL

config ARM_KS8695_ETHER
	tristate "KS8695 Ethernet support"
	depends on ARM && ARCH_KS8695
	select MII
	---help---
	  If you wish to compile a kernel for the KS8695 and want to
	  use the internal ethernet then you should answer Y to this.

config KS8842
	tristate "Micrel KSZ8841/42 with generic bus interface"
	depends on HAS_IOMEM && DMA_ENGINE
	---help---
	  This platform driver is for KSZ8841(1-port) / KS8842(2-port)
	  ethernet switch chip (managed, VLAN, QoS) from Micrel or
	  Timberdale(FPGA).

config KS8851
	tristate "Micrel KS8851 SPI"
	depends on SPI
	select MII
	select CRC32
	select EEPROM_93CX6
	---help---
	  SPI driver for Micrel KS8851 SPI attached network chip.

config KS8851_MLL
	tristate "Micrel KS8851 MLL"
	depends on HAS_IOMEM
	select MII
	---help---
	  This platform driver is for Micrel KS8851 Address/data bus
	  multiplexed network chip.

config KSZ884X_PCI
	tristate "Micrel KSZ8841/2 PCI"
	depends on PCI
	select MII
	select CRC32
	---help---
	  This PCI driver is for Micrel KSZ8841/KSZ8842 PCI Ethernet chip.

	  To compile this driver as a module, choose M here. The module
	  will be called ksz884x.


config KSZ_STP
	bool "STP support"
	depends on KSZ_SWITCH
	default n
	help
	  Enable STP support.

menuconfig KSZ_SWITCHES
	tristate "Drivers for Microchip KSZ switches"
	---help---
	  Supports Microchip KSZ switches.

if KSZ_SWITCHES

comment "Microchip KSZ switch device drivers"

config KSZ_SWITCH
	bool
	default n

config KSZ_DSA
	bool
	default n

config KSZ_SWITCH_EMBEDDED
	bool
	default n
	select KSZ_SWITCH

config HAVE_KSZ8863
	bool
	default n

config HAVE_SPI_KSZ8863
	bool
	default n
	select HAVE_KSZ8863

config I2C_KSZ8863
	tristate "I2C driver for Microchip KSZ8863 switch"
	select KSZ_SWITCH if !NET_DSA_TAG_TAIL
	select KSZ_DSA if NET_DSA_TAG_TAIL
	select HAVE_KSZ8863
	---help---
	  Supports the Microchip KSZ8863 switch.

config SPI_KSZ8863
	tristate "SPI driver for Microchip KSZ8863 switch"
	select KSZ_SWITCH if !NET_DSA_TAG_TAIL
	select KSZ_DSA if NET_DSA_TAG_TAIL
	select HAVE_SPI_KSZ8863
	---help---
	  Supports the Microchip KSZ8863 switch.

config KSZ8863_EMBEDDED
	bool "Microchip KSZ8863 switch support in network controller"
	depends on I2C_KSZ8863 = n && SPI_KSZ8863 = n && !NET_DSA_TAG_TAIL
	select KSZ_SWITCH_EMBEDDED
	select HAVE_SPI_KSZ8863
	---help---
	  Supports the Microchip KSZ8863 switch used within a network controller.

config SMI_KSZ8863
	bool "Microchip KSZ8863 switch support in network controller, SMI mode"
	depends on I2C_KSZ8863 = n && SPI_KSZ8863 = n && !NET_DSA_TAG_TAIL
	select KSZ_SWITCH_EMBEDDED
	select KSZ_SMI
	select HAVE_KSZ8863
	---help---
	  Supports the Microchip KSZ8863 switch used within a network controller in SMI mode.

endif

endif # NET_VENDOR_MICREL
```

## drivers/net/pcs/Kconfig
```kconfig
# SPDX-License-Identifier: GPL-2.0-only
#
# PCS Layer Configuration
#

menu "PCS device drivers"

config MTIP_BACKPLANE_PHY
	tristate "MoreThanIP copper backplane PHYs"
	help
	  Enable support for the MoreThanIP copper backplane Auto-Negotiation
	  and Link Training blocks, as implemented on the QorIQ and Layerscape
	  SoCs.

config PCS_XPCS
	tristate
	select PHYLINK
	help
	  This module provides helper functions for Synopsys DesignWare XPCS
	  controllers.

config PCS_LYNX
	depends on MTIP_BACKPLANE_PHY || MTIP_BACKPLANE_PHY=n
	tristate
	help
	  This module provides helpers to phylink for managing the Lynx PCS
	  which is part of the Layerscape and QorIQ Ethernet SERDES.

config PCS_RZN1_MIIC
	tristate "Renesas RZ/N1 MII converter"
	depends on OF && (ARCH_RZN1 || COMPILE_TEST)
	help
	  This module provides a driver for the MII converter that is available
	  on RZ/N1 SoCs. This PCS converts MII to RMII/RGMII or can be set in
	  pass-through mode for MII.

config PCS_ALTERA_TSE
	tristate
	help
	  This module provides helper functions for the Altera Triple Speed
	  Ethernet SGMII PCS, that can be found on the Intel Socfpga family.

endmenu
```

## drivers/net/wireless/rtl8712s/Kconfig
```kconfig
config RTL8712S
	tristate "Realtek 8712 SDIO WiFi"
	---help---
	  Help message of RTL8712S
```

## drivers/net/wireless/rtl8712u/Kconfig
```kconfig
config RTL8712U
	tristate "Realtek 8712 USB WiFi"
	depends on USB
	---help---
	  Help message of RTL8712U
```

## drivers/net/wireless/rtlwifi/rtl8821as/Kconfig
```kconfig
config RTL8821AS
	tristate "Realtek 8821A SDIO WiFi"
	---help---
	  Help message of RTL8821AS
```

## drivers/pci/controller/mobiveil/Kconfig
```kconfig
# SPDX-License-Identifier: GPL-2.0

menu "Mobiveil PCIe Core Support"
	depends on PCI

config PCIE_MOBIVEIL
	bool

config PCIE_MOBIVEIL_HOST
	bool
	depends on PCI_MSI_IRQ_DOMAIN
	select PCIE_MOBIVEIL

config PCIE_MOBIVEIL_EP
	bool
	depends on PCI_ENDPOINT
	select PCIE_MOBIVEIL

config PCIE_MOBIVEIL_PLAT
	bool "Mobiveil AXI PCIe controller"
	depends on ARCH_ZYNQMP || COMPILE_TEST
	depends on OF
	depends on PCI_MSI_IRQ_DOMAIN
	select PCIE_MOBIVEIL_HOST
	help
	  Say Y here if you want to enable support for the Mobiveil AXI PCIe
	  Soft IP. It has up to 8 outbound and inbound windows
	  for address translation and it is a PCIe Gen4 IP.

config PCIE_LAYERSCAPE_GEN4
	bool "Freescale Layerscape PCIe Gen4 controller in RC mode"
	depends on PCI
	depends on OF && (ARM64 || ARCH_LAYERSCAPE)
	depends on PCI_MSI_IRQ_DOMAIN
	select PCIE_MOBIVEIL_HOST
	help
	  Say Y here if you want PCIe Gen4 controller as host support on
	  Layerscape SoCs.

config PCIE_LAYERSCAPE_GEN4_EP
	bool "Freescale Layerscape PCIe Gen4 controller in EP mode"
	depends on PCI
	depends on OF && (ARM64 || ARCH_LAYERSCAPE)
	depends on PCI_ENDPOINT
	select PCIE_MOBIVEIL_EP
	help
	  Say Y here if you want PCIe Gen4 controller as endpoint support on
	  Layerscape SoCs.
endmenu
```

## drivers/pwm/Kconfig
```kconfig
menuconfig PWM
	bool "PWM Support"
	depends on !MACH_JZ4740 && !PUV3_PWM
	help
	  This enables PWM support through the generic PWM framework.
	  You only need to enable this, if you also want to enable
	  one or more of the PWM drivers below.

	  If unsure, say N.

if PWM

config PWM_IMX
	tristate "i.MX pwm support"
	depends on ARCH_MXC
	help
	  Generic PWM framework driver for i.MX.

	  To compile this driver as a module, choose M here: the module
	  will be called pwm-imx.

endif
```

## drivers/soc/imx/Kconfig
```kconfig
menu "i.MX SoC drivers"

config IMX7_PM_DOMAINS
	bool "i.MX7 PM domains"
	depends on SOC_IMX7D || (COMPILE_TEST && OF)
	depends on PM
	select PM_GENERIC_DOMAINS
	default y if SOC_IMX7D

config HAVE_IMX_MU
	bool

config HAVE_IMX_SC
	bool

config HAVE_IMX_SC_PD
	bool

config HAVE_IMX_RPMSG
	select RPMSG_VIRTIO
	select RPMSG
	bool
endmenu
```

## drivers/staging/android/ion/heaps/Kconfig
```kconfig
# SPDX-License-Identifier: GPL-2.0
config ION_SYSTEM_HEAP
	tristate "Ion system heap"
	depends on ION
	help
	  Choose this option to enable the Ion system heap. The system heap
	  is backed by pages from the buddy allocator. If in doubt, say Y.

config ION_CMA_HEAP
	tristate "Ion CMA heap support"
	depends on ION && DMA_CMA
	help
	  Choose this option to enable CMA heaps with Ion. This heap is backed
	  by the Contiguous Memory Allocator (CMA). If your system has these
	  regions, you should say Y here.

config ION_UNMAPPED_HEAP
	tristate "ION unmapped heap support"
	depends on ION && (ARM || ARM64)
	help
	   Choose this option to enable UNMAPPED heaps with Ion. This heap is
	   backed in specific memory pools, carveout from the Linux memory.
	   Unless you know your system has these regions, you should say N here.
```

## drivers/staging/anx78xx/Kconfig
```kconfig
config DRM_ANX78XX
	tristate "Analogix ANX78XX bridge"
	help
       	ANX78XX is a HD video transmitter chip over micro-USB
		connector for smartphone device.
```

## drivers/staging/iio/imu/Kconfig
```kconfig
#
# IIO imu drivers configuration
#
menu "Inertial measurement units"
source "drivers/staging/iio/imu/inv_mpu/Kconfig"
endmenu
```

## drivers/staging/nanohub/Kconfig
```kconfig
config NANOHUB
	tristate "Nanohub"
	select IIO
	default N
	help
	  Enable support for the nanohub sensorhub driver.

	  This driver supports the android nanohub sensorhub.

	  If in doubt, say N here.

if NANOHUB

config NANOHUB_SPI
	bool "Nanohub SPI"
	default Y
	help
	  Enable nanohub SPI support.

	  If in doubt, say Y here.

endif # NANOHUB
```

## drivers/staging/npu/Kconfig
```kconfig
menu "Amlogic NPU Support"

config AMLOGIC_NPU
	tristate "amlogic NPU module"
	default m
	help
	  Driver for NPU.

endmenu
```

## drivers/thermal/mediatek/Kconfig
```kconfig
config MTK_THERMAL
	tristate "MediaTek thermal drivers"
	depends on THERMAL_OF
	help
	  This is the option for MediaTek thermal software solutions.
	  Please enable corresponding options to get temperature
	  information from thermal sensors or turn on throttle
	  mechaisms for thermal mitigation.

if MTK_THERMAL

config MTK_SOC_THERMAL
	tristate "AUXADC temperature sensor driver for MediaTek SoCs"
	depends on HAS_IOMEM
	help
	  Enable this option if you want to get SoC temperature
	  information for MediaTek platforms.
	  This driver configures thermal controllers to collect
	  temperature via AUXADC interface.

config MTK_LVTS_THERMAL
        tristate "LVTS Thermal Driver for MediaTek SoCs"
        depends on HAS_IOMEM
        help
          Enable this option if you want to get SoC temperature
          information for supported MediaTek platforms.
          This driver configures LVTS (Low Voltage Thermal Sensor)
          thermal controllers to collect temperatures via ASIF
          (Analog Serial Interface).

config MTK_LVTS_THERMAL_DEBUGFS
       bool "LVTS thermal debugfs"
       depends on MTK_LVTS_THERMAL && DEBUG_FS
       help
         Enable this option to debug the internals of the device driver.

config MTK_PMIC_THERMAL
	tristate "PMIC thermal sensor driver for MediaTek SoCs"
	depends on MT635X_EFUSE
	depends on MEDIATEK_MT635X_AUXADC
	help
	  Enable this option if you want to get PMIC temperature
	  for MediaTek platforms.
	  This driver reads the voltage value from PMIC AUXADC channels,
	  and converts raw value to PMIC temperature via PMIC efuse data.
endif
```

## drivers/usbc/Kconfig
```kconfig
#
# Kconfig for MAX77958 usbc devices
#
config USBC_MAX77958
	bool "Maxim Integrated MAX77958 Support"
	depends on MFD_MAX77958
	help
	  Say yes here to add support for Maxim Integrated MAX77958.
	  This is a complete solution for USB Type-C CC detection and
	  PD protocol implementation.
	  This driver provides common support for accessing the device,
	  additional drivers must be enabled in order to use the functionality
	  of the device.
```

## drivers/video/Kconfig
```kconfig
# SPDX-License-Identifier: GPL-2.0-only
#
# Video configuration
#

menu "Graphics support"

config APERTURE_HELPERS
	bool
	help
	  Support tracking and hand-over of aperture ownership. Required
	  by graphics drivers for firmware-provided framebuffers.

if HAS_IOMEM

config HAVE_FB_ATMEL
	bool

source "drivers/char/agp/Kconfig"

source "drivers/gpu/vga/Kconfig"

source "drivers/gpu/host1x/Kconfig"
source "drivers/gpu/imx/Kconfig"

source "drivers/gpu/drm/Kconfig"

menu "Frame buffer Devices"
source "drivers/video/fbdev/Kconfig"
endmenu

source "drivers/video/backlight/Kconfig"

config VGASTATE
       tristate
       default n

config DVI_TFP410
	tristate "tfp410 - Lowlevel DVI output control"
	help
	  This initializes the tfp410 i2c for output.

config SN65DSI83
	tristate "Mipi to LVDS bridge (SN65DSI83)"
	depends on I2C
	help
	  This initializes the Texas Instruments SN65DSI83 bridge for output.

config TC358778
	tristate "RGB to MIPI bridge (TC358778)"
	depends on I2C
	help
	  This initializes the Toshiba TC358778 bridge for output.

config VIDEOMODE_HELPERS
	bool

config HDMI
	bool

endif # HAS_IOMEM

if VT
	source "drivers/video/console/Kconfig"
endif

if FB || SGI_NEWPORT_CONSOLE
	source "drivers/video/logo/Kconfig"

endif


endmenu
```

## drivers/video/mxc/Kconfig
```kconfig
config FB_MXC
	tristate "MXC Framebuffer support"
	depends on FB
	select FB_CFB_FILLRECT
	select FB_CFB_COPYAREA
	select FB_CFB_IMAGEBLIT
	select FB_MODE_HELPERS
	default y
	help
	  This is a framebuffer device for the MXC LCD Controller.
	  See <http://www.linux-fbdev.org/> for information on framebuffer
	  devices.

	  If you plan to use the LCD display with your MXC system, say
	  Y here.

config FB_MXC_SYNC_PANEL
	depends on FB_MXC
	tristate "Synchronous Panel Framebuffer"

config FB_MXC_LDB
	tristate "MXC LDB"
	depends on FB_MXC_SYNC_PANEL
	depends on MXC_IPU_V3

config FB_MXC_HDMI
	depends on FB_MXC_SYNC_PANEL
	depends on MXC_IPU_V3
	depends on I2C
	tristate "MXC HDMI driver support"
	select MFD_MXC_HDMI
	help
	  Driver for the on-chip MXC HDMI controller.

config FB_MXC_EDID
     depends on FB_MXC && I2C
     tristate "MXC EDID support"
     default y
```
