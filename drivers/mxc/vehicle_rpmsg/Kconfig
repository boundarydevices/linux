## scripts/amlogic/configs/meson64_small_defconfig
```kconfig
CONFIG_SYSVIPC=y
CONFIG_NO_HZ=y
CONFIG_HIGH_RES_TIMERS=y
CONFIG_BSD_PROCESS_ACCT=y
CONFIG_IKCONFIG=y
CONFIG_LOG_BUF_SHIFT=19
CONFIG_CGROUPS=y
CONFIG_CGROUP_DEBUG=y
CONFIG_CGROUP_FREEZER=y
CONFIG_CGROUP_CPUACCT=y
CONFIG_CGROUP_SCHED=y
CONFIG_RT_GROUP_SCHED=y
CONFIG_BLK_DEV_INITRD=y
CONFIG_EMBEDDED=y
# CONFIG_COMPAT_BRK is not set
CONFIG_PROFILING=y
CONFIG_JUMP_LABEL=y
CONFIG_MODULES=y
CONFIG_MODULE_UNLOAD=y
CONFIG_SCHED_MC=y
CONFIG_NR_CPUS=8
CONFIG_PREEMPT=y
CONFIG_DEFAULT_MMAP_MIN_ADDR=32768
CONFIG_CMA=y
CONFIG_ZSMALLOC=y
CONFIG_SECCOMP=y
CONFIG_BINFMT_MISC=y
# CONFIG_SUSPEND is not set
CONFIG_CPU_FREQ=y
CONFIG_AMLOGIC_DRIVER=y
CONFIG_AMLOGIC_IOMAP=y
CONFIG_AMLOGIC_REG_ACCESS=y
CONFIG_AMLOGIC_CLK=y
CONFIG_UEVENT_HELPER_PATH="/sbin/hotplug"
CONFIG_DEVTMPFS=y
CONFIG_DEVTMPFS_MOUNT=y
CONFIG_DMA_CMA=y
# CONFIG_BLK_DEV is not set
CONFIG_MD=y
CONFIG_BLK_DEV_DM=y
CONFIG_DM_CRYPT=y
CONFIG_DM_VERITY=y
CONFIG_INPUT_FF_MEMLESS=y
CONFIG_INPUT_POLLDEV=y
# CONFIG_INPUT_MOUSEDEV is not set
CONFIG_INPUT_EVDEV=y
# CONFIG_INPUT_KEYBOARD is not set
# CONFIG_INPUT_MOUSE is not set
# CONFIG_DEVMEM is not set
# CONFIG_DEVKMEM is not set
CONFIG_HW_RANDOM=y
# CONFIG_HWMON is not set
CONFIG_MFD_SYSCON=y
# CONFIG_HID is not set
# CONFIG_USB_SUPPORT is not set
CONFIG_UIO=y
CONFIG_UIO_PDRV_GENIRQ=y
CONFIG_VIRTIO_MMIO=y
CONFIG_MAILBOX=y
# CONFIG_IOMMU_SUPPORT is not set
CONFIG_PM_DEVFREQ=y
CONFIG_DEVFREQ_GOV_SIMPLE_ONDEMAND=y
CONFIG_DEVFREQ_GOV_PERFORMANCE=y
CONFIG_DEVFREQ_GOV_POWERSAVE=y
CONFIG_DEVFREQ_GOV_USERSPACE=y
CONFIG_RESET_CONTROLLER=y
CONFIG_EXT2_FS=y
CONFIG_EXT3_FS=y
CONFIG_EXT3_FS_POSIX_ACL=y
CONFIG_EXT3_FS_SECURITY=y
CONFIG_FANOTIFY=y
CONFIG_QUOTA=y
CONFIG_QFMT_V2=y
CONFIG_AUTOFS4_FS=y
CONFIG_FUSE_FS=y
CONFIG_ISO9660_FS=y
CONFIG_JOLIET=y
CONFIG_ZISOFS=y
CONFIG_UDF_FS=y
CONFIG_MSDOS_FS=y
CONFIG_VFAT_FS=y
CONFIG_TMPFS=y
CONFIG_TMPFS_POSIX_ACL=y
CONFIG_ECRYPT_FS=y
CONFIG_CRAMFS=y
CONFIG_PSTORE=y
CONFIG_PSTORE_CONSOLE=y
CONFIG_PSTORE_RAM=y
CONFIG_NLS_CODEPAGE_437=y
CONFIG_NLS_ISO8859_1=y
CONFIG_PRINTK_TIME=y
CONFIG_DEBUG_INFO=y
CONFIG_SCHEDSTATS=y
CONFIG_TIMER_STATS=y
CONFIG_FTRACE_SYSCALLS=y
CONFIG_STACK_TRACER=y
CONFIG_FUNCTION_PROFILER=y
CONFIG_KGDB=y
CONFIG_KGDB_TESTS=y
CONFIG_KEYS=y
CONFIG_SECURITY=y
CONFIG_SECURITYFS=y
CONFIG_SECURITY_NETWORK=y
CONFIG_SECURITY_PATH=y
CONFIG_CRYPTO_CRYPTD=y
CONFIG_CRYPTO_AUTHENC=y
CONFIG_CRYPTO_CCM=y
CONFIG_CRYPTO_GCM=y
CONFIG_CRYPTO_CMAC=y
CONFIG_CRYPTO_MICHAEL_MIC=y
CONFIG_CRYPTO_SHA1=y
CONFIG_CRYPTO_ARC4=y
CONFIG_CRYPTO_DES=y
CONFIG_CRYPTO_TWOFISH=y
CONFIG_CRYPTO_DEFLATE=y
CONFIG_CRYPTO_ANSI_CPRNG=y
CONFIG_CRC_CCITT=y
CONFIG_CRC_T10DIF=y
CONFIG_CRC7=y
CONFIG_LIBCRC32C=y
```

## scripts/amlogic/configs/meson64_tiny_defconfig
```kconfig
# CONFIG_LOCALVERSION_AUTO is not set
CONFIG_SYSVIPC=y
CONFIG_NO_HZ=y
CONFIG_HIGH_RES_TIMERS=y
CONFIG_BSD_PROCESS_ACCT=y
CONFIG_IKCONFIG=y
CONFIG_LOG_BUF_SHIFT=19
CONFIG_BLK_DEV_INITRD=y
CONFIG_EMBEDDED=y
# CONFIG_SLUB_DEBUG is not set
# CONFIG_COMPAT_BRK is not set
CONFIG_PROFILING=y
CONFIG_JUMP_LABEL=y
CONFIG_MODULES=y
CONFIG_MODULE_UNLOAD=y
CONFIG_SCHED_MC=y
CONFIG_NR_CPUS=8
CONFIG_PREEMPT=y
CONFIG_DEFAULT_MMAP_MIN_ADDR=32768
CONFIG_CMA=y
CONFIG_ZSMALLOC=y
CONFIG_SECCOMP=y
CONFIG_BINFMT_MISC=y
# CONFIG_SUSPEND is not set
CONFIG_CPU_FREQ=y
CONFIG_AMLOGIC_DRIVER=y
CONFIG_AMLOGIC_IOMAP=y
CONFIG_AMLOGIC_REG_ACCESS=y
CONFIG_AMLOGIC_CLK=y
CONFIG_UEVENT_HELPER_PATH="/sbin/hotplug"
CONFIG_DEVTMPFS=y
CONFIG_DEVTMPFS_MOUNT=y
CONFIG_DMA_CMA=y
# CONFIG_BLK_DEV is not set
# CONFIG_INPUT_MOUSEDEV is not set
# CONFIG_INPUT_KEYBOARD is not set
# CONFIG_INPUT_MOUSE is not set
# CONFIG_DEVMEM is not set
# CONFIG_DEVKMEM is not set
CONFIG_HW_RANDOM=y
# CONFIG_HWMON is not set
CONFIG_MFD_SYSCON=y
# CONFIG_HID is not set
# CONFIG_USB_SUPPORT is not set
# CONFIG_IOMMU_SUPPORT is not set
CONFIG_RESET_CONTROLLER=y
# CONFIG_DMIID is not set
# CONFIG_FILE_LOCKING is not set
# CONFIG_DNOTIFY is not set
# CONFIG_INOTIFY_USER is not set
CONFIG_ISO9660_FS=y
CONFIG_JOLIET=y
CONFIG_ZISOFS=y
CONFIG_UDF_FS=y
CONFIG_MSDOS_FS=y
CONFIG_VFAT_FS=y
CONFIG_TMPFS=y
CONFIG_TMPFS_POSIX_ACL=y
# CONFIG_MISC_FILESYSTEMS is not set
CONFIG_NLS_CODEPAGE_437=y
CONFIG_NLS_ISO8859_1=y
CONFIG_PRINTK_TIME=y
CONFIG_DEBUG_INFO=y
CONFIG_DEBUG_FS=y
# CONFIG_SCHED_DEBUG is not set
# CONFIG_DEBUG_PREEMPT is not set
# CONFIG_FTRACE is not set
CONFIG_CRC16=y
# CONFIG_XZ_DEC_X86 is not set
# CONFIG_XZ_DEC_POWERPC is not set
# CONFIG_XZ_DEC_IA64 is not set
# CONFIG_XZ_DEC_ARM is not set
# CONFIG_XZ_DEC_ARMTHUMB is not set
# CONFIG_XZ_DEC_SPARC is not set
```

## sound/soc/amlogic/Kconfig
```kconfig
#
# Amlogic SoC audio configuration
#

menuconfig AMLOGIC_SND_SOC
	bool "Amlogic ASoC"
	default n
	help
	  Say Y or M if you want to add support for codecs attached to
	  the Amlogic Asoc interface. You will also need
	  to select the audio interfaces to support below.

if AMLOGIC_SND_SOC

config AMLOGIC_SND_SOC_MESON
	bool "Amlogic Meson Asoc"
	depends on AMLOGIC_SND_SOC
	default n
	help
	  Say Y or M if you want to add support for meson arch to the
	  Amlogic Asoc Interface. it is for old audio arch, less than
	  kernel4.9.

config AMLOGIC_SND_SOC_AUGE
	bool "Amlogic Auge Asoc"
	depends on AMLOGIC_SND_SOC
	default n
	help
	  Say Y or M if you want to add support for audio arch Auge
	  to the Amlogic Asoc Interface. it is a new audio arch to
	  distinguish Meson audio arch. it is base on kernel 4.9

# All the supported SoCs
source "sound/soc/amlogic/meson/Kconfig"
source "sound/soc/amlogic/auge/Kconfig"
source "sound/soc/amlogic/common/Kconfig"

endif # AMLOGIC_SND_SOC
```

## sound/soc/amlogic/auge/Kconfig
```kconfig
menuconfig AMLOGIC_SND_SOC_AUGE
	bool "Amlogic Auge ASoC"
	default n
	help
		Say Y or M if you want to add support for codecs attached to
		the Amlogic Asoc interface. You will also need
		to select the audio interfaces to support below.
```

## sound/soc/amlogic/common/Kconfig
```kconfig
menuconfig AMLOGIC_SND_SOC_COMMON
        bool "Amlogic Common for ASoC"
        default n
        help
                Say Y or M if you want to add support for common interface attached to
                the Amlogic Asoc interface. You will also need
                to select the audio interfaces to support below.
```

## sound/soc/amlogic/meson/Kconfig
```kconfig
menuconfig AMLOGIC_SND_SOC_MESON
	bool "Amlogic Meson ASoC"
	default n
	help
	  Say Y or M if you want to add support for codecs attached to
	  the Amlogic Asoc interface. You will also need
	  to select the audio interfaces to support below.

if AMLOGIC_SND_SOC_MESON

config AMLOGIC_SND_SPLIT_MODE
	bool "AIU split/interleave mode"
	depends on AMLOGIC_SND_SOC_MESON
	default n
	help
	  Say Y to enable AIU split mode. If not, it is normal  block mode.
	  Say Y to enable AIU split mode. If not, it is normal  block mode.
	  Say Y to enable AIU split mode. If not, it is normal  block mode.
	  Say Y to enable AIU split mode. If not, it is normal  block mode.

config AMLOGIC_SND_SPLIT_MODE_MMAP
	bool "AIU split/interleave and mmap mode"
	depends on AMLOGIC_SND_SOC_MESON
	default n
	help
	  Say Y to enable AIU split mode. If not, it is normal  block mode.
	  Say Y to enable mmap mode. If not, it is copy mode.
	  Say Y to enable AIU split mode. If not, it is normal  block mode.
	  Say Y to enable mmap mode. If not, it is copy mode.

endif # AMLOGIC_SND_SOC_MESON
```

## sound/soc/codecs/amlogic/Kconfig
```kconfig
menuconfig AMLOGIC_SND_SOC_CODECS
	bool "AMLOGIC CODEC drivers"
	default n
	help
	  Say Y or M if you want to add support for codecs attached to
	  the Amlogic Asoc interface. You will also need
	  to select the audio interfaces to support below.

#if AMLOGIC_SND_SOC_CODECS

config AMLOGIC_SND_CODEC_DUMMY_CODEC
	bool "Amlogic Audio dummy codec"
	depends on AMLOGIC_SND_SOC_CODECS
	default n
	help
		Amlogic Audio codec,
		dummy codec,
		dummy codec,
		this codec is internal

config AMLOGIC_SND_CODEC_PCM2BT
	bool "Amlogic Audio pcm2bt codec"
	depends on AMLOGIC_SND_SOC_CODECS
	default n
	help
		Amlogic Audio codec,
		pcm2bt codec,
		pcm2bt codec,
		this codec is internal

config AMLOGIC_SND_CODEC_PDM_DUMMY_CODEC
        bool "Amlogic Audio pdm dummy codec"
        depends on AMLOGIC_SND_SOC_CODECS
	default n
        help
                Amlogic Audio pdm codec,
                pdm dummy codec,
                pdm dummy codec,
                this codec is internal

config AMLOGIC_SND_CODEC_AMLT9015
	bool "Amlogic Audio AMLT9015 codec"
	depends on AMLOGIC_SND_SOC_CODECS
	default n
	help
		Amlogic Audio codec,
		AMLT9015 codec,
		AMLT9015 codec,
		this codec is internal

config AMLOGIC_SND_CODEC_AMLT9015S
        bool "Amlogic Audio AMLT9015S codec"
        depends on AMLOGIC_SND_SOC_CODECS
        default n
        help
                Amlogic Audio codec,
                AMLT9015S codec,
                AMLT9015S codec,
                this codec is internal

config AMLOGIC_SND_CODEC_PMU3
        bool "Amlogic Audio AML PMU3 codec"
        depends on AMLOGIC_SND_SOC_CODECS
	default n
        help
                Amlogic Audio codec,
                AML PMU3 codec,
                AML PMU3 codec,
                this codec is internal

config AMLOGIC_SND_SOC_TAS5805
	bool "Texas Instruments TAS5805 amplifier"
	depends on AMLOGIC_SND_SOC_CODECS
	depends on I2C
	default n
	help
		Enable support for Texas Instruments TAS5805 CODEC.
		Select this if your TAS5805 is connected via an I2C bus.
                Enable support for Texas Instruments TAS5805 CODEC.
                Select this if your TAS5805 is connected via an I2C bus.

config AMLOGIC_SND_CODEC_TXLX_ACODEC
	bool "Amlogic Audio txlx acodec"
	depends on AMLOGIC_SND_SOC_CODECS
	default n
	help
		Amlogic Audio codec,
		AML txlx acodec,
		AML txlx acodec,
		this codec is internal

config AMLOGIC_SND_CODEC_TL1_ACODEC
	bool "Amlogic Audio tl1 acodec"
	depends on AMLOGIC_SND_SOC_CODECS
	default n
	help
		Amlogic Audio codec,
		AML tl1 acodec,
		AML tl1 acodec,
		this codec is internal

#Third part codecs
# Amlogic add codecs

config AMLOGIC_SND_SOC_TAS5782M
	bool "Texas Instruments TAS5782M amplifier"
	depends on AMLOGIC_SND_SOC_CODECS
	depends on I2C
	default n
	help
		Enable support for Texas Instruments TAS5782M CODEC.
		Select this if your TAS5782M is connected via an I2C bus.
		Enable support for Texas Instruments TAS5782M CODEC.
		Select this if your TAS5782M is connected via an I2C bus.

config AMLOGIC_SND_SOC_TAS5707
	bool "Texas Instruments TAS5707 amplifier"
	depends on AMLOGIC_SND_SOC_CODECS
	depends on I2C
	default n
	help
		Enable support for Texas Instruments TAS5707 CODEC.
		Select this if your TAS5707 is connected via an I2C bus.
                Enable support for Texas Instruments TAS5707 CODEC.
                Select this if your TAS5707 is connected via an I2C bus.

config AMLOGIC_SND_SOC_TLV320ADC3101
	bool "Texas Instruments TLV320ADC3101"
	depends on AMLOGIC_SND_SOC_CODECS
	depends on I2C
	default n
	help
		Enable Support for Texas INstruments TLV320ADC3101 CODEC.
		Select this if your TLV320ADC3101 is connected via an I2C bus.
		Enable Support for Texas INstruments TLV320ADC3101 CODEC.
		Select this if your TLV320ADC3101 is connected via an I2C bus.

config AMLOGIC_SND_SOC_PCM186X
	bool "Texas Instruments PCM186X "
	depends on AMLOGIC_SND_SOC_CODECS
	depends on I2C
	default n
	help
		Enable support for Texas Instruments PCM186X CODEC.
		Select this if your PCM186X is connected via an I2C bus.
		Enable support for Texas Instruments PCM186X CODEC.
		Select this if your PCM186X is connected via an I2C bus.

config AMLOGIC_SND_SOC_SSM3525
	bool "Analog Devices SSM3525 "
	depends on AMLOGIC_SND_SOC_CODECS
	depends on I2C
	default n
	help
		Enable support for SSM3525 CODEC.
		Select this if your SSM3525 is connected via an I2C bus.
		Enable support for SSM3525 CODEC.
		Select this if your SSM3525 is connected via an I2C bus.

config AMLOGIC_SND_SOC_SSM3515
	bool "Analog Devices SSM3515 "
	depends on AMLOGIC_SND_SOC_CODECS
	depends on I2C
	default n
	help
		Enable support for SSM3515 CODEC.
		Select this if SSM3515 is connected via an I2C bus.
		Enable support for SSM3515 CODEC.
		Select this if SSM3515 is connected via an I2C bus.

config AMLOGIC_SND_SOC_TAS575X
	bool "Texas Instruments TAS575X"
	depends on AMLOGIC_SND_SOC_CODECS
	depends on I2C
	default n
	help
		Enable Support for Texas INstruments TAS575X CODEC.
		Select this if your TAS575X is connected via an I2C bus.
		Enable Support for Texas INstruments TAS575X CODEC.
		Select this if your TAS575X is connected via an I2C bus.

config AMLOGIC_SND_SOC_ES7243
	bool "EVEREST SEMI ES7243"
	depends on AMLOGIC_SND_SOC_CODECS
	depends on I2C
	default n
	help
		Enable Support for EVEREST SEMI ES7243 CODEC.
		Select this if your ES7243 is connected via an I2C bus.
		Enable Support for EVEREST SEMI ES7243 CODEC.
		Select this if your ES7243 is connected via an I2C bus.

config AMLOGIC_SND_SOC_AD82584F
		bool "ESMT AD82584F"
		depends on AMLOGIC_SND_SOC_CODECS
		depends on I2C
		default n
		help
		Enable Support for ESMT AD82584f CODEC.
		Select this if your AD82584F is connected via an I2C bus.

config AMLOGIC_SND_SOC_CS42528
	bool "Cirrus Logic CS42528"
	depends on AMLOGIC_SND_SOC_CODECS
	depends on I2C
	default n
	help
		Enable Support for Cirrus Logic CS42528 CODEC.
		Select this if your CS425X8 is connected via an I2C bus.
		Enable Support for Cirrus Logic CS42528 CODEC.
		Select this if your CS42528 is connected via an I2C bus.
#endif #AMLOGIC_SND_SOC_CODECS
```
