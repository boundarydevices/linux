## drivers/media/platform/mediatek/mdp3/Kconfig
```kconfig
# SPDX-License-Identifier: GPL-2.0-only
config VIDEO_MEDIATEK_MDP3
	tristate "MediaTek MDP v3 driver"
	depends on MTK_IOMMU || COMPILE_TEST
	depends on VIDEO_DEV
	depends on HAS_DMA
	depends on REMOTEPROC
	depends on MTK_MMSYS
	depends on MTK_CMDQ
	depends on MTK_SCP
	select VIDEOBUF2_DMA_CONTIG
	select V4L2_MEM2MEM_DEV
	default n
	help
	    It is a v4l2 driver and present in MediaTek MT8183 SoC.
	    The driver supports scaling and color space conversion.

	    To compile this driver as a module, choose M here: the
	    module will be called mtk-mdp3.

config VIDEO_MEDIATEK_MDP3_CAP
	bool "MediaTek MDP v3 capture driver"
	depends on VIDEO_MEDIATEK_MDP3
	depends on MTK_HDMI_RX
	default n
	help
	    It is a v4l2 capture device driver for hdmirx and build
	    in mtk-mdp3.
```

## drivers/media/platform/mtk-isp/Kconfig
```kconfig
config MTK_SENINF
	tristate "MediaTek sensor interface driver"
	depends on VIDEO_V4L2 && VIDEO_V4L2_SUBDEV_API
	depends on MEDIA_CAMERA_SUPPORT
	depends on ARCH_MEDIATEK || COMPILE_TEST
	depends on OF
	select V4L2_FWNODE
	default n
	help
	  This driver provides a MIPI CSI-2 receiver interface to connect
	  an external camera module with MediaTek's MT8183 ISP SoC. It is
	  able to handle multiple cameras at the same time.

config MTK_CAMSV30
        tristate "MediaTek ISP3.0 CAMSV driver"
        depends on VIDEO_V4L2 && VIDEO_V4L2_SUBDEV_API
        depends on ARCH_MEDIATEK
        depends on PM
        select VIDEOBUF2_VMALLOC
        select VIDEOBUF2_DMA_CONTIG
        select MTK_SENINF
        select PHY_MTK_CDPHY
        default n
        help
          This driver provides a path to bypass the SoC ISP so that
          image data come from the SENINF can go directly into memory
          without any image processing.

config MTK_CAMSV50
	tristate "MediaTek ISP5.0 CAMSV driver"
	depends on VIDEO_V4L2 && VIDEO_V4L2_SUBDEV_API
	depends on ARCH_MEDIATEK
	select VIDEOBUF2_VMALLOC
	select VIDEOBUF2_DMA_CONTIG
	select MTK_SENINF
	select PHY_MTK_CDPHY
	default n
	help
	  This driver provides a path to bypass the SoC ISP5.0 so that
	  the image data coming from SENINF can go directly into memory
	  without any image processing for MT8183 platforms.
```

## drivers/media/video/boundary/Kconfig
```kconfig
if VIDEO_BOUNDARY_CAMERA

menu "Boundary Camera Features support"
config BOUNDARY_CAMERA_CSI0
	bool "Support cameras on CSI0"
	default n
	---help---
	  Choose Y to include camera support on Camera Sensor #0

config BOUNDARY_CAMERA_CSI1
	bool "Support cameras on CSI1"
	default n
	---help---
	  Choose Y to include camera support on Camera Sensor #1

config BOUNDARY_CAMERA_OV5640
	tristate "OmniVision ov5640 camera support"
	---help---
	  If you plan to use the ov5640 Camera with your Boundary Device, say Y here.

endmenu

endif
```

## drivers/media/video/mxc/output/Kconfig
```kconfig
config VIDEO_MXC_IPU_OUTPUT
	bool "IPU v4l2 support"
	depends on VIDEO_MXC_OUTPUT && MXC_IPU
	default y
	---help---
	This is the video4linux2 driver for IPU post processing video output.

config VIDEO_MXC_PXP_V4L2
        tristate "MXC PxP V4L2 driver"
        depends on VIDEO_DEV && VIDEO_V4L2 && ARCH_IMX_V6_V7
        select FB_MXC_ELCDIF_FB
        select VIDEOBUF_DMA_CONTIG
        ---help---
          This is a video4linux driver for the Freescale PxP
          (Pixel Pipeline). This module supports output overlay of
          the MXC framebuffer on a video stream.

          To compile this driver as a module, choose M here.
```

## drivers/misc/nxp-pn5xx/Kconfig
```kconfig
config NFC_NXP_PN5XX
	tristate "NXP PN5XX based driver"
	depends on I2C
	select CRC_CCITT
	default n
	---help---
	  NXP PN5XX driver based on I2C.
	  This is a driver to provides I2C access to PN5xx NFC Controller devices 

	  To compile this driver as a module, choose m here. The module will
	  be called pn5xx_i2c.
	  Say N if unsure.
```

## drivers/mxc/Kconfig
```kconfig
# drivers/mxc/Kconfig

if ARCH_MXC

menu "MXC support drivers"

config MXC_IPU
	bool "Image Processing Unit Driver"
	select MXC_IPU_V3 if SOC_IMX6Q
	select MXC_IPU_V3H if SOC_IMX6Q
	help
	  If you plan to use the Image Processing unit, say
	  Y here. IPU is needed by Framebuffer and V4L2 drivers.

source "drivers/mxc/ipu3/Kconfig"
source "drivers/mxc/thermal/Kconfig"
source "drivers/mxc/gpu-viv/Kconfig"
source "drivers/mxc/vpu/Kconfig"
source "drivers/mxc/mipi/Kconfig"
source "drivers/mxc/asrc/Kconfig"

endmenu

endif
```

## drivers/mxc/asrc/Kconfig
```kconfig
#
# ASRC configuration
#

menu "MXC Asynchronous Sample Rate Converter support"

config MXC_ASRC
	tristate "ASRC support"
	depends on SOC_IMX35 || SOC_IMX53 || SOC_IMX6Q
	select SND_SOC_FSL_ASRC
	---help---
         Say Y to get the ASRC service.

endmenu
```

## drivers/mxc/mlb/Kconfig
```kconfig
#
# MLB configuration
#

menu "MXC Media Local Bus Driver"

config MXC_MLB
	boolean

config MXC_MLB50
	tristate "MLB support"
	depends on SOC_IMX35 || SOC_IMX53
	select MXC_MLB
	---help---
         Say Y to get the MLB support.

config MXC_MLB150
	tristate "MLB150 support"
	depends on SOC_IMX6Q
	select MXC_MLB
	---help---
	Say Y to get the MLB150 support.

endmenu
```

## drivers/mxc/thermal/Kconfig
```kconfig
#
# ANATOP Configuration
#

menu "ANATOP_THERMAL"

config ANATOP_THERMAL
	bool "anatop thermal driver"
	select THERMAL
	default y
	help
	  This driver supports ANATOP thermal. It is HIGHLY
	  recommended that this option be enabled, as your processor(s)
	  may be damaged without it.

	  To compile this driver as a module, choose M here:
	  the module will be called thermal.

endmenu
```
