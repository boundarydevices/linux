## drivers/battery/Kconfig
```kconfig
menuconfig BATTERY_SAMSUNG
	bool "samsung battery driver"
	help
	 Say Y to include support for samsung battery driver
	 This battery driver integrated all battery-related functions
	 To see battery-related functions,
	 refer to sec_charging_common.h

if BATTERY_SAMSUNG

config BATTERY_SAMSUNG_DATA_FILE
	depends on BATTERY_SAMSUNG
	string "samsung battery data file"
	default ""
	help
	 Path to the battery data file.

config BATTERY_SAMSUNG_DATA
	bool
	default BATTERY_SAMSUNG_DATA_FILE != ""

config CHARGING_VZWCONCEPT
	bool "VZW concept about the charging"
	depends on BATTERY_SAMSUNG
	default n
	help
	 Say Y to include support for the VZW concepts.

config BATTERY_SWELLING
	bool "prevent battery swelling"
	depends on BATTERY_SAMSUNG
	help
	  Say Y to include support for prevent battery swelling

# Fuel Gauge

config FUELGAUGE_MAX77823
	tristate "MAX77823 fuel gauge driver"
	default n
	depends on BATTERY_SAMSUNG
	help
	 Say Y to include support
	 for MAXIM MAX77823 or MAX77818 fuel gauge driver.
	 This fuel-gauge can be used in voltage-tracking mode
	 or coulomb-counting mode.

config FUELGAUGE_MAX77823_VOLTAGE_TRACKING
	bool "use MAX77823 fuel gauge only as voltage tracking"
	default n
	depends on FUELGAUGE_MAX77823
	help
	 Say Y to use MAX17050 fuel gauge
	 only as voltage tracking.
	 This mode is for target that consumes low current
	 like smart-phone.

config FUELGAUGE_MAX77823_COULOMB_COUNTING
	bool "use MAX77823 fuel gauge as coulomb counting (including voltage tracking)"
	default n
	depends on FUELGAUGE_MAX77823
	help
	 Say Y to use MAX77823 fuel gauge
	 as coulomb counting (including voltage tracking).
	 This mode is for target that consumes high current
	 like tablet.

# Charger

config CHARGER_MAX77823
	tristate "MAX77823 battery charger support"
	depends on BATTERY_SAMSUNG
	help
	 Say Y here to enable support for the MAX77823 charger

config SAMSUNG_BATTERY_ENG_TEST
	bool "enable ENG mode for battery test"
	depends on BATTERY_SAMSUNG
	default n
	help
	  Say Y to include support for battery test
	  enable this feature only ENG mode
	  this featuren must disabled user binary
	  stability test etc..

config SAMSUNG_BATTERY_FACTORY
	bool "enable for factory test"
	depends on BATTERY_SAMSUNG
	default n
	help
	  Say Y to include support for factory test
	  enable this feature only factory mode
	  this featuren must disabled user binary
	  stability test etc..

config SEC_BOARD_MXC
	tristate "enable for imx6"
	default y if ARCH_MXC

endif #BATTERY_SAMSUNG
```

## drivers/bus/Kconfig
```kconfig
#
# Bus Devices
#

menu "Bus devices"

config IMX_WEIM
	bool "Freescale EIM DRIVER"
	depends on ARCH_MXC
	help
	  Driver for i.MX6 WEIM controller.
	  The WEIM(Wireless External Interface Module) works like a bus.
	  You can attach many different devices on it, such as NOR, onenand.
	  But now, we only support the Parallel NOR.

endmenu
```

## drivers/extcon/Kconfig
```kconfig
menuconfig EXTCON
	tristate "External Connector Class (extcon) support"
	help
	  Say Y here to enable external connector class (extcon) support.
	  This allows monitoring external connectors by userspace
	  via sysfs and uevent and supports external connectors with
	  multiple states; i.e., an extcon that may have multiple
	  cables attached. For example, an external connector of a device
	  may be used to connect an HDMI cable and a AC adaptor, and to
	  host USB ports. Many of 30-pin connectors including PDMI are
	  also good examples.

if EXTCON

comment "Extcon Device Drivers"

config EXTCON_GPIO
	tristate "GPIO extcon support"
	depends on GENERIC_GPIO
	help
	  Say Y here to enable GPIO based extcon support. Note that GPIO
	  extcon supports single state per extcon instance.

config EXTCON_ARIZONA
	tristate "Wolfson Arizona EXTCON support"
	depends on MFD_ARIZONA && INPUT && SND_SOC
	help
	  Say Y here to enable support for external accessory detection
	  with Wolfson Arizona devices. These are audio CODECs with
	  advanced audio accessory detection support.

endif # MULTISTATE_SWITCH
```

## drivers/firmware/imx/Kconfig
```kconfig
# SPDX-License-Identifier: GPL-2.0-only
config IMX_DSP
	tristate "IMX DSP Protocol driver"
	depends on IMX_MBOX
	help
	  This enables DSP IPC protocol between host AP (Linux)
	  and the firmware running on DSP.
	  DSP exists on some i.MX8 processors (e.g i.MX8QM, i.MX8QXP).

	  It acts like a doorbell. Client might use shared memory to
	  exchange information with DSP side.

config IMX_SCU
	bool "IMX SCU Protocol driver"
	depends on IMX_MBOX
	select SOC_BUS
	help
	  The System Controller Firmware (SCFW) is a low-level system function
	  which runs on a dedicated Cortex-M core to provide power, clock, and
	  resource management. It exists on some i.MX8 processors. e.g. i.MX8QM
	  (QM, QP), and i.MX8QX (QXP, DX).

	  This driver manages the IPC interface between host CPU and the
	  SCU firmware running on M4.

config IMX_SCU_PD
	bool "IMX SCU Power Domain driver"
	depends on IMX_SCU
	help
	  The System Controller Firmware (SCFW) based power domain driver.

config IMX_SECO_MU
	tristate "i.MX Security Controller (SECO) support"
	depends on IMX_MBOX
	default y if IMX_SCU

	help
	  It is possible to use APIs exposed by the SECO like HSM and SHE using the
	  SAB protocol via the shared Messaging Unit. This driver exposes these
	  interfaces via a set of file descriptors allowing to configure shared
	  memory, send and receive messages.

config IMX_SEC_ENCLAVE
	tristate "i.MX Embedded Secure Enclave - EdgeLock Enclave Firmware driver."
	depends on IMX_MBOX && ARCH_MXC && ARM64
	default m if ARCH_MXC

	help
	  It is possible to use APIs exposed by the iMX Secure Enclave HW IP called:
          - EdgeLock Enclave Firmware (for i.MX8ULP, i.MX93),
            like base, HSM, V2X & SHE using the SAB protocol via the shared Messaging
            Unit. This driver exposes these interfaces via a set of file descriptors
            allowing to configure shared memory, send and receive messages.

config IMX_ELE_TRNG
	tristate "i.MX ELE True Random Number Generator"
	default y
	select CRYPTO_RNG
	select HW_RANDOM
	help
	  This driver provides kernel-side support for the Random Number generation,
          through NXP hardware IP for secure-enclave called EdgeLock Enclave.

config IMX_ISPMU
	tristate "IMX ISP MU Protocol driver"
	depends on IMX_MBOX
	help
	  The ISP Firmware is a low-level code that manages the ISP core
	  and runs on a dedicated Cortex-M core to provide queue and resource
	  management of the ISP core.

	  This driver manages the IPC interface between host CPU and the
	  ISP firmware running on M0+ core.
```

## drivers/gpu/drm/Kconfig
```kconfig
#
# Drm device configuration
#
# This driver provides support for the
# Direct Rendering Infrastructure (DRI) in XFree86 4.1.0 and higher.
#
menuconfig DRM
	tristate "Direct Rendering Manager (XFree86 4.1.0 and higher DRI support)"
	select I2C
	select I2C_ALGOBIT
	select DMA_SHARED_BUFFER
	help
	  Kernel-level support for the Direct Rendering Infrastructure (DRI)
	  introduced in XFree86 4.0. If you say Y here, you need to select
	  the module that's right for your graphics card from the list below.
	  These modules provide support for synchronization, security, and
	  DMA transfers. Please see <http://dri.sourceforge.net/> for more
	  details.  You should also select and configure AGP
	  (/dev/agpgart) support if it is available for your platform.

config DRM_USB
	tristate
	depends on DRM
	select USB

config DRM_KMS_HELPER
	tristate
	depends on DRM
	select FB
	select FRAMEBUFFER_CONSOLE if !EXPERT
	help
	  FB and CRTC helpers for KMS drivers.

config DRM_LOAD_EDID_FIRMWARE
	bool "Allow to specify an EDID data set instead of probing for it"
	depends on DRM_KMS_HELPER
	help
	  Say Y here, if you want to use EDID data to be loaded from the
	  /lib/firmware directory or one of the provided built-in
	  data sets. This may be necessary, if the graphics adapter or
	  monitor are unable to provide appropriate EDID data. Since this
	  feature is provided as a workaround for broken hardware, the
	  default case is N. Details and instructions how to build your own
	  EDID data are given in Documentation/EDID/HOWTO.txt.

config DRM_TTM
	tristate
	depends on DRM
	help
	  GPU memory management subsystem for devices with multiple
	  GPU memory types. Will be enabled automatically if a device driver
	  uses it.

config DRM_VIVANTE
	tristate "Vivante GCCore"
	depends on DRM
	help
	  Choose this option if you have a Vivante graphics card.
          If M is selected, the module will be called vivante.
```

## drivers/gpu/drm/apu/Kconfig
```kconfig
# SPDX-License-Identifier: GPL-2.0-only
#

config DRM_APU
	tristate "APU (AI Processor Unit)"
	select REMOTEPROC
	select DRM_SCHED
	help
	  This provides a DRM driver that provides some facilities to
	  communicate with an accelerated processing unit (APU).
```

## drivers/gpu/drm/bridge/imx/Kconfig
```kconfig
if ARCH_MXC || COMPILE_TEST

config DRM_IMX_LDB_HELPER
	tristate

config DRM_IMX8QXP_PIXEL_COMBINER
	tristate "Freescale i.MX8QM/QXP pixel combiner"
	depends on OF
	depends on COMMON_CLK
	select DRM_KMS_HELPER
	help
	  Choose this to enable pixel combiner found in
	  Freescale i.MX8qm/qxp processors.

config DRM_IMX8QXP_PIXEL_LINK
	tristate "Freescale i.MX8QM/QXP display pixel link"
	depends on OF
	depends on IMX_SCU
	select DRM_KMS_HELPER
	help
	  Choose this to enable display pixel link found in
	  Freescale i.MX8qm/qxp processors.

config DRM_IMX8QXP_PIXEL_LINK_TO_DPI
	tristate "Freescale i.MX8QXP pixel link to display pixel interface"
	depends on OF
	select DRM_KMS_HELPER
	help
	  Choose this to enable pixel link to display pixel interface(PXL2DPI)
	  found in Freescale i.MX8qxp processor.

config DRM_IMX95_LDB
	tristate "Freescale i.MX95 LVDS display bridge"
	depends on OF
	depends on COMMON_CLK
	select DRM_IMX_LDB_HELPER
	select DRM_KMS_HELPER
	help
	  Choose this to enable the internal LVDS Display Bridge(LDB) found in
	  Freescale i.MX95 processor.

config DRM_IMX95_MIPI_DSI
	tristate "NXP i.MX95 specific extensions for Synopsys DW MIPI DSI"
	depends on OF && MFD_SYSCON && COMMON_CLK
	select DRM_DW_MIPI_DSI
	select DRM_KMS_HELPER
	select MULTIPLEXER
	select REGMAP_MMIO
	help
	  Choose this to enable Synopsys DesignWare MIPI DSI found in NXP
	  i.MX95 processor.

config DRM_IMX95_PIXEL_INTERLEAVER
	tristate "NXP i.MX95 pixel interleaver"
	depends on OF && MFD_SYSCON && COMMON_CLK
	select DRM_KMS_HELPER
	select REGMAP_MMIO
	help
	  Choose this to enable pixel interleaver found in NXP i.MX95
	  processors.

config DRM_IMX95_PIXEL_LINK
	tristate "NXP i.MX95 display pixel link"
	depends on OF && MFD_SYSCON
	select DRM_KMS_HELPER
	select REGMAP_MMIO
	help
	  Choose this to enable display pixel link found in NXP i.MX95
	  processors.

endif # ARCH_MXC || COMPILE_TEST
```

## drivers/gpu/drm/bridge/sn65dsi83/Kconfig
```kconfig
config DRM_I2C_SN65DSI83
	tristate "SN65DSI83 mipi dsi to lvds bridge"
	depends on OF
	select DRM_MIPI_DSI
	select DRM_KMS_HELPER
	help
	  Support for the sn65dsi83 MIPI DSI to LVDS bridge
```

## drivers/gpu/drm/mediatek/Kconfig
```kconfig
# SPDX-License-Identifier: GPL-2.0-only
config DRM_MEDIATEK
	tristate "DRM Support for Mediatek SoCs"
	depends on DRM
	depends on ARCH_MEDIATEK || (ARM && COMPILE_TEST)
	depends on COMMON_CLK
	depends on HAVE_ARM_SMCCC
	depends on OF
	depends on MTK_MMSYS
	select DRM_GEM_CMA_HELPER
	select DRM_KMS_HELPER
	select DRM_MIPI_DSI
	select DRM_PANEL
	select MEMORY
	select MTK_SMI
	select PHY_MTK_MIPI_DSI
	select VIDEOMODE_HELPERS
	select DRM_DP_HELPER
	help
	  Choose this option if you have a Mediatek SoCs.
	  The module will be called mediatek-drm
	  This driver provides kernel mode setting and
	  buffer management to userspace.

config DRM_MEDIATEK_HDMI
	tristate "DRM HDMI Support for Mediatek SoCs"
	depends on DRM_MEDIATEK
	select SND_SOC_HDMI_CODEC if SND_SOC
	select PHY_MTK_HDMI
	help
	  DRM/KMS HDMI driver for Mediatek SoCs

config DRM_MEDIATEK_HDMI_HDCP
	tristate "DRM HDMI HDCP Support for MediaTek SoCs"
	depends on OPTEE
	depends on DRM_MEDIATEK_HDMI
	help
	  DRM/KMS HDMI HDCP driver for MediaTek SoCs.
	  Choose this option
	  if you want to enable
	  HDMI HDCP driver.

config DRM_MEDIATEK_CEC
	tristate "DRM CEC Support for MediaTek SoCs"
	depends on DRM_MEDIATEK_HDMI
	select CEC_CORE
	help
	  DRM/KMS HDMI CEC driver for MediaTek 8195 compatible HDMI SoCs.
	  Choose this option if you want to
	  enable the CEC driver. Note that the CEC
	  driver depends on DRM_MEDIATEK_HDMI, so select
	  DRM_MEDIATEK_HDMI before choosing this option.

config DRM_MEDIATEK_CEC_SUSPEND_LOW_POWER
	tristate "DRM CEC SUSPEND LOW POWER Support for MediaTek SoCs"
	depends on DRM_MEDIATEK_CEC
	help
	  DRM/KMS CEC SUSPEND_LOW_POWER for MediaTek SoCs.
	  Choose this option if you want to
	  disable CEC clock when
	  platform enter suspend.

config MTK_DPTX_SUPPORT
	tristate "DRM DPTX Support for Mediatek SoCs"
	depends on DRM_MEDIATEK
	select PHY_MTK_DP
	help
	  DRM/KMS Display Port driver for Mediatek SoCs.

config MTK_LVDS_SUPPORT
	tristate "DRM LVDS Support for MediaTek SoCs"
	depends on DRM_MEDIATEK
	select PHY_MTK_LVDS
	help
	  DRM/KMS LVDS driver for MediaTek SoCs.
```

## drivers/media/i2c/os08a20/Kconfig
```kconfig
config VIDEO_OS08A20
	tristate "OmniVision OS08A20 sensor support"
	depends on OF
	depends on GPIOLIB && VIDEO_V4L2_I2C && VIDEO_V4L2_SUBDEV_API
	depends on MEDIA_CAMERA_SUPPORT
	select V4L2_FWNODE
	help
	  This is a Video4Linux2 sensor driver for the Omnivision
	  OS08A20 camera sensor with a MIPI CSI-2 interface.
```

## drivers/media/pci/Kconfig
```kconfig
if PCI && MEDIA_SUPPORT

menuconfig MEDIA_PCI_SUPPORT
	bool "Media PCI Adapters"
	help
	  Enable media drivers for PCI/PCIe bus.
	  If you have such devices, say Y.

if MEDIA_PCI_SUPPORT

	comment "Media capture/analog TV support"
source "drivers/media/pci/TW68/Kconfig"
endif


endif #MEDIA_PCI_SUPPORT
```

## drivers/media/pci/TW68/Kconfig
```kconfig
config VIDEO_TW68
	tristate "TW686x cards"
	depends on PCI
	select VIDEOBUF_DMA_SG
	select VIDEOBUF_VMALLOC
	help
	  Support for TW6869 PCIe cards.

	  Say Y or M if you own such a device and want to use it.
```

## drivers/media/pci/tw6869/Kconfig
```kconfig
config VIDEO_TW6869
	tristate "Techwell tw6869 Video For Linux"
	depends on VIDEO_DEV && PCI && VIDEO_V4L2
	select VIDEOBUF2_DMA_SG
	---help---
	  Support for Techwell tw6869 based frame grabber boards.

	  To compile this driver as a module, choose M here: the
	  module will be called tw6869.
```

## drivers/media/platform/mediatek/Kconfig
```kconfig
# SPDX-License-Identifier: GPL-2.0-only

comment "Mediatek media platform drivers"

source "drivers/media/platform/mediatek/mdp3/Kconfig"
```

## drivers/media/platform/mediatek/isp/Kconfig
```kconfig
# SPDX-License-Identifier: GPL-2.0-only
source "drivers/media/platform/mediatek/isp/isp_30/Kconfig"
```

## drivers/media/platform/mediatek/isp/isp_30/Kconfig
```kconfig
# SPDX-License-Identifier: GPL-2.0-only
config MTK_SENINF30
	tristate "MediaTek ISP3.0 SENINF driver"
	depends on VIDEO_V4L2_SUBDEV_API
	depends on MEDIA_CAMERA_SUPPORT
	depends on ARCH_MEDIATEK || COMPILE_TEST
	depends on OF
	select V4L2_FWNODE
	default n
	help
	  This driver provides a MIPI CSI-2 receiver interface to connect
	  an external camera module with MediaTek ISP3.0. It is able to handle
	  multiple cameras at the same time.

	  To compile this driver as a module, choose M here: the
	  module will be called mtk-seninf.
```
