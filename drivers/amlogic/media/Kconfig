## drivers/amlogic/media/Kconfig
```kconfig
#
# Amlogic DVB configuration
#

menu "Amlogic dvb configuration"

config AMLOGIC_DVB
	bool "Amlogic dvb support"
	select DVB_CORE
	select AMLOGIC_DVB_COMPAT
	default y
	help
		This option is used only to control the
		compilation of dvb related driver code, for
		example hw_demux, it is enabled by default,
		When it is turned on,it will automatically
		select DVB_CORE and AMLOGIC_DVB_COMPAT.

config AMLOGIC_DVB_COMPAT
	bool "Compat amlogic dvb"
	depends on AMLOGIC_DVB && DVB_CORE
	default y
	help
		This option is used only to compatible with
		amlogic dvb related code, for example dvb-core,
		it is enabled by default,depending on
		AMLOGIC_DVB and DVB_CORE.

endmenu


#
# Amlogic multimedia configuration
#

menu "Amlogic multimedia configuration"

config AMLOGIC_MEDIA_ENABLE
	bool "Amlgoic Multimedia Support"
	default n
	help
		Amlogic multimedia framework composed of two parts,
		the first part is common which consists of modules
		such as arch, codec_mm, vfm, the second is driver
		part of the media, both of which depends on this
		configuration options.

config AMLOGIC_MEDIA_COMMON
	bool "Amlogic the common of the media"
	depends on AMLOGIC_MEDIA_ENABLE
	default n
	help
		This option is used to configure Amlogic common
		for media, it as the basis for drivers of the
		multimedia, mainly on the operation of the
		registers, memory allocation and the chain of
		responsibility management of the frame processing.

config AMLOGIC_MEDIA_DRIVERS
	bool "Amlogic drivers of the media"
	depends on AMLOGIC_MEDIA_COMMON
	default n
	help
		This option is used to configure Amlogic drivers
		of the multimedia, which consists of video decoder
		module, video decoder management module and post
		processing of the frame.

config AMLOGIC_MEDIA_MULTI_DEC
	bool "Support multi-instance decoding"
	default n

config AMLOGIC_AVSP_LONG_CABAC
	bool "GXL support avs long cabac"
	default n
	help
		This option is used only to configure GXL avs
		decode, other platform behind GXL is not need.
		disable it to save memory default.


if AMLOGIC_MEDIA_COMMON
source "drivers/amlogic/media/common/Kconfig"
endif

if AMLOGIC_MEDIA_DRIVERS
source "drivers/amlogic/media/video_sink/Kconfig"
source "drivers/amlogic/media/vout/Kconfig"
source "drivers/amlogic/media/osd/Kconfig"
source "drivers/amlogic/media/osd_ext/Kconfig"
source "drivers/amlogic/media/deinterlace/Kconfig"
source "drivers/amlogic/media/vin/Kconfig"
source "drivers/amlogic/media/video_processor/Kconfig"
source "drivers/amlogic/media/enhancement/Kconfig"
source "drivers/amlogic/media/gdc/Kconfig"
source "drivers/amlogic/media/algorithm/Kconfig"
source "drivers/amlogic/media/camera/Kconfig"
endif
source "drivers/amlogic/media/dtv_demod/Kconfig"
endmenu
```

## drivers/amlogic/media/algorithm/Kconfig
```kconfig
#
# Amlogic multimedia algorithm configuration
#

menu "Amlogic multimedia algorithm configuration"

config AMLOGIC_MEDIA_ALGORITHM
	bool "Amlgoic Multimedia Algorithm Support"
	default n
	help
		Amlogic multimedia algorithm include:
		dnlp
		hdr10
		sl_hdr
		ldim

if AMLOGIC_MEDIA_ALGORITHM
#source "drivers/amlogic/media/algorithm/ldim/Kconfig"
#source "drivers/amlogic/media/algorithm/dnlp/Kconfig"
endif

endmenu
```

## drivers/amlogic/media/amldemod/Kconfig
```kconfig
#
# DTV driver configuration
#

menu "Amlogic DTV driver"

config AMLOGIC_DTV_DEMOD
	tristate "Amlogic DTVDEMOD device driver"
	default n
	help
		DTVDEMOD device driver.
		Y: enable
		N: disable
		M: build as module

endmenu
```

## drivers/amlogic/media/common/Kconfig
```kconfig
#Ascending by module name's ASCII
source "drivers/amlogic/media/common/codec_mm/Kconfig"
source "drivers/amlogic/media/common/canvas/Kconfig"
source "drivers/amlogic/media/common/ge2d/Kconfig"
source "drivers/amlogic/media/common/ion_dev/Kconfig"
source "drivers/amlogic/media/common/rdma/Kconfig"
source "drivers/amlogic/media/common/vfm/Kconfig"
source "drivers/amlogic/media/common/vpu/Kconfig"
source "drivers/amlogic/media/common/v4l_util/Kconfig"
```

## drivers/amlogic/media/common/canvas/Kconfig
```kconfig
#
# Canvas management driver configuration
#

menu "Canvas management driver"

config AMLOGIC_MEDIA_CANVAS
	bool "Amlogic Canvas management driver"
	default n
	help
		Select to enable Canvas management driver.

endmenu
```

## drivers/amlogic/media/common/codec_mm/Kconfig
```kconfig
#
# Codec mermory manager driver configuration
#

config AMLOGIC_MEDIA_CODEC_MM
	bool "Amlogic codec memory management driver"
	default n
	help
		Select to enable codec related memory management driver.
```

## drivers/amlogic/media/common/ge2d/Kconfig
```kconfig
#
# GE2D Module
#
menu "Amlogic GE2D Module"
config  AMLOGIC_MEDIA_GE2D
	bool "Amlogic GE2D Module"
	default n
	help
		Select to enable GE2D graphic 2D engine.
config	AMLOGIC_MEDIA_GE2D_MORE_SECURITY
	bool "Amlogic GE2D not use physical addr"
	default n
	depends on AMLOGIC_MEDIA_GE2D
	help
		Select to enable GE2D not use physical addr.
endmenu
```

## drivers/amlogic/media/common/ion_dev/Kconfig
```kconfig
menu "ION support"

config AMLOGIC_ION
	tristate "ION memeory management support"
	select ION
	select ARM_HAS_SG_CHAIN
	select ARM64_HAS_SG_CHAIN
	default n
	---help---
	Select to enable "Amlogic ion device support.
endmenu
```

## drivers/amlogic/media/common/rdma/Kconfig
```kconfig
#
# RDMA management driver configuration
#

menu "RDMA management driver"

config AMLOGIC_MEDIA_RDMA
	bool "Amlogic RDMA management driver"
	default n
	help
		Select to enable RDMA management driver.

	config AMLOGIC_MEDIA_VSYNC_RDMA
	bool "Amlogic RDMA VSYNC"
	depends on AMLOGIC_MEDIA_RDMA
	default n
	help
		Select to enable RDMA VSYNC.
endmenu
```

## drivers/amlogic/media/common/v4l_util/Kconfig
```kconfig
#
# V4L UTIL configuration
#

config AMLOGIC_VIDEOBUF_RESOURCE
	bool "Amlogic V4L UTIL Support"
	select VIDEOBUF2_DMA_CONTIG
	select V4L2_MEM2MEM_DEV
	default n
	help
		Select to enable V4L UTIL support
```

## drivers/amlogic/media/common/vfm/Kconfig
```kconfig
#
# VFM configuration
#

config AMLOGIC_MEDIA_VFM
	bool "Amlogic VFM Support"
	default n
	help
		Select to enable VFM support
```

## drivers/amlogic/media/common/vpu/Kconfig
```kconfig
#
# Amlogic VPU driver configuation
#

menu "Amlogic VPU Driver Support"

config AMLOGIC_VPU
	bool "Amlogic VPU driver"
	default n
	help
		Amlogic vpu driver support.
		Manage vpu domain clock,
			memory power down,
			and vpu clock gate.
		All the video modules work on vpu domain.

config AMLOGIC_VPU_DYNAMIC_ADJ
	bool "Amlogic VPU Frequency Dynamic Adjust"
	default n
	depends on AMLOGIC_VPU
	help
		Amlogic vpu frequency dynamic adjust,
		manage the max frequency what video modules required.

endmenu
```

## drivers/amlogic/media/deinterlace/Kconfig
```kconfig
#
# Deinterlace driver configuration
#

menu "Deinterlace driver"

config AMLOGIC_MEDIA_DEINTERLACE
	tristate "DEINTERLACE driver"
	default n
	help
		Select to enable AMLOGIC DEINTERLACE driver
		process interlace source need three continueed fields,
		wave progressive source with two interlace fields from
		one progreesive fields
endmenu
```

## drivers/amlogic/media/enhancement/Kconfig
```kconfig
#
# Amlogic multimedia input configuration
#
menu "Amlogic Enhancement drivers"
config AMLOGIC_MEDIA_ENHANCEMENT
        bool "Amlogic driver of enhancement"
		depends on AMLOGIC_MEDIA_DRIVERS
        default n
        help
            "Amlogic amvecm module init"

if AMLOGIC_MEDIA_ENHANCEMENT
source "drivers/amlogic/media/enhancement/amvecm/Kconfig"
source "drivers/amlogic/media/enhancement/amdolby_vision/Kconfig"
source "drivers/amlogic/media/enhancement/amprime_sl/Kconfig"
endif

endmenu
```

## drivers/amlogic/media/enhancement/amdolby_vision/Kconfig
```kconfig
#
# AMLOGIC amdolby_vision devices configuration
#

comment "Amlogic amdolby_vision Drivers"

menu "Amlogic amdolby_vision Driver"

config AMLOGIC_MEDIA_ENHANCEMENT_DOLBYVISION
        bool "Amlogic amdolby_vision driver"
        default n
        help
                "Amlogic amdolby_vision module init"

endmenu
```

## drivers/amlogic/media/enhancement/amprime_sl/Kconfig
```kconfig
#
# AMLOGIC amprime_sl devices configuration
#

comment "Amlogic amprime_sl Drivers"

menu "Amlogic amprime_sl Driver"

config AMLOGIC_MEDIA_ENHANCEMENT_PRIME_SL
        bool "Amlogic amprime_sl driver"
        default n
        help
                "Amlogic amprime_sl module init"

endmenu
```

## drivers/amlogic/media/enhancement/amvecm/Kconfig
```kconfig
#
# AMLOGIC amvecm devices configuration
#

comment "Amlogic VECM Drivers"

menu "Amlogic amvecm Driver"

config AMLOGIC_MEDIA_ENHANCEMENT_VECM
        bool "Amlogic amvecm driver"
        default n
        help
            "Amlogic amvecm module init"
endmenu
```

## drivers/amlogic/media/gdc/Kconfig
```kconfig
#
# gdc driver configuration
#
config AMLOGIC_MEDIA_GDC
	bool "Amlogic gdc driver"
	default n
	help
		Select to enable gdc driver.
```

## drivers/amlogic/media/logo/Kconfig
```kconfig
#
# Amlogic Logo configuration
#
config AMLOGIC_MEDIA_LOGO
	bool "Amlogic Logo Module"
	default n
	depends on AMLOGIC_MEDIA_FB
	depends on AMLOGIC_VOUT
	help
		Select to enable Logo module
```

## drivers/amlogic/media/osd/Kconfig
```kconfig
#
# Frame buffer configuration
#
menu "Amlogic OSD Module"

config AMLOGIC_MEDIA_FB
	bool "Amlogic OSD Support"
	depends on FB
	select FB_CFB_FILLRECT
	select FB_CFB_COPYAREA
	select FB_CFB_IMAGEBLIT
#	depends on AMLOGIC_MEDIA_CANVAS
#	depends on AMLOGIC_VOUT_SERVE
	default n
	help
		This is the frame buffer device driver.
		It provide basic frame buffer device driver.

		It need enable canvas.
		It need enable vout.

config AMLOGIC_MEDIA_FB_OSD_SYNC_FENCE
	bool "OSD SYNC FENCE"
	default n
	depends on AMLOGIC_MEDIA_FB
	depends on STAGING
	depends on ANDROID
	depends on SYNC_FILE
	depends on SW_SYNC
	help
		Select to enable OSD SYNC FENCE.
		This is the frame buffer device driver.
		It provide basic frame buffer device driver.

		This module is used in android system.
		It used sync fence.

config AMLOGIC_MEDIA_FB_OSD_VSYNC_RDMA
	bool "OSD VSYNC RDMA"
	default n
	depends on AMLOGIC_MEDIA_FB
	depends on AMLOGIC_MEDIA_RDMA
	help
		This is the frame buffer device driver.
		Select to enable OSD VSYNC RDMA.

		This module used VSYNC RDMA.
		It used rdma.

config AMLOGIC_MEDIA_FB_OSD2_ENABLE
	bool "OSD2 Layer Support"
	default n
	depends on AMLOGIC_MEDIA_FB
	help
		This is the frame buffer device driver.
		Select to enable OSD2 Layer.

		This module enable OSD2 layer,
		otherwise we used OSD1 only.

config AMLOGIC_MEDIA_FB_OSD2_CURSOR
	bool "OSD2 Cursor Support"
	depends on AMLOGIC_MEDIA_FB_OSD2_ENABLE
	default n
	help
		This is the frame buffer device driver.
		Select to enable OSD2 cursor.

		This module used2 OSD2 as cursor.
endmenu
```

## drivers/amlogic/media/osd_ext/Kconfig
```kconfig
#
# Frame buffer configuration
#
menu "Amlogic OSD_EXT Module"

config AMLOGIC_MEDIA_FB_EXT
	bool "Amlogic OSD_EXT Support"
	default n
	depends on AMLOGIC_MEDIA_FB
	select FB_CFB_FILLRECT
	select FB_CFB_COPYAREA
	select FB_CFB_IMAGEBLIT
	#depends on AMLOGIC_MEDIA_CANVAS
	#depends on AMLOGIC_VOUT2
	help
		This is the frame buffer device driver.
endmenu
```

## drivers/amlogic/media/video_processor/Kconfig
```kconfig
#
# Amlogic video processor configuation
#

menu "Amlogic Video Processor Support"

config AMLOGIC_MEDIA_VIDEO_PROCESSOR
	bool "Amlogic Video Processor Driver"
	default n
	help
		Amlogic Video Processor module support.
		Video Processor module includes ION_VIDEO, PPMGR, VIDEO_DEV and etc.

if AMLOGIC_MEDIA_VIDEO_PROCESSOR

source "drivers/amlogic/media/video_processor/video_dev/Kconfig"
source "drivers/amlogic/media/video_processor/ppmgr/Kconfig"
source "drivers/amlogic/media/video_processor/ionvideo/Kconfig"
source "drivers/amlogic/media/video_processor/pic_dev/Kconfig"
source "drivers/amlogic/media/video_processor/videosync/Kconfig"
endif

endmenu
```

## drivers/amlogic/media/video_processor/ionvideo/Kconfig
```kconfig
#
# Amlogic ionvideo device configuation
#

menu "Amlogic ion video support"

config AMLOGIC_VIDEOBUF2_ION
	tristate "videobuf2-ion video device support"
	depends on VIDEO_DEV
	depends on VIDEO_V4L2
	depends on VIDEOBUF2_CORE
	depends on VIDEOBUF2_MEMOPS
	depends on DMA_SHARED_BUFFER
	default n

	---help---
		capture ion video to user
		select to enable capture ion video to user
		enabled by default
		good luck


config AMLOGIC_IONVIDEO
	tristate "Amlogic ion video device support"
	depends on AMLOGIC_VIDEOBUF2_ION
	default n

	---help---
	capture ion video to user

endmenu
```

## drivers/amlogic/media/video_processor/pic_dev/Kconfig
```kconfig
#
# Amlogic picture decoder device configuation
#

menu "Amlogic picture decoder support"

config AMLOGIC_PIC_DEC
		tristate "Amlogic picture decoder"
		default n
		select AM_PTSSERVER
		help
				Driver for picture decoder.

endmenu
```

## drivers/amlogic/media/video_processor/ppmgr/Kconfig
```kconfig
#
# Post Process Manager device configuration
#

menu "Post Process Manager driver"

config AMLOGIC_POST_PROCESS_MANAGER
    tristate "Amlogic Post Process Manager driver"
    default n
	help
	  Select to
	  enable Amlogic Post Process Manager driver
	  in system
	  Disabled by default

config AMLOGIC_POST_PROCESS_MANAGER_PPSCALER
    tristate "Amlogic Post Process Manager PPScaler mode"
    depends on  AMLOGIC_POST_PROCESS_MANAGER
    default n
	help
	  Select to
	  include PPscaler function
	  in Amlogic Post Process Manager driver
	  Disabled by default
	  C
config AMLOGIC_POST_PROCESS_MANAGER_3D_PROCESS
    tristate "Amlogic Post Process Manager 3D Process"
    depends on  AMLOGIC_POST_PROCESS_MANAGER
    default n
	help
	  Select to
	  include 3D Process function
	  in Amlogic Post Process Manager driver
	  Disabled by default
endmenu
```
