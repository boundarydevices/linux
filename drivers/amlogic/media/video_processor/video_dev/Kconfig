## drivers/amlogic/media/video_processor/video_dev/Kconfig
```kconfig
#
# Amlogic video2 device configuation
#

menu "V4L2 Video Support"

config AMLOGIC_V4L_VIDEO
		tristate "Amlogic v4l video device support"
		depends on VIDEO_DEV
		depends on VIDEO_V4L2
		depends on AMLOGIC_VIDEOBUF_RESOURCE
		default n
		help
				Select to enable "Amlogic v4l video device support.

config AMLOGIC_V4L_VIDEO2
		tristate "Amlogic v4l video2 device support"
		depends on VIDEO_DEV
		select VIDEOBUF_GEN
		depends on AMLOGIC_MEDIA_COMMON
		depends on AMLOGIC_VIDEOBUF_RESOURCE
		depends on AMLOGIC_MEDIA_GE2D
		default n
		help
				Select to enable "Amlogic v4l video2 device support.

endmenu
```

## drivers/amlogic/media/video_processor/videosync/Kconfig
```kconfig
menu "Amlogic videosync support"

config AMLOGIC_VIDEOSYNC
	tristate "amlogic videosync device support"
	select VIDEO_DEV
	default n

	---help---
			Select to enable "Amlogic videosync support.

endmenu
```

## drivers/amlogic/media/video_sink/Kconfig
```kconfig
#
# Amlogic video Sink configuation
#

menu "Amlogic Video Sink Driver Support"

config AMLOGIC_MEDIA_VIDEO
	bool "Amlogic Video Sink Driver"
	default n
	help
		Amlogic Video Sink module support.
		This module driver include basic
		video, vpp etc.

if AMLOGIC_MEDIA_VIDEO

config  AMLOGIC_MEDIA_VSYNC_RDMA
	bool "VSYNC CBUS RDMA"
	default n
    depends on AMLOGIC_MEDIA_RDMA
	help
		Select to enable VSYNC CBUS RDMA.

endif

config AMLOGIC_MEDIA_VIDEOCAPTURE
    bool "Amlogic Video Capture support"
    default n
    help
		Internal Video Capture driver

endmenu
```

## drivers/amlogic/media/vin/Kconfig
```kconfig
#
# Amlogic multimedia input configuration
#
menu "Input drivers"
config AMLOGIC_MEDIA_VIN
	bool "Amlogic drivers of the media video in"
	depends on AMLOGIC_MEDIA_DRIVERS
	default n
	help
		This option is used to configure Amlogic drivers
		of the multimedia video in, which consists of tvin
		module, dvb module and camera module.

if AMLOGIC_MEDIA_VIN
source "drivers/amlogic/media/vin/tvin/Kconfig"
endif

endmenu
```

## drivers/amlogic/media/vin/tvin/Kconfig
```kconfig
#
# Amlogic tvin drivers configuration
#

comment "Tvin drivers"

config AMLOGIC_MEDIA_TVIN
        bool "Amlogic drivers of the media tvin"
	depends on AMLOGIC_MEDIA_VIN
	default n
	help
		This option is used to configure Amlogic drivers
		of the multimedia input of tvin, which consists
		of tvafe module, viu module, vdin module and
		hdmirx module.

if AMLOGIC_MEDIA_TVIN
source "drivers/amlogic/media/vin/tvin/vdin/Kconfig"
source "drivers/amlogic/media/vin/tvin/viu/Kconfig"
source "drivers/amlogic/media/vin/tvin/bt656/Kconfig"
source "drivers/amlogic/media/vin/tvin/hdmirx_ext/Kconfig"
source "drivers/amlogic/media/vin/tvin/hdmirx/Kconfig"
source "drivers/amlogic/media/vin/tvin/tvafe/Kconfig"
endif
```

## drivers/amlogic/media/vin/tvin/bt656/Kconfig
```kconfig
#
# BT656 Device Driver Configuration
#
config  AMLOGIC_MEDIA_TVIN_BT656
	bool "Amlogic bt656 device driver"
	default n
	help
		This option is used to configure Amlogic drivers
		of the multimedia input of BT656, which can support
		bt601/bt656 signals input.
```

## drivers/amlogic/media/vin/tvin/csi/Kconfig
```kconfig
#
# CSI Device Driver Configuration
#


config AMLOGIC_MEDIA_TVIN_CSI
	tristate "Amlogic CSI device driver"
	default n
	help
	  CSI device driver.
```

## drivers/amlogic/media/vin/tvin/hdmirx/Kconfig
```kconfig
#
# HDMI Rx Device Driver Configuration
#


config AMLOGIC_MEDIA_TVIN_HDMI
    tristate "Amlogic HDMI RX device driver"
    default n
    help
      HDMI RX device driver.
      HDMI RX device driver.
      HDMI RX device driver.
      HDMI RX device driver.
```

## drivers/amlogic/media/vin/tvin/hdmirx_ext/Kconfig
```kconfig
#
# Amlogic external hdmirx chips configuration
#

menuconfig AMLOGIC_MEDIA_TVIN_HDMI_EXT
	bool "External hdmirx chips support"
	default n
	help
		This option is used to configure Amlogic drivers
		of the multimedia input of external hdmirx,
		which can support HDMI signals input.

if AMLOGIC_MEDIA_TVIN_HDMI_EXT

source "drivers/amlogic/media/vin/tvin/hdmirx_ext/hw_sii9135/Kconfig"

endif
```

## drivers/amlogic/media/vin/tvin/hdmirx_ext/hw_sii9135/Kconfig
```kconfig
#
# Hdmirx external SII9135 Device Driver Configuration
#

config AMLOGIC_MEDIA_TVIN_HDMI_EXT_SII9135
	bool "external hdmirx chip sii9135 support"
	default n
	help
		sii9135 is input with hdmi siganl, and output dvp signal.
```

## drivers/amlogic/media/vin/tvin/tvafe/Kconfig
```kconfig
#
# AMLOGIC TVAFE Device Driver Configuration
#

config AMLOGIC_MEDIA_TVIN_AFE
	tristate "Amlogic AFE device driver"
	default n
	help
		AFE device driver,
		process input source of av/atv/vga/ypbpr/atvdemod,
		translate analog signal to digtal to vdin process

if AMLOGIC_MEDIA_TVIN_AFE
config ADC_DOUBLE_SAMPLING_FOR_CVBS
	bool "Enable double sampling function for AV port"
	default n
	help
		Adc double sampling for AV port
		Only for input source of AV,
		Only support on G9TV and after G9TV
		right now,not add support on M6TV

config AMLOGIC_MEDIA_TVIN_VBI
	tristate "Amlogic TVIN VBI device"
	default n
	help
		VBI devices driver
		Only for ATV input,
		By now,wo only test CC is ok on M6TV & G9TV
		CC is usually used in USA
config AMLOGIC_MEDIA_TVIN_AVDETECT
	tristate "Amlogic AVIN DETECT device"
	default n
	help
		avin detect devices driver
		Only for av input
endif
```

## drivers/amlogic/media/vin/tvin/vdin/Kconfig
```kconfig
#
# VDIN Device Driver Configuration
#

config AMLOGIC_MEDIA_VDIN
        tristate "Amlogic Vdin device driver"
        default n
        help
            Vdin device driver.
```

## drivers/amlogic/media/vin/tvin/viu/Kconfig
```kconfig
#
# Viu Device Driver Configuration
#
config AMLOGIC_MEDIA_VIUIN
        tristate "Amlogic VIUIN device driver"
        default n
        help
            VIUIN device driver.
```

## drivers/amlogic/media/vout/Kconfig
```kconfig
#
# Amlogic vout driver configuation
#

menu "Amlogic Vout Driver Support"

config AMLOGIC_VOUT
	bool "Amlogic Vout Driver"
	default n
	help
		Amlogic Video output module support.
		Vout module includes HDMI-TX, CVBS, PANEL(LCD, backlight) etc.
		Also provide display mode service for all the display modules.

if AMLOGIC_VOUT

source "drivers/amlogic/media/vout/cvbs/Kconfig"
source "drivers/amlogic/media/vout/vdac/Kconfig"
source "drivers/amlogic/media/vout/hdmitx/Kconfig"
source "drivers/amlogic/media/vout/lcd/Kconfig"
source "drivers/amlogic/media/vout/backlight/Kconfig"
source "drivers/amlogic/media/vout/vout_serve/Kconfig"

endif

endmenu
```

## drivers/amlogic/media/vout/backlight/Kconfig
```kconfig
menu "Amlogic Backlight Support"

config AMLOGIC_BACKLIGHT
	bool "Amlogic backlight support"
	depends on BACKLIGHT_LCD_SUPPORT
	depends on BACKLIGHT_CLASS_DEVICE
	default n
	help
		Say Y here if you want to use the Amlogic backlight management.
		Backlight have five ways, including gpio, pwm, pwm_combo,
		local dimming, extern.

if AMLOGIC_BACKLIGHT
source "drivers/amlogic/media/vout/backlight/bl_extern/Kconfig"
source "drivers/amlogic/media/vout/backlight/aml_ldim/Kconfig"
endif

endmenu
```

## drivers/amlogic/media/vout/backlight/aml_ldim/Kconfig
```kconfig
#
# LDIM Device Driver Configuration
#
config AMLOGIC_LOCAL_DIMMING
	bool "Amlogic Local Dimming"
	default n
	help
		Say Y if you want to use Amlogic Local dimming.
		The role of local dimming is according to each
		image information, calculate the corresponding
		brightness values, to improve the effect of image quality
```

## drivers/amlogic/media/vout/backlight/bl_extern/Kconfig
```kconfig
config AMLOGIC_BL_EXTERN
	bool "Amlogic backlight extern driver support"
	default n
	help
		Say Y if you want to use Amlogic backlight external controller.
		Amlogic backlight external driver support,
		such as i2c or mipi initial
		According to choose the corresponding bl_extern inside index bl_extern driver

config AMLOGIC_BL_EXTERN_I2C_LP8556
	bool "Amlogic backlight i2c lp8556"
	depends on AMLOGIC_BL_EXTERN
	default n
	help
		i2c lp8556 backlight controller support.
		Once the backlight power on, according to the timing requirements,
		through the i2c_lp8556 to write data to the backlight,
		make its initialization

config AMLOGIC_BL_EXTERN_MIPI_LT070ME05
	bool "Amlogic backlight mipi lt070me05"
	depends on AMLOGIC_BL_EXTERN
	default n
	help
		mipi LT070ME05 backlight controller support.
		Once the backlight power on, according to the timing requirements,
		through the mipi_LT070ME05 to write data to the backlight,
		make its initialization
```

## drivers/amlogic/media/vout/cvbs/Kconfig
```kconfig
#
# Video output configuration
#

config AMLOGIC_CVBS_OUTPUT
	bool "CVBS Output Module"
	default n
	help
		Amlogic cvbs output driver support.this is based on
		display driver as HDMI,LCD.
		cvbs output mode support:480cvbs 576cvbs.
		cvbsoutput performance enhancement.cvbs encoding.
		This driver is based on display driver.

config AMLOGIC_WSS
	bool "WSS function"
	default n
	depends on AMLOGIC_CVBS_OUTPUT
	help
		Wide Screen Signalling config.
		base on amlogic cvbs output driver.
		function cgms-a,wide screen,closed caption.
```

## drivers/amlogic/media/vout/hdmitx/Kconfig
```kconfig
#
# HDMITX
#
menu "Amlogic HDMITX Module"

config AMLOGIC_HDMITX
	bool "HDMITX Output Enable"
	default n
	help
		HDMITX Output Enable

endmenu
```

## drivers/amlogic/media/vout/lcd/Kconfig
```kconfig
#
# Video output configuration
#
menu "Amlogic LCD Output Module"

config AMLOGIC_LCD
	bool "LCD Output Module"
	default n
	help
		LCD output module
		support tv mode and tablet mode
		Through the inside of the DTS file "mode" is
		to choose a TV mode or tablet mode

config AMLOGIC_LCD_TV
	bool "LCD TV Output Module"
	default n
	depends on AMLOGIC_LCD
	help
		LCD TV output module
		Configure the LCD output model for TV output
		TV mode mainly includes vbyone and an LVDS interface display
		Through the environment variable is to choose panel_type lcd_index

config AMLOGIC_LCD_TABLET
	bool "LCD Tablet Output Module"
	default n
	depends on AMLOGIC_LCD
	help
		LCD Tablet output module
		Configure the LCD output model for Tablet output

if AMLOGIC_LCD
source "drivers/amlogic/media/vout/lcd/lcd_extern/Kconfig"
endif

endmenu
```

## drivers/amlogic/media/vout/lcd/lcd_extern/Kconfig
```kconfig
menuconfig AMLOGIC_LCD_EXTERN
	bool "LCD external driver support"
	default n
	help
		Amlogic LCD external driver support, such as i2c initial

config AMLOGIC_LCD_EXTERN_I2C_T5800Q
	bool "lcd external i2c T5800Q init driver"
	default n
	depends on AMLOGIC_LCD_EXTERN
	help
		Amlogic LCD external i2c_T5800Q init driver support
		Once the power on, according to the timing requirements,
		through the i2c interface to write data to the LCD,
		make its initialization

config AMLOGIC_LCD_EXTERN_I2C_DLPC3439
	bool "lcd external i2c DLPC3439 init driver"
	default n
	depends on AMLOGIC_LCD_EXTERN
	help
		Amlogic LCD external i2c_DLPC3439 init driver support
		Once the power on, according to the timing requirements,
		through the i2c interface to write data to the LCD,
		make its initialization

config AMLOGIC_LCD_EXTERN_I2C_ANX6345
	bool "lcd external i2c ANX6345 init driver"
	default n
	depends on AMLOGIC_LCD_EXTERN
	help
		Amlogic LCD external i2c_ANX6345 init driver support
		Once the power on, according to the timing requirements,
		through the i2c interface to write data to the LCD,
		make its initialization

config AMLOGIC_LCD_EXTERN_I2C_TC101
	bool "lcd external i2c TC101 init driver"
	default n
	depends on AMLOGIC_LCD_EXTERN
	help
		Amlogic LCD external i2c_TC101 init driver support
		Once the power on, according to the timing requirements,
		through the i2c interface to write data to the LCD,
		make its initialization

config AMLOGIC_LCD_EXTERN_SPI_LD070WS2
	bool "lcd external spi LD070WS2 init driver"
	default n
	depends on AMLOGIC_LCD_EXTERN
	help
		Amlogic LCD external spi_LD070WS2 init driver support
		Once the power on, according to the timing requirements,
		through the spi interface to write data to the LCD,
		make its initialization

config AMLOGIC_LCD_EXTERN_MIPI_KD080D13
	bool "lcd external mipi KD080D13 init driver"
	default n
	depends on AMLOGIC_LCD_EXTERN
	help
		Amlogic LCD external mipi_KD080D13 init driver support
		Once the power on, according to the timing requirements,
		through the mipi interface to write data to the LCD,
		make its initialization

config AMLOGIC_LCD_EXTERN_MIPI_N070ICN
	bool "lcd external mipi N070ICN init driver"
	default n
	depends on AMLOGIC_LCD_EXTERN
	help
		Amlogic LCD external mipi_N070ICN init driver support
		Once the power on, according to the timing requirements,
		through the mipi interface to write data to the LCD,
		make its initialization

config AMLOGIC_LCD_EXTERN_MIPI_TV070WSM
	bool "lcd external mipi TV070WSM init driver"
	default n
	depends on AMLOGIC_LCD_EXTERN
	help
		Amlogic LCD external mipi_TV070WSM init driver support
		Once the power on, according to the timing requirements,
		through the mipi interface to write data to the LCD,
		make its initialization
```

## drivers/amlogic/media/vout/lcd/lcd_tablet/Kconfig
```kconfig
config AMLOGIC_LCD_GAMMA_DEBUG
	bool "LCD Gamma debug support"
	default n
	help
		Amlogic LCD gamma debug
```

## drivers/amlogic/media/vout/vdac/Kconfig
```kconfig
#
# Video output configuration
#

config AMLOGIC_VDAC
	bool "VDAC Module"
	default n
	help
		VDAC config.
```

## drivers/amlogic/media/vout/vout_serve/Kconfig
```kconfig
#
# Amlogic VOUT_SERVE driver configuation
#

config AMLOGIC_VOUT_SERVE
	bool "Amlogic Vout_Serve Module"
	default n
	help
		Amlogic Video output Server support.
		Provide display mode service for all of the display modules.

config AMLOGIC_VOUT2_SERVE
	bool "Amlogic Vout2_Serve Module"
	default n
	help
		Amlogic Video output2 Server support.
		Provide 2nd display mode service for all of the display modules.
```

## drivers/amlogic/memory_ext/Kconfig
```kconfig
menuconfig AMLOGIC_MEMORY_EXTEND
	bool "AMLOGIC memory extend support"
	depends on AMLOGIC_DRIVER
	depends on AMLOGIC_MODIFY
	default y
	help
		Amlogic memory extend is drivers which extend for memory management
		functions, can be used for memory debug or other features.

config AMLOGIC_PAGE_TRACE
	bool "Amlogic trace for page allocate"
	depends on AMLOGIC_MEMORY_EXTEND
	depends on KALLSYMS
	default y
	help
		Amlogic page trace will record function address of caller for page
		allocate/free, according with allocate flags and order. trace
		information is stored in a pre-allocated memory block. And can be shown
		with allocate page count information of each caller functions from
		/proc/pagetrace

config AMLOGIC_RAMDUMP
	bool "Amlogic RAM DUMP support"
	depends on AMLOGIC_MEMORY_EXTEND
	depends on PANIC_TIMEOUT != 0
	default n
	help
		RAM dump support for amlogic platform, when system is rebooted
		after panic/watch dog reboot, you may need this option to save
		whole ram to /data/ partition. Which can be used for analyze
		crash reason.

config AMLOGIC_CMA
	bool "Amlogic CMA change"
	depends on AMLOGIC_MEMORY_EXTEND
	depends on CMA
	default y
	help
		Amlogic CMA optimization for cma alloc/free problems
		Including policy change of CMA usage

config AMLOGIC_VMAP
	bool "Amlogic kernel stack"
	depends on AMLOGIC_MEMORY_EXTEND
	depends on !KASAN
	depends on 64BIT
	default y
	help
		This config is used to enable amlogic kernel stack
		usage optimization with vmalloc. It depends on
		AMLOGIC_MEMORY_EXTEND. This config only opened
		on 64 bit platform.

config AMLOGIC_SLUB_DEBUG
	bool "Amlogic debug for trace all slub objects"
	depends on AMLOGIC_PAGE_TRACE
	depends on SLUB
	default n
	help
		This option open trace debug for each slub objects. And will give
		slub objdect allocator information when detected bad objects
```
