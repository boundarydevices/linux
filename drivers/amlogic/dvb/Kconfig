## drivers/amlogic/dvb/Kconfig
```kconfig
menu "DVB COMPAT support"
config AMLOGIC_DVB_COMPAT
       bool "Amlogic DVB drivers"
       depends on COMPAT
       help
               select it to support amlogic dvb driver
endmenu
```

## drivers/amlogic/efuse/Kconfig
```kconfig
#
# Amlogic efuse device configuration
#

menu "EFUSE Support"

config AMLOGIC_EFUSE
	bool	"amlogic EFUSE Driver"
	default	n
	help
		amlogic EFUSE device driver,
		not choose by default,
		if you want to use,
		choose y.

config	AMLOGIC_EFUSE_WRITE_VERSION_PERMIT
	depends	on AMLOGIC_EFUSE
	bool	"efuse write version permit"
	default	n
	help
		efuse version is prohibited writing in kernel default case,
		if it must be written, enable this config
		if you don't understand efuse version, please don't enable this config


endmenu
```

## drivers/amlogic/esm/Kconfig
```kconfig
menu "ESM Support"

config AMLOGIC_ESM
  bool "Embedded Security Module Enable"
  depends on AMLOGIC_HDMITX || TVIN_HDMI
  help
    Embedded Security Module(ESM) for HDCP22

endmenu
```

## drivers/amlogic/ethernet/phy/Kconfig
```kconfig
#
# PHY Layer Configuration
#

config AMLOGIC_INTERNAL_PHY
	tristate "Drivers for amlogic internal phy"
	---help---
	  Currently supports the amlogic internal phy.
	  This module implements the amlogic internal phy,
	  modify the dts file to switch internal external phy.

	  if in doube, ask yizhou.
```

## drivers/amlogic/i2c/Kconfig
```kconfig
#
# Amlogic i2c device configuration
#

menu  "I2C Hardware Bus support"

config AMLOGIC_I2C
	bool "Amlogic I2C Driver"
	select I2C
	select I2C_CHARDEV
	select I2C_ALGOBIT
	help
		Amlogic software
		I2C Driver
		Yet another Amlogic I2C Driver,
		normal master.

config AMLOGIC_I2C_SLAVE
	bool "Amlogic I2C Slave Driver"
	depends on AMLOGIC_I2C
	help
		Amlogic software
		I2C Driver
		Yet
		Amlogic I2C Slave Driver.

config AMLOGIC_I2C_MASTER
	bool "Amlogic I2C Master Driver"
	depends on AMLOGIC_I2C
	help
		Amlogic software
		I2C Driver
		Yet
		Amlogic I2C Master Driver.

endmenu
```

## drivers/amlogic/iio/Kconfig
```kconfig
#
# Industrial I/O subsystem configuration
#

menuconfig AMLOGIC_IIO
	tristate "Industrial I/O support"
	help
	  The industrial I/O subsystem provides a unified framework for
	  drivers for many different types of embedded sensors using a
	  number of different physical interfaces (i2c, spi, etc).

if AMLOGIC_IIO

source "drivers/amlogic/iio/adc/Kconfig"

endif #IIO
```

## drivers/amlogic/iio/adc/Kconfig
```kconfig
#
# ADC drivers
#
# When adding new entries keep the list in alphabetical order

menu "Analog to digital converters"

config AMLOGIC_SARADC
	bool "Meson SAR ADC support"
	depends on REGMAP_MMIO
	depends on IIO
	depends on IIO_BUFFER
	depends on IIO_KFIFO_BUF
	default n
	help
	  Say Y here if you want to use the Meson SAR ADC.

endmenu
```

## drivers/amlogic/input/Kconfig
```kconfig
#
# Input device configuration
#

menuconfig AMLOGIC_INPUT
	bool "Input Device Support"
	default n
	help
	  "Input devices include keyboard, touchscreen, remote, sensor, etc."

if AMLOGIC_INPUT

source "drivers/amlogic/input/avin_detect/Kconfig"

source "drivers/amlogic/input/keyboard/Kconfig"

source "drivers/amlogic/input/remote/Kconfig"

source "drivers/amlogic/input/touchscreen/Kconfig"

source "drivers/amlogic/input/sensor/Kconfig"

endif
```

## drivers/amlogic/input/avin_detect/Kconfig
```kconfig
#
# avin detect driver configuration
#

config AMLOGIC_AVIN_DETECT
	tristate "tv av-in detect module support"
	default n
	help
		Amlogic TV AV-IN detect management.
```

## drivers/amlogic/input/keyboard/Kconfig
```kconfig
#
# Kyeboard device configuration
#

menuconfig AMLOGIC_INPUT_KEYBOARD
	bool "Keyboards and keypads"
	default n
	help
	  Say Y here, and a list of supported keyboards and keypads will be displayed.
	  This option doesn't affect the kernel.

	  If unsure, say Y.

if AMLOGIC_INPUT_KEYBOARD

config AMLOGIC_ADC_KEYPADS
	tristate "Meson ADC keypad support"
	depends on AMLOGIC_SARADC
	default n
	help
	  Say Y here if you want to use the Meson ADC keypad.

config AMLOGIC_GPIO_KEY
        tristate "Amlogic gpio key device surport"
        default n
        help
          Say Y here if you want to use the amlogic hold key.

config AMLOGIC_PCA9557_KEYPAD
        tristate "Amlogic pca9557 keypad device surport"
        default n
        help
          Say Y here if you want to use the amlogic hold key.

endif # AMLOGIC_INPUT_KEYBOARD
```

## drivers/amlogic/input/remote/Kconfig
```kconfig
#
# Remote control drivers
#
menuconfig AMLOGIC_REMOTE
	bool "GX Remotes"
	default n
	help
	  Say Y here, and a list of supported remote controls will be displayed.
	  This option doesn't affect the kernel.

	  If unsure, say Y.

if AMLOGIC_REMOTE

config AMLOGIC_MESON_REMOTE
	tristate "GX IR remote control support"
	default n
	help
	  Say Y here if you want to use the Meson IR remote control.



endif # AMLOGIC_REMOTE
```

## drivers/amlogic/input/saradc/Kconfig
```kconfig
#
# Input core configuration
#
config AMLOGIC_SARADC
	bool "Meson SAR ADC support"
	default n
	help
	  Say Y here if you want to use the Meson SAR ADC.
```

## drivers/amlogic/input/sensor/Kconfig
```kconfig
menuconfig AMLOGIC_SENSOR
	bool "Sensor devices"
	---help---
	  Say Y here to get to see options for sensor device drivers from
	  all categories. This option alone does not add any kernel code.

	  If you say N,all options in this submenu will be skipped and disabled.

if AMLOGIC_SENSOR

config AMLOGIC_SENSOR_CY8C4014
	tristate "cy8c4014 sensor driver"
	depends on I2C
	default n
	help
	  Say yes here to support Cypress cy8c4014 sensor and proximity
	  sensor
	  Say yes here to support Cypress cy8c4014 sensor and proximity
	  sensor

endif # SENSOR_DEVICES
```

## drivers/amlogic/input/touchscreen/Kconfig
```kconfig
#
# touchscreen drivers
#

menuconfig AMLOGIC_TOUCHSCREEN
	bool "amlogic touchscreen"
	default n
	help
	  Say Y here, and a list of supported touchscreen driver will be displayed.
	  This option doesn't affect the kernel.

if AMLOGIC_TOUCHSCREEN

config AMLOGIC_TOUCHSCREEN_FTS
	tristate "facaltech FT_xx touch driver support"
	depends on I2C
	default n
	help
	  Say Y here if you want to use facaltech FT_xx.

config AMLOGIC_TOUCHSCREEN_GT1X
	tristate "goodix gt1x touch driver support"
	depends on I2C
	default n
	help
	  Say Y here if you want to use goodix gt1x.

endif
```

## drivers/amlogic/input/touchscreen/focaltech_touch/Kconfig
```kconfig
#
# Focaltech Touchscreen driver configuration
#

config AMLOGIC_TOUCHSCREEN_FTS
        bool "Focaltech Touchscreen"
		depends on I2C
		default n
		help
		  Say Y here if you have Focaltech touch panel.
		  If unsure, say N.

config AMLOGIC_TOUCHSCREEN_FTS_DIRECTORY
    string "Focaltech ts directory name"
    default "focaltech_touch"
    depends on AMLOGIC_TOUCHSCREEN_FTS
    
```

## drivers/amlogic/input/touchscreen/goodix_gt1x/Kconfig
```kconfig
#
# Goodix Touchscreen driver configuration
#

config AMLOGIC_TOUCHSCREEN_GT1X
	bool "Goodix GT1X Touchscreen"
		depends on I2C
		default n
		help
		  Say Y here if you have Goodix GT1X touch panel.
		  If unsure, say N.
```

## drivers/amlogic/input/touchscreen/hyn_cst2xx/Kconfig
```kconfig
#
#  Touchscreen driver configuration
#

config  TOUCHSCREEN_HYN_CST2XX
       tristate  "hyn_CST2XX touchscreen driver"
       depends on INPUT && I2C
       default m
       help
		hyn_CST2XX touchscreen driver
```

## drivers/amlogic/iomap/Kconfig
```kconfig
# Amlogic iomap driver
#
config AMLOGIC_IOMAP
    bool "Amlogic iomap support"
    select REGMAP_MMIO
    help
      This is the Amlogic Iomap  driver
```

## drivers/amlogic/irblaster/Kconfig
```kconfig
#
# Input core configuration
#
config AMLOGIC_IRBLASTER
	bool "Amlogic irblaster device surport"
	default n
	help
	  Say Y here if you want to use the amlogic irblaster.
```

## drivers/amlogic/irqchip/Kconfig
```kconfig
config AMLOGIC_GPIO_IRQ
	bool "Meson GPIO Interrupt Multiplexer"
	depends on IRQ_DOMAIN
	depends on IRQ_DOMAIN_HIERARCHY
	default n
	help
	  Support Meson SoC Family GPIO Interrupt Multiplexer
```

## drivers/amlogic/jtag/Kconfig
```kconfig
#
# Amlogic jtag configuration
#

menuconfig AMLOGIC_JTAG
	bool "Amlogic JTAG Support"
	default n
	help
		Say Y here to enable jtag support.

		This option alone does not add any kernel code.


if AMLOGIC_JTAG

config	AMLOGIC_JTAG_MESON
	bool "meson jtag setup driver"
	default n
	help
		This option enables support jtag setup.

		Enable this option to allow setup jtag with uboot parameter.

endif
```

## drivers/amlogic/key_manage/Kconfig
```kconfig
#
# Amlogic key device configuration
#

menu "key management Support"

config AMLOGIC_KEY_MANAGE
	bool "key management Driver"
	default n
	help
	    key management device driver.
	    y here, means select key manage
	    n here, means don't use key manage

endmenu
```

## drivers/amlogic/led/Kconfig
```kconfig
#
# LED drivers configuration
#

menuconfig AMLOGIC_LED
	bool "Amlogic LED Support"
	default n
	help
	  Say Y here to get to see options for led drivers.
	  This option alone does not add any kernel code.

	  If you say N, all options in this submenu will be
	  skipped and disabled.


if AMLOGIC_LED

config AMLOGIC_LED_SYS
	bool "System LED Support"
	depends on LEDS_CLASS
	default n
	help
	  This option enables support for system led drivers.

	  Enable this option to allow the userspace to control
	  the system led.

endif
```

## drivers/amlogic/ledring/Kconfig
```kconfig
#
# LEDRING drivers configuration
#
config AMLOGIC_LEDRING
	bool "System ledring Support"
	default n
	help
	  This option enables support for system ledring drivers.
```

## drivers/amlogic/mailbox/Kconfig
```kconfig
#
# Amlogic mhu mailbox device configuration
#

menu "MESON MHU mailbox Support"

config AMLOGIC_MHU_MBOX
	tristate "MESON MHU Mailbox"
	default n
	select MAILBOX
	select ARM_SCPI_PROTOCOL
	help
		MESON MHU Mailbox driver.
		.
		.
		.

config ARM_SCPI_PROTOCOL
	tristate "ARM System Control and Power Interface (SCPI) Message Protocol"
	default n
	help
		System Control and Power Interface (SCPI) Message Protocol is
		defined for the purpose of communication between the Application
		Cores(AP) and the System Control Processor(SCP). The MHU peripheral
		provides a mechanism for inter-processor communication between SCP
		and AP.

		This protocol library provides interface for all the client drivers
		making use of the features offered by the SCP.

endmenu
```
