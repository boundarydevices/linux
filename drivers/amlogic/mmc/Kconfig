## drivers/amlogic/mmc/Kconfig
```kconfig
# Amlogic MMC driver

comment "MMC/SD/SDIO Host Controller Drivers"

menu "Multimedia Card support"

config AMLOGIC_MMC
	bool "Amlogic Multimedia Card support"
	depends on MMC
	depends on MMC_BLOCK
	depends on MMC_BLOCK_BOUNCE
	default n
	help
	This selects support for the Amlogic SD/MMC Host Controller
	found on the S912/GXM family of SoCs.  This controller is
	MMC 5.1 compliant and supports SD, eMMC and SDIO interfaces.
	If you have a controller with this interface, say Y here.

config AMLOGIC_M8B_MMC
	bool "Amlogic M8B Multimedia Card support"
	depends on AMLOGIC_MMC
	default n
	help
	This selects support for the Amlogic SD/MMC Host Controller
	found on the S805/M8B family of SoCs.  This controller is
	MMC 5.1 compliant and supports SD, eMMC and SDIO interfaces.
	If you have a controller with this interface, say Y here.


endmenu
```

## drivers/amlogic/mtd/Kconfig
```kconfig
#
# Amlogic NAND device configuration
#

menu "Meson NAND Device Support"

config AMLOGIC_NAND
	bool "Meson NAND flash device"
	default n
	depends on MTD_BLOCK
	depends on MTD_NAND
	depends on MTD
	help
		Amlogic mtd support config.
		Support for MTD NAND flash on Amlogic Meson platforms
		Need open in defconfig, set CONFIG_AMLOGIC_NAND=y
		need check
endmenu
```

## drivers/amlogic/mtd_meson8b/Kconfig
```kconfig
#
# Amlogic NAND device configuration
#

menu "Meson8B NAND Device Support"

config AMLOGIC_M8B_NAND
	bool "Meson8B NAND flash device"
	default n
	depends on MACH_MESON8B
	depends on MTD_BLOCK
	depends on MTD_NAND
	depends on MTD
	help
		Amlogic mtd support config.
		Support for MTD NAND flash on Amlogic Meson platforms
		Need open in defconfig, set CONFIG_AMLOGIC_M8B_NAND=y
		need check
endmenu
```

## drivers/amlogic/pci/Kconfig
```kconfig
menu "Multimedia Card support"

config AMLOGIC_PCIE
	bool "Amlogic Multimedia Card support"
	depends on PCI
	depends on PCI_MSI_IRQ_DOMAIN
	help
	This selects support for the Amlogic PCIE Host Controller
	found on the A113 family of SoCs.  This controller is
	GEN2 compliant.
	If you have a controller with this interface, say Y here.


endmenu
```

## drivers/amlogic/pinctrl/Kconfig
```kconfig
menuconfig AMLOGIC_PINCTRL
	bool "PINCTRL/GPIO support"
	select OF
	select PINCTRL
	select PINMUX
	select PINCONF
	select GENERIC_PINCONF
	select GPIOLIB
	select OF_GPIO
	select REGMAP_MMIO

if AMLOGIC_PINCTRL

config AMLOGIC_PINCTRL_MESON8B
	bool "Meson 8b SoC pinctrl driver"
	depends on ARM
	select AMLOGIC_PINCTRL_MESON8_PMX
	default n

config AMLOGIC_PINCTRL_MESON_GXL
	bool "Meson gxl SoC pinctrl driver"
	depends on ARM64 || ARM64_A32
	select AMLOGIC_PINCTRL_MESON8_PMX
	default n

config AMLOGIC_PINCTRL_MESON_AXG
	bool "Meson axg SoC pinctrl driver"
	depends on ARM64 || ARM64_A32
	select AMLOGIC_PINCTRL_MESON_AXG_PMX
	default n

config AMLOGIC_PINCTRL_MESON_TXLX
	bool "Meson txlx SoC pinctrl driver"
	depends on ARM64 || ARM64_A32
	select AMLOGIC_PINCTRL_MESON8_PMX
	default n

config AMLOGIC_PINCTRL_MESON_G12A
	bool "Meson g12a SoC pinctrl driver"
	depends on ARM64 || ARM64_A32
	select AMLOGIC_PINCTRL_MESON_AXG_PMX
	select AMLOGIC_PINCONF_MESON_G12A
	default n

config AMLOGIC_PINCTRL_MESON_TXL
	bool "Meson txl SoC pinctrl driver"
	depends on ARM64 || ARM64_A32
	select AMLOGIC_PINCTRL_MESON8_PMX
	default n

config AMLOGIC_PINCTRL_MESON_TL1
	bool "Meson tl1 SoC pinctrl driver"
	depends on ARM64 || ARM64_A32
	select AMLOGIC_PINCTRL_MESON_AXG_PMX
	select AMLOGIC_PINCONF_MESON_G12A
	default n

config AMLOGIC_PINCONF_MESON_G12A
	bool

config AMLOGIC_PINCTRL_MESON8_PMX
	bool

config AMLOGIC_PINCTRL_MESON_AXG_PMX
	bool
endif
```

## drivers/amlogic/pm/Kconfig
```kconfig
# Amlogic pm

menu "Meson core pm driver"

config AMLOGIC_SUSPEND
    bool "Meson chips pm driver"
    depends on PM
    default n
    help
      This is the Amlogic core pm driver for meson family chips
      AMLOGIC_GX_SUSPEND provides pm driver for GX family chips
      AMLOGIC_M8B_SUSPEND provides pm driver for m8b (32bit) chip.
      If you want this support, you should say Y here.

config AMLOGIC_GX_SUSPEND
    bool "Meson gx chips pm driver"
    depends on AMLOGIC_SUSPEND
    depends on CPU_IDLE
    depends on PM_WAKELOCKS
    depends on PM
    depends on ARM64 || ARM64_A32
    default n
    help
      This is the Amlogic suspend driver for 64bit family chips
      It provides PM suspend entry to ATF. It invoke ATF via idle routine.
      It support PSCIv0.2 or newer version.

      If you want this support, you should say Y here.

config AMLOGIC_M8B_SUSPEND
    bool "Meson mx chips pm driver"
    depends on AMLOGIC_SUSPEND
    depends on PM_WAKELOCKS
    depends on PM
    depends on ARM
    default n
    help
      This is the Amlogic suspend driver for 32bit family chips
      It provides PM suspend entry to suspend firmware.
      It invoke suspend firmware via idle routine.

      If you want this support, you should say Y here.

config AMLOGIC_LEGACY_EARLY_SUSPEND
    bool "A re-implement early_suspend instead of legacy ealry_suspend."
    depends on AMLOGIC_GX_SUSPEND || AMLOGIC_M8B_SUSPEND
    depends on PM
    default n
    help
      Kernel has abandoned legacy early_suspend mechanism.
      Here re-implement a early_suspend for use driver legacy early_suspend code easily.

      If you want this support, you should say Y here.

endmenu
```

## drivers/amlogic/power/Kconfig
```kconfig
config AMLOGIC_POWER
	bool "Amloigc power related driver support"
	default n
	help
		this config enables to use amlogic power management driver
		Say y here if you want power related driver(pmu/dvfs) support

config AMLOGIC_PMU_OF
	bool "Amlogic Power OF support"
	depends on AMLOGIC_POWER
	depends on I2C
	default n
	help
		Power management device tree support

source "drivers/amlogic/power/aml_pmu/Kconfig"
source "drivers/amlogic/power/aml_dvfs/Kconfig"
```

## drivers/amlogic/power/aml_dvfs/Kconfig
```kconfig
config AMLOGIC_M8B_DVFS
	bool "Amlogic DVFS interface support"
	depends on AMLOGIC_POWER
	default n
	help
		interface for clock adjustment and power management
```

## drivers/amlogic/power/aml_pmu/Kconfig
```kconfig
menuconfig AMLOGIC_PMU
	bool "Amlogic PMU drivers"
	depends on AMLOGIC_POWER
	depends on I2C
	default n
	---help---
		say yes if you want add Amlogic power management unit support

if AMLOGIC_PMU

config AMLOGIC_1218
	bool "AML1218 driver"
	---help---
		drivers for amlogic pmu AML1218

endif #AMLOGIC_PMU
```

## drivers/amlogic/pwm/Kconfig
```kconfig
#
# PWM configuration
#


menuconfig AMLOGIC_PWM
	bool "Amlogic PWM driver"
	depends on PWM_SYSFS
	depends on PWM
	default n
	help
	  say y to enable Amlogic PWM driver.
```

## drivers/amlogic/reboot/Kconfig
```kconfig
# Amlogic POWER OFF
config AMLOGIC_REBOOT
	bool "Amlogic Board level reboot or power off"
	default n
    help
		This is the Amlogic
		Board reboot
		or poweroff
		driver.

config AMLOGIC_GX_REBOOT
	bool "Amlogic reboot gx"
	depends on AMLOGIC_REBOOT
	default n
    help
		This is the Amlogic GX reboot driver.

config AMLOGIC_M8B_REBOOT
	bool "Amlogic reboot m8b"
	depends on AMLOGIC_REBOOT
	default n
    help
		This is the Amlogic M8b reboot driver.

config AMLOGIC_M8B_REBOOT_UBOOT_SUSPEND
	bool "Amlogic reboot uboot suspend"
	depends on AMLOGIC_M8B_REBOOT
	default n
    help
		This is the Amlogic M8b reboot uboot suspend driver.
```

## drivers/amlogic/reg_access/Kconfig
```kconfig
# Amlogic DEBUG
#
config AMLOGIC_REG_ACCESS
    bool "Amlogic register access from userspace support"
    default n
    help
      This is the Amlogic debug sysfs interface driver using debugfs interface
```

## drivers/amlogic/secmon/Kconfig
```kconfig
# Amlogic secure monitor driver


config AMLOGIC_SEC
	bool "Amlogic secure monitor driver support"
	default n
	help
		This is the Amlogic secure monitor driver
		this config only ctrl in makefile
		prepare share memory
		etc
```

## drivers/amlogic/secure_monitor/Kconfig
```kconfig
#
# Amlogic secure monitor configuration
#

menuconfig AMLOGIC_SM
	bool "Amlogic SM(secure monitor) Support"
	default n
	help
		Say Y here to enable SM support.
		This option alone does not add any kernel code.


if AMLOGIC_SM
config	AMLOGIC_M8B_SM
	bool "Amlogic meson8b SM(secure monitor) driver"
	default n
	depends on AMLOGIC_SM
	help
		This option enables support SM.
		choose y to enable secure monitor.
		choose n to disable secure monitor
endif
```

## drivers/amlogic/securitykey/Kconfig
```kconfig
# Amlogic security key driver


config AMLOGIC_SECURITY_KEY
    bool "Amlogic security key driver support"
    help
      This is the Amlogic security key driver
```

## drivers/amlogic/smartcard/Kconfig
```kconfig
#
#Smart card driver configuration
#

config AMLOGIC_SMARTCARD
	bool "Amlogic Smartcard driver"
	default n
```

## drivers/amlogic/spi-nor/Kconfig
```kconfig
#
# Amlogic SPI NOR Flash device configuration
#

menu "Meson SPI NOR Flash Support"

config SPI_AML_SPIFC
	bool "Meson SPI NOR Flash device"
	default n
	depends on MTD_SPI_NOR
	help
		Amlogic spi nor flash support config.
		Support for spi nor flash on Amlogic Meson platforms
		Need open in defconfig, set CONFIG_SPI_AML_SPIFC=y
		need check
endmenu
```

## drivers/amlogic/tee/Kconfig
```kconfig
config AMLOGIC_TEE
	tristate "TEE Support for Amlogic"
	default n
	help
	  Amlogic TEE driver

	  Provide TEE APIs and Debug interface in sysfs, depends on the
	  tee os.
```

## drivers/amlogic/thermal/Kconfig
```kconfig
#
# Amlogic temperature sensor configuration
#

menu "Amlogic temperature sensor"

config AMLOGIC_TEMP_SENSOR
	bool "Amlgoic temperature sensor Support"
	depends on THERMAL
	default n
	---help---
		Thermal sensor low level support for thermal
		This driver parse thermal config data from device tree files.
		And register each cooling device for thermal framework.

		If you wan this driver, selest it.

config AMLOGIC_M8B_TEMP_SENSOR
	bool "Amlgoic temperature sensor Support for M8 chips"
	depends on AMLOGIC_TEMP_SENSOR
	depends on MACH_MESON8B
	default n
	help
		this config enables thermal driver for M8/M8baby chips.
		Say Y if you want this driver.

config AMLOGIC_GX_TEMP_SENSOR
	bool "Amlgoic temperature sensor Support for GX chips"
	depends on AMLOGIC_TEMP_SENSOR
	depends on ARM64 || ARM64_A32
	default y
	help
		this config enables thermal driver for GX/GXB/GXL/GXM chips.
		Say Y if you want this driver.

config AMLOGIC_CPUCORE_THERMAL
	bool "generic cpu core cooling support"
	depends on AMLOGIC_TEMP_SENSOR
	default n
	help
	  This implements the generic cpu cooling mechanism through reduce cpu core numbers.
	  This will be useful for platforms using the generic thermal interface
	  and not the ACPI interface.

	  If you want this support, you should say Y here.

config AMLOGIC_GPU_THERMAL
	bool "generic gpu cooling support"
	depends on AMLOGIC_TEMP_SENSOR
	default n
	help
	  This implements the generic gpu cooling mechanism through frequency
	  reduction. An ACPI version of this already exists
	  (drivers/acpi/processor_thermal.c).
	  This will be useful for platforms using the generic thermal interface
	  and not the ACPI interface.

	  If you want this support, you should say Y here.

config AMLOGIC_GPUCORE_THERMAL
	bool "generic gpu core cooling support"
	depends on AMLOGIC_TEMP_SENSOR
	default n
	help
	  This implements the generic cpu cooling mechanism through reduce cpu core numbers.
	  This will be useful for platforms using the generic thermal interface
	  and not the ACPI interface.

	  If you want this support, you should say Y here.

endmenu
```

## drivers/amlogic/uart/Kconfig
```kconfig
#
# Amlogic driver configuration
#

config AMLOGIC_UART
	bool "Serial support"
	select SERIAL_CORE
	select SERIAL_EARLYCON
	default n
    help
	Add support for the Amlogic serial port.
	this config only ctrl in makefile
	this config do not in meson_uart.c
	this config add

config AMLOGIC_SERIAL_MESON_CONSOLE
	bool "Console on Amlogic Serial port"
	select SERIAL_CORE_CONSOLE
	default n
	help
		Support for running a console on the Amlogic serial
		this config is only
		used in meson_uart.c
		so so

config AMLOGIC_PRINTK_NOBLOCK_MODE
    bool "printk with no block"
    depends on AMLOGIC_SERIAL_MESON_CONSOLE
    default n
    help
        printk with no block
        push tx data to internal buffer first
        default size of internal buffer is 128K
        when enabled, new_printk_enabled=1
```

## drivers/amlogic/unifykey/Kconfig
```kconfig
#
# Amlogic key device configuration
#

menu "unifykey Support"

config AMLOGIC_UNIFYKEY
	bool "Amlogic unifykey driver support"
	default n
	help
	    platform independent part of unifykey driver
	    y here, means select unifykey
	    n here, means don't use unifykey

config AMLOGIC_V8_UNIFYKEY
	bool "Amlogic unifykey driver support for armv8"
	default n
	depends on AMLOGIC_UNIFYKEY
	help
	    Support for unifykey on S905 devices
	    y here, means select unifykey for gx
	    n here, means don't use unifykey for gx

config AMLOGIC_V7_UNIFYKEY
	bool "Amlogic unifykey driver support for armv7"
	default n
	depends on AMLOGIC_UNIFYKEY
	help
	    Support for unifykey on S805 devices
	    y here, means select unifykey for m8b
	    n here, means don't use unifykey for m8b

endmenu
```

## drivers/amlogic/usb/Kconfig
```kconfig
menu "USB Support"

config AMLOGIC_USB
	tristate "Amlogic USB controller support"
	depends on AMLOGIC_USB_HOST_ELECT_TEST
	select OF_LM
	depends on USB
	help
	   DWC_OTG
	   USB
	   host
	   controller.

config AMLOGIC_USB_DWC_OTG_HCD
	tristate "USB Host controller dwc_otg support"
	depends on AMLOGIC_USB
	help
	   USB Host
	   controller
	   dwc_otg
	   support
config AMLOGIC_USB_HOST_ELECT_TEST
	bool "USB high speed electric test"
	help
	    Enable this config to support USB High speed electric test.

config AMLOGIC_USBPHY
	bool "Amlogic USB PHY Driver"
	depends on AMLOGIC_USB
	help
	  Enable this to support Amlogic USB phy helper driver for Amlogic SoCs.
	  This driver provides common interface to interact, for Amlogic USB 2.0 PHY
	  driver and later for Amlogic USB 3.0 PHY driver.

	  This driver supports GXBABYTV and G9TV.

          To compile this driver as a module, choose M here: the
          module will be called phy-aml-usb.

config AMLOGIC_USB2PHY
	bool "Amlogic USB 2.0 PHY controller Driver"
	depends on AMLOGIC_USBPHY
	help
	  Enable this to support Amlogic USB 2.0 (High Speed) PHY controller
	  for Amlogic SoCs.

	  This driver supports GXBABYTV and G9TV.

	  To compile this driver as a module, choose M here: the
          module will be called phy-aml-usb.

config AMLOGIC_USB3PHY
	bool "Amlogic USB 3.0 PHY controller Driver"
	depends on AMLOGIC_USBPHY
	help
	  Enable this to support Amlogic USB 3.0 (Super Speed) phy controller
	  for Amlogic SoCs.

	  This driver supports GXBABYTV and G9TV.

          To compile this driver as a module, choose M here: the
          module will be called phy-aml-usb.
endmenu
```

## drivers/amlogic/vrtc/Kconfig
```kconfig
# Amlogic VRTC

config AMLOGIC_VRTC
    bool "meson VRTC support"
    default n
    select RTC_CLASS
    help
      This is the Amlogic virtual Real Time Clock driver,
      which only has alarm function.
```

## drivers/amlogic/watchdog/Kconfig
```kconfig
#
# watchdog configuration
#


menuconfig AMLOGIC_WDT
	bool "Amlogic Watchdog Support"
	select WATCHDOG
	select WATCHDOG_CORE
	default n
	help
	  say y to enable Amlogic watchdog driver.


if AMLOGIC_WDT
config AMLOGIC_WDT_MESON
	bool "Amlogic Meson Watchdog"
	default n
	help
	  say y to enable Amlogic meson watchdog driver.

config AMLOGIC_WDT_MESON_V3
	tristate "Amlogic Meson SoCs Watchdog V3"
	default n
	help
	  Say Y here to include support for the watchdog timer
	  in Amlogic Meson SoCs.
	  To compile this driver as a module, choose M here.


endif
```

## drivers/amlogic/wifi/Kconfig
```kconfig
config AMLOGIC_WIFI
	bool "WiFi support"
	select WIRELESS_EXT
	select WEXT_PRIV
	default n
	help
		select y to support wifi
```
