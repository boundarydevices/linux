## arch/arm/configs/sp_defconfig
```kconfig
CONFIG_KERNEL_LZO=y
CONFIG_SYSVIPC=y
CONFIG_FHANDLE=y
CONFIG_NO_HZ=y
CONFIG_HIGH_RES_TIMERS=y
CONFIG_IKCONFIG=y
CONFIG_IKCONFIG_PROC=y
CONFIG_LOG_BUF_SHIFT=18
CONFIG_CGROUPS=y
CONFIG_RELAY=y
CONFIG_BLK_DEV_INITRD=y
CONFIG_EMBEDDED=y
CONFIG_PERF_EVENTS=y
# CONFIG_COMPAT_BRK is not set
CONFIG_MODULES=y
CONFIG_MODULE_UNLOAD=y
CONFIG_MODVERSIONS=y
CONFIG_MODULE_SRCVERSION_ALL=y
CONFIG_PARTITION_ADVANCED=y
CONFIG_GPIO_PCA953X=y
CONFIG_ARCH_MXC=y
CONFIG_SOC_IMX6Q=y
CONFIG_SOC_IMX6SL=y
CONFIG_PCI=y
CONFIG_PCI_MSI=y
CONFIG_PCI_IMX6=y
CONFIG_SMP=y
CONFIG_VMSPLIT_2G=y
CONFIG_PREEMPT_VOLUNTARY=y
CONFIG_AEABI=y
# CONFIG_OABI_COMPAT is not set
CONFIG_KSM=y
CONFIG_SECCOMP=y
CONFIG_CMDLINE="noinitrd console=ttymxc0,115200"
CONFIG_CPU_FREQ=y
CONFIG_CPU_FREQ_DEFAULT_GOV_INTERACTIVE=y
CONFIG_CPU_FREQ_GOV_POWERSAVE=y
CONFIG_CPU_FREQ_GOV_USERSPACE=y
CONFIG_CPU_FREQ_GOV_ONDEMAND=y
CONFIG_CPU_FREQ_GOV_CONSERVATIVE=y
CONFIG_ARM_IMX6_CPUFREQ=y
CONFIG_CPU_IDLE=y
CONFIG_VFP=y
CONFIG_NEON=y
CONFIG_BINFMT_MISC=y
CONFIG_PM_RUNTIME=y
CONFIG_PM_DEBUG=y
CONFIG_PM_TEST_SUSPEND=y
CONFIG_NET=y
CONFIG_PACKET=y
CONFIG_UNIX=y
CONFIG_INET=y
CONFIG_IP_PNP=y
CONFIG_IP_PNP_DHCP=y
# CONFIG_INET_XFRM_MODE_TRANSPORT is not set
# CONFIG_INET_XFRM_MODE_TUNNEL is not set
# CONFIG_INET_XFRM_MODE_BEET is not set
# CONFIG_INET_LRO is not set
CONFIG_IPV6=y
CONFIG_NETFILTER=y
CONFIG_BT=y
CONFIG_BT_RFCOMM=y
CONFIG_BT_RFCOMM_TTY=y
CONFIG_BT_BNEP=y
CONFIG_BT_BNEP_MC_FILTER=y
CONFIG_BT_BNEP_PROTO_FILTER=y
CONFIG_BT_HIDP=y
CONFIG_BT_HCIUART=y
CONFIG_BT_HCIUART_H4=y
CONFIG_CFG80211=m
CONFIG_MAC80211=m
CONFIG_MAC80211_LEDS=y
CONFIG_RFKILL=y
CONFIG_RFKILL_GPIO=y
CONFIG_DEVTMPFS=y
CONFIG_DEVTMPFS_MOUNT=y
# CONFIG_STANDALONE is not set
CONFIG_CMA=y
CONFIG_CMA_SIZE_MBYTES=256
CONFIG_CONNECTOR=y
CONFIG_MTD=y
CONFIG_MTD_CMDLINE_PARTS=y
CONFIG_MTD_BLOCK=y
CONFIG_MTD_CFI=y
CONFIG_MTD_JEDECPROBE=y
CONFIG_MTD_CFI_STAA=y
CONFIG_MTD_PHYSMAP_OF=y
CONFIG_MTD_M25P80=y
CONFIG_MTD_SST25L=y
CONFIG_MTD_SPI_NOR_BASE=y
CONFIG_MTD_UBI=y
CONFIG_BLK_DEV_LOOP=y
CONFIG_BLK_DEV_RAM=y
CONFIG_BLK_DEV_RAM_SIZE=65536
CONFIG_EEPROM_AT24=y
CONFIG_EEPROM_AT25=y
CONFIG_SCSI=y
# CONFIG_SCSI_PROC_FS is not set
CONFIG_BLK_DEV_SD=y
CONFIG_SCSI_MULTI_LUN=y
CONFIG_SCSI_CONSTANTS=y
CONFIG_SCSI_LOGGING=y
CONFIG_SCSI_SCAN_ASYNC=y
# CONFIG_SCSI_LOWLEVEL is not set
CONFIG_NETDEVICES=y
# CONFIG_ETHERNET is not set
CONFIG_BRCMFMAC=m
CONFIG_INPUT_POLLDEV=y
# CONFIG_INPUT_MOUSEDEV_PSAUX is not set
CONFIG_INPUT_EVDEV=y
CONFIG_KEYBOARD_GPIO=y
CONFIG_KEYBOARD_IMX=y
# CONFIG_MOUSE_PS2 is not set
CONFIG_INPUT_TOUCHSCREEN=y
CONFIG_TOUCHSCREEN_AR1020_I2C=y
CONFIG_VT_HW_CONSOLE_BINDING=y
# CONFIG_LEGACY_PTYS is not set
# CONFIG_DEVKMEM is not set
CONFIG_SERIAL_IMX=y
CONFIG_SERIAL_IMX_CONSOLE=y
CONFIG_SERIAL_FSL_LPUART=y
CONFIG_SERIAL_FSL_LPUART_CONSOLE=y
CONFIG_HW_RANDOM=y
# CONFIG_I2C_COMPAT is not set
CONFIG_I2C_CHARDEV=y
# CONFIG_I2C_HELPER_AUTO is not set
CONFIG_I2C_IMX=y
CONFIG_SPI=y
CONFIG_SPI_IMX=y
CONFIG_PTP_1588_CLOCK=y
CONFIG_GPIO_SYSFS=y
CONFIG_POWER_SUPPLY=y
CONFIG_SENSORS_ADS1000=y
# CONFIG_MXC_MMA8451 is not set
CONFIG_THERMAL=y
CONFIG_CPU_THERMAL=y
CONFIG_IMX_THERMAL=y
CONFIG_DEVICE_THERMAL=y
CONFIG_WATCHDOG=y
CONFIG_IMX2_WDT=y
CONFIG_REGULATOR=y
CONFIG_REGULATOR_FIXED_VOLTAGE=y
CONFIG_REGULATOR_ANATOP=y
CONFIG_MEDIA_SUPPORT=y
CONFIG_MEDIA_CAMERA_SUPPORT=y
CONFIG_V4L_PLATFORM_DRIVERS=y
CONFIG_VIDEO_MXC_OUTPUT=y
CONFIG_VIDEO_MXC_IPU_OUTPUT=y
# CONFIG_MEDIA_SUBDRV_AUTOSELECT is not set
# CONFIG_DVB_AU8522_V4L is not set
# CONFIG_DVB_TUNER_DIB0070 is not set
# CONFIG_DVB_TUNER_DIB0090 is not set
CONFIG_DRM=y
CONFIG_DRM_VIVANTE=y
CONFIG_FB=y
CONFIG_FB_MXS=y
CONFIG_BACKLIGHT_LCD_SUPPORT=y
CONFIG_LCD_CLASS_DEVICE=y
CONFIG_LCD_L4F00242T03=y
CONFIG_LCD_PLATFORM=y
CONFIG_BACKLIGHT_CLASS_DEVICE=y
CONFIG_BACKLIGHT_PWM=y
CONFIG_FB_MXC_SYNC_PANEL=y
CONFIG_FB_MXC_LDB=y
# CONFIG_FB_MXC_EDID is not set
CONFIG_FRAMEBUFFER_CONSOLE=y
CONFIG_FRAMEBUFFER_CONSOLE_DETECT_PRIMARY=y
CONFIG_FONTS=y
CONFIG_FONT_8x8=y
CONFIG_FONT_8x16=y
CONFIG_LOGO=y
CONFIG_USB=y
CONFIG_USB_EHCI_HCD=y
CONFIG_USB_STORAGE=y
CONFIG_USB_CHIPIDEA=y
CONFIG_USB_CHIPIDEA_UDC=y
CONFIG_USB_CHIPIDEA_HOST=y
CONFIG_USB_SERIAL=y
CONFIG_USB_SERIAL_GENERIC=y
CONFIG_USB_SERIAL_CP210X=y
CONFIG_USB_SERIAL_FTDI_SIO=y
CONFIG_USB_SERIAL_KEYSPAN=y
CONFIG_USB_SERIAL_PL2303=y
CONFIG_USB_SERIAL_QUALCOMM=y
CONFIG_USB_SERIAL_OPTION=y
CONFIG_USB_MXS_PHY=y
CONFIG_USB_GADGET=y
CONFIG_USB_ZERO=m
CONFIG_USB_ETH=m
CONFIG_USB_FUNCTIONFS=m
CONFIG_USB_MASS_STORAGE=m
CONFIG_USB_G_SERIAL=m
CONFIG_USB_G_MULTI=m
CONFIG_MMC=y
CONFIG_MMC_UNSAFE_RESUME=y
CONFIG_MMC_SDHCI=y
CONFIG_MMC_SDHCI_PLTFM=y
CONFIG_MMC_SDHCI_ESDHC_IMX=y
CONFIG_MXC_IPU=y
CONFIG_MXC_GPU_VIV=y
CONFIG_MXC_MIPI_CSI2=y
CONFIG_NEW_LEDS=y
CONFIG_LEDS_CLASS=y
CONFIG_LEDS_GPIO=y
CONFIG_LEDS_PWM=y
CONFIG_RTC_CLASS=y
CONFIG_RTC_INTF_DEV_UIE_EMUL=y
CONFIG_RTC_DRV_ISL1208=y
CONFIG_DMADEVICES=y
# CONFIG_MX3_IPU is not set
CONFIG_MXC_PXP_V2=y
CONFIG_IMX_SDMA=y
CONFIG_STAGING=y
CONFIG_COMMON_CLK_DEBUG=y
# CONFIG_IOMMU_SUPPORT is not set
CONFIG_PWM=y
CONFIG_PWM_IMX=y
CONFIG_EXT2_FS=y
CONFIG_EXT2_FS_XATTR=y
CONFIG_EXT2_FS_POSIX_ACL=y
CONFIG_EXT2_FS_SECURITY=y
CONFIG_EXT3_FS=y
CONFIG_EXT3_FS_POSIX_ACL=y
CONFIG_EXT3_FS_SECURITY=y
CONFIG_EXT4_FS=y
CONFIG_EXT4_FS_POSIX_ACL=y
CONFIG_EXT4_FS_SECURITY=y
CONFIG_QUOTA=y
CONFIG_QUOTA_NETLINK_INTERFACE=y
# CONFIG_PRINT_QUOTA_WARNING is not set
CONFIG_AUTOFS4_FS=y
CONFIG_FUSE_FS=y
CONFIG_MSDOS_FS=y
CONFIG_VFAT_FS=y
CONFIG_TMPFS=y
CONFIG_TMPFS_POSIX_ACL=y
CONFIG_CONFIGFS_FS=y
CONFIG_SQUASHFS=y
CONFIG_NFS_FS=y
CONFIG_NFS_V3_ACL=y
CONFIG_NFS_V4=y
CONFIG_ROOT_NFS=y
CONFIG_NLS_DEFAULT="cp437"
CONFIG_NLS_CODEPAGE_437=y
CONFIG_NLS_ASCII=y
CONFIG_NLS_ISO8859_1=y
CONFIG_NLS_ISO8859_15=y
CONFIG_NLS_UTF8=y
CONFIG_MAGIC_SYSRQ=y
# CONFIG_SCHED_DEBUG is not set
# CONFIG_DEBUG_BUGVERBOSE is not set
# CONFIG_FTRACE is not set
# CONFIG_ARM_UNWIND is not set
CONFIG_SECURITYFS=y
CONFIG_CRYPTO_USER=y
CONFIG_CRYPTO_AUTHENC=y
CONFIG_CRYPTO_CCM=y
CONFIG_CRYPTO_GCM=y
CONFIG_CRYPTO_CBC=y
CONFIG_CRYPTO_CTS=y
CONFIG_CRYPTO_LRW=y
CONFIG_CRYPTO_ARC4=y
CONFIG_CRYPTO_DEFLATE=y
CONFIG_CRYPTO_LZO=y
# CONFIG_CRYPTO_ANSI_CPRNG is not set
CONFIG_CRC_CCITT=y
CONFIG_CRC_T10DIF=y
CONFIG_CRC_ITU_T=y
CONFIG_CRC7=y
CONFIG_LIBCRC32C=y
```

## arch/arm/mach-meson/Kconfig
```kconfig
menuconfig ARCH_MESON
	bool "Amlogic Meson SoCs"
	depends on ARCH_MULTI_V7
	select GPIOLIB
	select GENERIC_IRQ_CHIP
	select ARM_GIC
	select CACHE_L2X0 if !ARM64_A32
	select PINCTRL
	select COMMON_CLK

if ARCH_MESON

config MACH_MESON6
	bool "Amlogic Meson6 (8726MX) SoCs support"
	default !ARM64_A32
	select MESON6_TIMER

config MACH_MESON8
	bool "Amlogic Meson8 SoCs support"
	default !ARM64_A32
	select MESON6_TIMER

config MACH_MESON8B
	bool "Amlogic Meson8b SoCs support"
	default !ARM64_A32

config ARM64_A32
	tristate "ARMV8 Run in A32"
	default n
	help
	  amlogic armv8 chip support 32bit.

endif
```

## arch/arm/mach-mx5/Kconfig
```kconfig
if ARCH_MX5

config ARCH_MX51
	bool
	select USB_ARCH_HAS_EHCI
	select MXC_TZIC
	select ARCH_MXC_IOMUX_V3

config ARCH_MX53
	bool
	select USB_ARCH_HAS_EHCI
	select MXC_TZIC
	select ARCH_MXC_IOMUX_V3

config ARCH_MX50
	bool
	select ARCH_HAS_RNGC

config FORCE_MAX_ZONEORDER
    int "MAX_ORDER"
    default "13"

config MX5_MULTI_ARCH
	bool
	default y
	select RUNTIME_PHYS_OFFSET
	depends on ARCH_MX51
	depends on ARCH_MX50 || ARCH_MX53

config MACH_MX51_3DS
	bool "Support MX51 3-Stack platform"
	select ARCH_MX51
	help
	  Include support for MX51 3-Stack platform. This includes specific
	  configurations for the board and its peripherals.

config MACH_MX51_BABBAGE
	bool "Support MX51 BABBAGE platforms"
	select ARCH_MX51
	help
	  Include support for MX51 Babbage platform, also known as MX51EVK in
	  u-boot. This includes specific configurations for the board and its
	  peripherals.

config MACH_NITROGEN_IMX51
	bool "Support MX51 Nitrogen E platform"
	select ARCH_MX51
	help
	  Include support for Boundary Devices' MX51 Nitrogen platform
	  This includes specific configurations for the board and its peripherals.
	  See http://boundarydevices.com/NitrogenE.php for a photo.

config MACH_NITROGEN_VM_IMX51
	bool "Support MX51 Nitrogen VM (Vertical Mount) platform"
	select ARCH_MX51
	help
	  Include support for Boundary Devices' MX51 Nitrogen Vertical
	  mount platform, typically used for player tracking.
	  This includes specific configurations for the board and its peripherals.
	  See http://boundarydevices.com/NitrogenVM.php for a photo.

config MACH_NITROGEN_P_IMX51
	bool "Support MX51 Nitrogen P(Portable) platform"
	select ARCH_MX51
	help
	  Include support for Boundary Devices' MX51 Nitrogen platform
	  This includes specific configurations for the board and its peripherals.
	  See http://boundarydevices.com/NitrogenP.php for a photo.

config MACH_NITROGEN_EJ_IMX51
	bool "Support MX51 Nitrogen EJ (Jumpered) platform"
	select ARCH_MX51
	help
	  Include support for Boundary Devices' MX51 Nitrogen EJ platform.
	  This is an internal testing board that has GP1[22] jumpered to I2C connector.

config MACH_MX53_EVK
	bool "Support MX53 EVK platform"
	select ARCH_MX53
	help
	  Include support for MX53 EVK platform. This includes specific
	  configurations for the board and its peripherals.

config MACH_MX53_ARD
	bool "Support MX53 ARD platform"
	select ARCH_MX53
	help
	  Include support for MX53 ARD platform. This includes specific
	  configurations for the board and its peripherals.

config MACH_MX53_SMD
	bool "Support MX53 SMD platform"
	select ARCH_MX53
	help
	  Include support for MX53 SMD platform. This includes specific
	  configurations for the board and its peripherals.

config MACH_MX53_LOCO
	bool "Support MX53 LOCO platform"
	select ARCH_MX53
	help
	  Include support for MX53 LOCO platform. This includes specific
	  configurations for the board and its peripherals.

config MACH_MX53_NITROGEN_K
	bool "Support MX53 Nitrogen K platform"
	select ARCH_MX53
	help
	  Include support for MX53 Nitrogen platform. This includes specific
	  configurations for the board and its peripherals.

config MACH_NITROGEN_IMX53
	bool "Support MX53 Nitrogen platform"
	select ARCH_MX53
	help
	  Include support for MX53 Nitrogen platform. This includes specific
	  configurations for the board and its peripherals.

config MACH_NITROGEN_V1_IMX53
	bool "Support MX53 Nitrogen V1"
	select ARCH_MX53
	help
	  Include support for MX53 Nitrogen V1. This includes specific
	  configurations for the board and its peripherals.

config MACH_NITROGEN_V2_IMX53
	bool "Support MX53 Nitrogen V2(DA9050)"
	select ARCH_MX53
	help
	  Include support for MX53 Nitrogen V2 (the first with DA905x support).
	  This includes specific configurations for the board and its peripherals.

config MACH_NITROGEN_A_IMX53
	bool "Support MX53 Nitrogen A"
	select ARCH_MX53
	help
	  Include support for MX53 Nitrogen A. This includes specific
	  configurations for the board and its peripherals.

config MACH_NITROGEN_AP_IMX53
	bool "Support MX53 Nitrogen A prototype board"
	select ARCH_MX53
	help
	  Include support for MX53 Nitrogen A prototype. This includes specific
	  configurations for the board and its peripherals.

config MACH_MX50_ARM2
	bool "Support MX50 Armadillo2 platform"
	select ARCH_MX50
	help
	  Include support for MX50 EVK platform. This includes specific
	  configurations for the board and its peripherals.

config MACH_MX50_RDP
	bool "Support MX50 Reference Design Platform"
	select ARCH_MX50
	help
	  Include support for MX50 RDP platform. This includes specific
	  configurations for the board and its peripherals.

comment "MX5x Options:"

config MXC_SDMA_API
        bool "Use SDMA API"
        default y
        help
           This selects the Freescale MXC SDMA API.
           If unsure, say N.

config ARCH_MXC_HAS_NFC_V3
        bool "MXC NFC Hardware Version 3"
        depends on ARCH_MX5
        default y
        help
           This selects the Freescale MXC Nand Flash Controller Hardware Version 3
           If unsure, say N.

config ARCH_MXC_HAS_NFC_V3_2
        bool "MXC NFC Hardware Version 3.2"
        depends on ARCH_MXC_HAS_NFC_V3
        default y
        help
           This selects the Freescale MXC Nand Flash Controller Hardware Version 3.1
           If unsure, say N.

config SDMA_IRAM
	bool "Use Internal RAM for SDMA transfer"
	depends on MXC_SDMA_API
	help
	  Support Internal RAM as SDMA buffer or control structures

config MXC_BLUETOOTH_RFKILL
       tristate "MXC Bluetooth rfkill interface support"
       depends on RFKILL
       ---help---
	Say Y to get the standard rfkill interface of Bluetooth

config DEFAULT_PWM0_BACKLIGHT
	int "Default PWM0 backlight value"
	range 0 255
	default 128
	depends on MXC_PWM
	depends on BACKLIGHT_PWM
	help
	Specify initial value for /sys/class/backlight/pwm-backlight.0/brightness

config DEFAULT_PWM1_BACKLIGHT
	int "Default PWM1 backlight value"
	range 0 255
	default 128
	depends on MXC_PWM
	depends on BACKLIGHT_PWM
	help
	Specify initial value for PWM1
	Specify initial value for /sys/class/backlight/pwm-backlight.1/brightness

config LL_DEBUG_UART
	int "Default LL_DEBUG UART (0-2)"
	range 0 2
	default 0
	default 1 if MACH_NITROGEN_IMX53
	default 2 if MACH_NITROGEN_A_IMX53

endif
```
