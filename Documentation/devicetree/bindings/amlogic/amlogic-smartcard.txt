## Documentation/devicetree/bindings/arm/imx/busfreq-imx6.txt
```
Freescale Busfreq driver

It is a generic driver that manages the frequency of the DDR, AHB and AXI buses in the iMX6x architecture.
It works for both SMP and UP systems and for both DDR3 and LPDDR2 memory types.

Required properties are listed below:
- compatible: should be "fsl,imx6_busfreq"
- clocks: Lists the various clocks used by the busfreq driver
- interrupts - Lists the interrupts used by the busfreq driver. This is needed only for SMP architecutre.
- fsl,max_ddr_freq - The max ddr freq for this chip

Examples:
For SOC imx6q.dtsi:
	busfreq { /* BUSFREQ */
		compatible = "fsl,imx6_busfreq";
		clocks = <&clks 171>, <&clks 6>, <&clks 11>, <&clks 104>, <&clks 172>, <&clks 58>,
			<&clks 18>, <&clks 60>, <&clks 20>, <&clks 3>;
		clock-names = "pll2_bus", "pll2_pfd2_396m", "pll2_198m", "arm", "pll3_usb_otg", "periph",
			"periph_pre", "periph_clk2", "periph_clk2_sel", "osc";
		interrupts = <0 107 0x04>, <0 112 0x4>, <0 113 0x4>, <0 114 0x4>;
		interrupt-names = "irq_busfreq_0", "irq_busfreq_1", "irq_busfreq_2", "irq_busfreq_3";
		fsl,max_ddr_freq = <528000000>;
	};

The Freescale Busfreq driver supports the following setpoints for the DDR freq:
enum bus_freq_mode {
	BUS_FREQ_HIGH, -> The max freq the SOC supports
	BUS_FREQ_MED,  -> Medium setpoint (ex 400MHz for DDR3 when the max is 528MHz)
	BUS_FREQ_AUDIO, -> Audio playback freq (50MHz)
	BUS_FREQ_LOW,  -> Low power IDLE freq (24MHz)
};

Currently the Freescale Busfreq driver implementation requires drivers to call the following APIs:
1. request_bus_freq(enum bus_freq_mode):
	The driver is requesting the system and ddr freq to be set to the requested value. The driver should call this
	API before it even enables its clocks.

2. release_bus_freq(enum bus_freq_mode):
	The driver no longer needs the system and ddr freq at the required value. The driver should call this API after
	its work is done and it has disabled its clocks.

Examples:
In the IPU driver, the requesting and releasing of the required bus frequency is tied into the runtime PM implementation:

int ipu_runtime_suspend(struct device *dev)
{
	release_bus_freq(BUS_FREQ_HIGH);
	dev_dbg(dev, "ipu busfreq high release.\n");

	return 0;
}

int ipu_runtime_resume(struct device *dev)
{
	request_bus_freq(BUS_FREQ_HIGH);
	dev_dbg(dev, "ipu busfreq high requst.\n");

	return 0;
}

static const struct dev_pm_ops ipu_pm_ops = {
	SET_RUNTIME_PM_OPS(ipu_runtime_suspend, ipu_runtime_resume, NULL)
	SET_SYSTEM_SLEEP_PM_OPS(ipu_suspend, ipu_resume)
};
```

## Documentation/devicetree/bindings/arm/imx/gpc.txt
```
Freescale imx GPC bindings

Optional properties:
- fsl,cpu_pupscr_sw2iso: for powering up CPU, number of 32K clock cycle PGC will wait before negating isolation signal.
- fsl,cpu_pupscr_sw: for powering up CPU, number of 32K clock cycle PGC will wait before asserting isolation signal.
- fsl,cpu_pdnscr_iso2sw: for powering down CPU, number of ipg clock cycle PGC will wait before negating isolation signal.
- fsl,cpu_pdnscr_iso: for powering down CPU, number of ipg clock cycle PGC will wait before asserting isolation signal.

These properties are for adjusting the GPC PGC CPU power up/down setting, if there is no such property in dts, then default
value in GPC PGC registers will be used.


Example:

	&gpc {
		fsl,cpu_pupscr_sw2iso = <0xf>;
		fsl,cpu_pupscr_sw = <0xf>;
		fsl,cpu_pdnscr_iso2sw = <0x1>;
		fsl,cpu_pdnscr_iso = <0x1>;
	};
```

## Documentation/devicetree/bindings/arm/mediatek/mediatek,ccorr.yaml
```yaml
# SPDX-License-Identifier: (GPL-2.0-only OR BSD-2-Clause)
%YAML 1.2
---
$id: http://devicetree.org/schemas/arm/mediatek/mediatek,ccorr.yaml#
$schema: http://devicetree.org/meta-schemas/core.yaml#

title: Mediatek color correction

maintainers:
  - Matthias Brugger <matthias.bgg@gmail.com>

description: |
  Mediatek color correction with 3X3 matrix.

properties:
  compatible:
    items:
      - enum:
        - mediatek,mt8183-mdp3-ccorr

  mediatek,mdp3-id:
    $ref: /schemas/types.yaml#/definitions/uint32
    maxItems: 1
    description: |
      There may be multiple blocks with the same function but
      different addresses in MDP3.
      In order to distinguish the connection with other blocks,
      a unique ID is needed to dynamically use one or more identical
      blocks to implement multiple pipelines.

  reg:
    maxItems: 1

  mediatek,gce-client-reg:
    $ref: /schemas/types.yaml#/definitions/phandle-array
    description: |
      The register of client driver can be configured by gce with 4 arguments
      defined in this property, such as phandle of gce, subsys id,
      register offset and size.
      Each GCE subsys id is mapping to a client defined in the header
      include/dt-bindings/gce/<chip>-gce.h.

  clocks:
    minItems: 1

additionalProperties: false

examples:
  - |
    #include <dt-bindings/clock/mt8183-clk.h>
    #include <dt-bindings/gce/mt8183-gce.h>

    mdp3_ccorr: mdp3_ccorr@1401c000 {
      compatible = "mediatek,mt8183-mdp3-ccorr";
      mediatek,mdp3-id = <0>;
      reg = <0x1401c000 0x1000>;
      mediatek,gce-client-reg = <&gce SUBSYS_1401XXXX 0xc000 0x1000>;
      clocks = <&mmsys CLK_MM_MDP_CCORR>;
    };
```

## Documentation/devicetree/bindings/arm/mediatek/mediatek,mt8188-clock.yaml
```yaml
# SPDX-License-Identifier: (GPL-2.0 OR BSD-2-Clause)
%YAML 1.2
---
$id: http://devicetree.org/schemas/arm/mediatek/mediatek,mt8188-clock.yaml#
$schema: http://devicetree.org/meta-schemas/core.yaml#

title: MediaTek Functional Clock Controller for MT8188

maintainers:
  - Garmin Chang <garmin.chang@mediatek.com>

description: |
  The clock architecture in MediaTek like below
  PLLs -->
          dividers -->
                      muxes
                           -->
                              clock gate

  The devices provide clock gate control in different IP blocks.

properties:
  compatible:
    enum:
      - mediatek,mt8188-adsp_audio26m
      - mediatek,mt8188-imp_iic_wrap_c
      - mediatek,mt8188-imp_iic_wrap_en
      - mediatek,mt8188-imp_iic_wrap_w
      - mediatek,mt8188-mfgcfg
      - mediatek,mt8188-vppsys0
      - mediatek,mt8188-wpesys
      - mediatek,mt8188-wpesys_vpp0
      - mediatek,mt8188-vppsys1
      - mediatek,mt8188-imgsys
      - mediatek,mt8188-imgsys_wpe1
      - mediatek,mt8188-imgsys_wpe2
      - mediatek,mt8188-imgsys_wpe3
      - mediatek,mt8188-imgsys1_dip_top
      - mediatek,mt8188-imgsys1_dip_nr
      - mediatek,mt8188-ipesys
      - mediatek,mt8188-camsys
      - mediatek,mt8188-camsys_rawa
      - mediatek,mt8188-camsys_yuva
      - mediatek,mt8188-camsys_rawb
      - mediatek,mt8188-camsys_yuvb
      - mediatek,mt8188-ccusys
      - mediatek,mt8188-vdecsys_soc
      - mediatek,mt8188-vdecsys
      - mediatek,mt8188-vencsys
  reg:
    maxItems: 1

  '#clock-cells':
    const: 1

required:
  - compatible
  - reg
  - '#clock-cells'

additionalProperties: false

examples:
  - |
    imp_iic_wrap_c: clock-controller@11283000 {
        compatible = "mediatek,mt8188-imp_iic_wrap_c";
        reg = <0x11283000 0x1000>;
        #clock-cells = <1>;
    };
```

## Documentation/devicetree/bindings/arm/mediatek/mediatek,rdma.yaml
```yaml
# SPDX-License-Identifier: (GPL-2.0-only OR BSD-2-Clause)
%YAML 1.2
---
$id: http://devicetree.org/schemas/arm/mediatek/mediatek,rdma.yaml#
$schema: http://devicetree.org/meta-schemas/core.yaml#

title: Mediatek Read Direct Memory Access

maintainers:
  - Matthias Brugger <matthias.bgg@gmail.com>

description: |
  Mediatek Read Direct Memory Access(RDMA) component used to do read DMA.
  It contains one line buffer to store the sufficient pixel data, and
  must be siblings to the central MMSYS_CONFIG node.
  For a description of the MMSYS_CONFIG binding, see
  Documentation/devicetree/bindings/arm/mediatek/mediatek,mmsys.yaml
  for details.
  The 1st RDMA is also used to be a controller node in Media Data Path 3(MDP3)
  that containing MMSYS, MUTEX, GCE and SCP settings.

properties:
  compatible:
    oneOf:
      - items:
          - const: mediatek,mt8183-mdp3
          - const: mediatek,mt8183-mdp3-rdma
      - items:
          - const: mediatek,mt8183-mdp3-rdma

  mediatek,scp:
    $ref: /schemas/types.yaml#/definitions/phandle
    maxItems: 1
    description: |
      The node of system control processor (SCP), using
      the remoteproc & rpmsg framework.
      $ref: /schemas/remoteproc/mtk,scp.yaml

  mediatek,mdp3-id:
    $ref: /schemas/types.yaml#/definitions/uint32
    maxItems: 1
    description: |
      There may be multiple blocks with the same function but
      different addresses in MDP3.
      In order to distinguish the connection with other blocks,
      a unique ID is needed to dynamically use one or more identical
      blocks to implement multiple pipelines.

  mdp3-comps:
    $ref: /schemas/types.yaml#/definitions/string-array
    items:
      - enum:
          # MDP direct-link input path selection, create a
          # component for path connectedness of HW pipe control
          - mediatek,mt8183-mdp3-dl1
      - enum:
          - mediatek,mt8183-mdp3-dl2
      - enum:
          # MDP direct-link output path selection, create a
          # component for path connectedness of HW pipe control
          - mediatek,mt8183-mdp3-path1
      - enum:
          - mediatek,mt8183-mdp3-path2
      - enum:
          # Input DMA of ISP PASS2 (DIP) module for raw image input
          - mediatek,mt8183-mdp3-imgi
      - enum:
          # Output DMA of ISP PASS2 (DIP) module for YUV image output
          - mediatek,mt8183-mdp3-exto
    description: |
      MTK sub-system of direct-link or DIP

  mdp3-comp-ids:
    maxItems: 1
    $ref: /schemas/types.yaml#/definitions/uint32-array
    description: |
      Pipeline ID of MDP sub-system.

  reg:
    minItems: 1
    maxItems: 5
    description: |
      1st: basic HW address
      2nd: mediatek,mt8183-mdp-dl1, mediatek,mt8183-mdp-dl2
      3rd: mediatek,mt8183-mdp-path1
      4th: mediatek,mt8183-mdp-path2
      5th: mediatek,mt8183-mdp3-imgi, mediatek,mt8183-mdp3-exto

  mediatek,gce-client-reg:
    $ref: /schemas/types.yaml#/definitions/phandle-array
    description: |
      The register of client driver can be configured by gce with 4 arguments
      defined in this property, such as phandle of gce, subsys id,
      register offset and size.
      Each GCE subsys id is mapping to a client defined in the header
      include/dt-bindings/gce/<chip>-gce.h.

  power-domains:
    maxItems: 1

  clocks:
    minItems: 1
    maxItems: 6
    description: |
      1st: RDMA0 clock
      2nd: RSZ1 clock
      3rd: direck-link TX clock in MDP side
      4th: direck-link RX clock in MDP side
      5th: direck-link TX clock in ISP side
      6th: direck-link RX clock in ISP side

  iommus:
    maxItems: 1

  mediatek,mmsys:
    $ref: /schemas/types.yaml#/definitions/phandle
    maxItems: 1
    description: |
      The node of mux(multiplexer) controller for HW connections.

  mediatek,mm-mutex:
    $ref: /schemas/types.yaml#/definitions/phandle
    maxItems: 1
    description: |
      The node of sof(start of frame) signal controller.

  mediatek,mailbox-gce:
    $ref: /schemas/types.yaml#/definitions/phandle
    description: |
      The node of global command engine (GCE), used to read/write
      registers with critical time limitation.

  mboxes:
    $ref: /schemas/types.yaml#/definitions/phandle-array

  gce-subsys:
    $ref: /schemas/types.yaml#/definitions/phandle-array
    description: |
      sub-system id corresponding to the global command engine (GCE)
      register address.

if:
  properties:
    compatible:
      contains:
        const: mediatek,mt8183-mdp3

then:
  required:
    - mediatek,scp
    - mediatek,mmsys
    - mediatek,mm-mutex
    - mediatek,mailbox-gce
    - mboxes
    - gce-subsys

required:
  - compatible
  - mediatek,mdp3-id
  - reg
  - clocks
  - mediatek,gce-client-reg

additionalProperties: false

examples:
  - |
    #include <dt-bindings/clock/mt8183-clk.h>
    #include <dt-bindings/gce/mt8183-gce.h>
    #include <dt-bindings/power/mt8183-power.h>
    #include <dt-bindings/memory/mt8183-larb-port.h>

    mdp3_rdma0: mdp3_rdma0@14001000 {
      compatible = "mediatek,mt8183-mdp3",
                   "mediatek,mt8183-mdp3-rdma";
      mediatek,scp = <&scp>;
      mediatek,mdp3-id = <0>;
      mdp3-comps = "mediatek,mt8183-mdp3-dl1", "mediatek,mt8183-mdp3-dl2",
                   "mediatek,mt8183-mdp3-path1", "mediatek,mt8183-mdp3-path2",
                   "mediatek,mt8183-mdp3-imgi", "mediatek,mt8183-mdp3-exto";
      mdp3-comp-ids = <0 1 0 1 0 1>;
      reg = <0x14001000 0x1000>,
            <0x14000000 0x1000>,
            <0x14005000 0x1000>,
            <0x14006000 0x1000>,
            <0x15020000 0x1000>;
      mediatek,gce-client-reg = <&gce SUBSYS_1400XXXX 0x1000 0x1000>,
                                <&gce SUBSYS_1400XXXX 0 0x1000>,
                                <&gce SUBSYS_1400XXXX 0x5000 0x1000>,
                                <&gce SUBSYS_1400XXXX 0x6000 0x1000>,
                                <&gce SUBSYS_1502XXXX 0 0x1000>;
      power-domains = <&spm MT8183_POWER_DOMAIN_DISP>;
      clocks = <&mmsys CLK_MM_MDP_RDMA0>,
               <&mmsys CLK_MM_MDP_RSZ1>,
               <&mmsys CLK_MM_MDP_DL_TXCK>,
               <&mmsys CLK_MM_MDP_DL_RX>,
               <&mmsys CLK_MM_IPU_DL_TXCK>,
               <&mmsys CLK_MM_IPU_DL_RX>;
      iommus = <&iommu>;
      mediatek,mmsys = <&mmsys>;
      mediatek,mm-mutex = <&mutex>;
      mediatek,mailbox-gce = <&gce>;
      mboxes = <&gce 20 CMDQ_THR_PRIO_LOWEST 0>,
               <&gce 21 CMDQ_THR_PRIO_LOWEST 0>,
               <&gce 22 CMDQ_THR_PRIO_LOWEST 0>,
               <&gce 23 CMDQ_THR_PRIO_LOWEST 0>;
      gce-subsys = <&gce 0x14000000 SUBSYS_1400XXXX>,
                   <&gce 0x14010000 SUBSYS_1401XXXX>,
                   <&gce 0x14020000 SUBSYS_1402XXXX>,
                   <&gce 0x15020000 SUBSYS_1502XXXX>;
    };
```
