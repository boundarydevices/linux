## Documentation/devicetree/bindings/amlogic/amlogic-smartcard.txt
```
Device-Tree bindings for smartcard driver

Required properties:
- compatible: Must be "amlogic, smartcard".
- interrupts: Smartcard IRQ.
- smc0_clock_source: Smartcard module's clock source selection.
- reset_level: Reset level.
- smc0_det_invert: Invert the DET level.
- pinctrl: Pinmux setting of the smartcard.
- resets: Clock domain of the smartcard.

If you want to use GPIO to replace the DET and RESET pins, the following properties should be set:
- reset_pin: RESET GPIO.
- detect_pin: DETECT GPIO.

If you want to switch 5v/3v by a GPIO, the following properties should be set:
- enable_5v3v_pin: 5v/3v switch GPIO.
- smc0_5v3v_level: 5v/3v GPIO output.

If you want to disable the CLK output when no card inserted, the following properties should be set:
- smc0_clk_pinmux_reg: CLK pinmux register address.
- smc0_clk_pinmux_bit: CLK pinmux bit.
- smc0_clk_oen_reg: CLK GPIO OEN register.
- smc0_clk_out_reg: CLK GPIO output register.
- smc0_clk_bit: CLK GPIO bit.
- smc0_clk_oebit: CLK GPIO OEN bit.;
- smc0_clk_oubit: BLK GPIO output bit.

Example:
smartcard {
	compatible = "amlogic,smartcard";
	irq_trigger_type = "GPIO_IRQ_LOW";

	reset_pin = <&gpio GPIOX_11 GPIO_ACTIVE_HIGH >;		//Reset pin
	detect_pin = <&gpio GPIOX_20 GPIO_ACTIVE_HIGH >;	//Detect pin
	enable_5v3v_pin = <&gpio GPIOX_10 GPIO_ACTIVE_HIGH >;	//5V3V pin, can be ignored

	interrupts = <0 69 4>;		//smc irq

	smc0_clock_source = <0>;	//Smc clock source, if change this, you must adjust clk and divider in smartcard.c
	smc0_irq = <69 >;		//smc irq
	smc0_det_invert = <0>;		//0: high voltage on detect pin indicates card in.
	smc0_5v3v_level = <0>;
	smc_need_enable_pin = "no";	//Ordinarily, smartcard controller needs a enable pin.
	reset_level = <0>;		//0: low to reset the smartcard

	smc0_clk_pinmux_reg = <0x30>;
	smc0_clk_pinmux_bit = <0x80>;
	smc0_clk_oen_reg = <0x200f>;
	smc0_clk_out_reg = <0x2010>;
	smc0_clk_bit = <0x2000>;
	smc0_clk_oebit = <0x2000000>;
	smc0_clk_oubit = <0x1000000>;

	pinctrl-names = "default";
	pinctrl-0 = <&smc_pins>;
	resets = <&clock GCLK_IDX_SMART_CARD_MPEG_DOMAIN>;
	reset-names = "smartcard";

	status = "okay";
};

&pinmux {
	smc_pins:smc_pins {	//Set gpio to 7816-clk 7816-data mode.
		amlogic,setmask = <4 0x000000c0>;       //Please refer to core-pin mux document
		amlogic,clrmask = <3 0x60000280>;
		amlogic,pins = "GPIOX_8","GPIOX_9";
	};
}
```

## Documentation/devicetree/bindings/amlogic/axg-adc3010-pcm.txt
```
diff --git a/arch/arm64/boot/dts/amlogic/axg_s420_v03.dts
	b/arch/arm64/boot/dts/amlogic/axg_s420_v03.dts
index f184fce..5a43ba1 100644
--- a/arch/arm64/boot/dts/amlogic/axg_s420_v03.dts
+++ b/arch/arm64/boot/dts/amlogic/axg_s420_v03.dts
@@ -383,24 +383,24 @@
 		};
 		aml-audio-card,dai-link@1 {
-			format = "i2s";
+	format = "dsp_a";
 			mclk-fs = <256>;
 			//continuous-clock;
-			//bitclock-inversion;
+			bitclock-inversion;
 			//frame-inversion;
 			bitclock-master = <&aml_tdmb>;
 			frame-master = <&aml_tdmb>;
 			cpu {
 				sound-dai = <&aml_tdmb>;
-	dai-tdm-slot-tx-mask = <1 1>;
-	dai-tdm-slot-rx-mask = <1 1>;
-	dai-tdm-slot-num = <2>;
+	dai-tdm-slot-tx-mask = <1 1 1 1 1 1 1 1>;
+	dai-tdm-slot-rx-mask = <1 1 1 1 1 1 1 1>;
+	dai-tdm-slot-num = <8>;
 	dai-tdm-slot-width = <32>;
 	system-clock-frequency = <12288000>;
 			};
 			codec {
-				sound-dai = <&tlv320adc3101_32>;
-					/*&tlv320adc3101_30>;*/
+	prefix-names = "3101_A", "3101_B",
+				"3101_C", "3101_D";
+	sound-dai = <&tlv320adc3101_30 &tlv320adc3101_32
+				&tlv320adc3101_34 &tlv320adc3101_36>;
 			};
 		};
@@ -728,7 +728,7 @@
 	status = "okay";
 	pinctrl-names="default";
 	pinctrl-0=<&b_i2c_master>;
-
+/*
 	tlv320adc3101_32: tlv320adc3101_32@30 {
 		compatible = "ti,tlv320adc3101";
 		#sound-dai-cells = <0>;
@@ -736,7 +736,7 @@
 		differential_pair = <1>;
 		status = "okay";
 	};
-
+*/
 	tas5707_36: tas5707_36@36 {
 		compatible = "ti,tas5707";
 		#sound-dai-cells = <0>;
@@ -771,23 +771,34 @@
 		status = "okay";
 	};
+	tlv320adc3101_32: tlv320adc3101_32@32 {
+		compatible = "ti,tlv320adc3101";
+		#sound-dai-cells = <0>;
+		reg = <0x19>;
+		slot_number = <3>;
+		//differential_pair = <1>;
+		status = "okay";
+	};
 	tlv320adc3101_30: tlv320adc3101_30@30 {
 		compatible = "ti,tlv320adc3101";
 		#sound-dai-cells = <0>;
 		reg = <0x18>;
-		status = "disable";
+		slot_number = <0>;
+		status = "okay";
 	};
-	tlv320adc3101_34: tlv320adc3101_34@30 {
+	tlv320adc3101_34: tlv320adc3101_34@34 {
 		compatible = "ti,tlv320adc3101";
 		#sound-dai-cells = <0>;
 		reg = <0x1a>;
-		status = "disable";
+		slot_number = <2>;
+		status = "okay";
 	};
-	tlv320adc3101_36: tlv320adc3101_36@30 {
+	tlv320adc3101_36: tlv320adc3101_36@36 {
 		compatible = "ti,tlv320adc3101";
 		#sound-dai-cells = <0>;
 		reg = <0x1b>;
-		status = "disable";
+		slot_number = <1>;
+		status = "okay";
 	};
 	es7243_10: es7243_10@10 {
               compatible = "MicArray_0";
@@ -928,8 +939,8 @@
 	aml_tdmb: tdmb {
 		compatible = "amlogic, axg-snd-tdmb";
 		#sound-dai-cells = <0>;
-		dai-tdm-lane-slot-mask-out = <1 0>;
-		dai-tdm-lane-slot-mask-in = <0 1>;
+		dai-tdm-lane-slot-mask-out = <1 1>;
+		dai-tdm-lane-slot-mask-in = <1 0>;
 		dai-tdm-clk-sel = <1>;
 		clocks = <&clkaudio CLKID_AUDIO_MCLK_B
 				&clkc CLKID_MPLL1>;
@@ -1089,8 +1100,7 @@
 	tdmin_b: tdmin_b {
 		mux {
-			groups = "tdmb_din0",
-				"tdmb_din1";
+			groups = "tdmb_din0";
 			function = "tdmb_in";
 		};
 	};
```

## Documentation/devicetree/bindings/amlogic/axg-sound-loopback.txt
```
Enable external loopback for S420 & S400 board

diff --git a/arch/arm64/boot/dts/amlogic/axg_s400_v03.dts b/arch/arm64/boot/dts/amlogic/axg_s400_v03.dts
index 8038672..064de0f 100644
--- a/arch/arm64/boot/dts/amlogic/axg_s400_v03.dts
+++ b/arch/arm64/boot/dts/amlogic/axg_s400_v03.dts
@@ -562,12 +562,12 @@
 				 *enable external loopback
 				 *and tlv320adc3101 as loopback
 				 */
-				/*sound-dai = <&pdm_codec &tlv320adc3101_32>;*/
+				sound-dai = <&pdm_codec &tlv320adc3101_32>;
 				/*
				 * enable internal loopback
 				 * or disable loopback
 				 */
-				sound-dai = <&pdm_codec>;
+				/*sound-dai = <&pdm_codec>;*/
 			};
 		};

@@ -1163,8 +1163,8 @@
 		 * external loopback clock config
 		 * enable clk while pdm record data
 		 */
-		/*clocks = <&clkc CLKID_MPLL1>;*/
-		/*clock-names = "datalb_mpll";*/
+		clocks = <&clkc CLKID_MPLL1>;
+		clock-names = "datalb_mpll";

 		/*
 		 * 0: out rate = in data rate;
@@ -1182,7 +1182,7 @@
 		 */
 		datain_src = <4>;
 		datain_chnum = <8>;
-		datain_chmask = <0x7f>;
+		datain_chmask = <0x3f>;

 		/* tdmin_lb src
 		 * 0: tdmoutA
@@ -1194,11 +1194,11 @@
 		 */

 		/*if tdmin_lb >= 3, use external loopback*/
-		datalb_src = <2>;
+		datalb_src = <4>;
 		datalb_chnum = <2>;
 		/*config which data pin as loopback*/
-		/*datalb-lane-mask-in = <0 0 0 1>;*/
-		datalb_chmask = <0x1>;
+		datalb-lane-mask-in = <0 0 0 1>;
+		datalb_chmask = <0x3>;

 		status = "okay";
 	};
diff --git a/arch/arm64/boot/dts/amlogic/axg_s420_v03.dts b/arch/arm64/boot/dts/amlogic/axg_s420_v03.dts
index aaf05de..bb5b173 100644
--- a/arch/arm64/boot/dts/amlogic/axg_s420_v03.dts
+++ b/arch/arm64/boot/dts/amlogic/axg_s420_v03.dts
@@ -427,12 +427,12 @@
 				 *enable external loopback
 				 *and tlv320adc3101 as loopback
 				 */
-				/*sound-dai = <&pdm_codec &tlv320adc3101_32>;*/
+				sound-dai = <&pdm_codec &tlv320adc3101_32>;
 				/*
				 * enable internal loopback
 				 * or disable loopback
 				 */
-				sound-dai = <&pdm_codec>;
+				/*sound-dai = <&pdm_codec>;*/
 			};
 		};

@@ -983,12 +983,13 @@

 	aml_loopback: loopback {
 		compatible = "amlogic, snd-loopback";
+
 		/*
 		 * external loopback clk config
 		 * enable clk while pdm record data
 		 */
-		/*clocks = <&clkc CLKID_MPLL1>;*/
-		/*clock-names = "datalb_mpll";*/
+		clocks = <&clkc CLKID_MPLL1>;
+		clock-names = "datalb_mpll";

 		/*
 		 * 0: out rate = in data rate;
@@ -1005,7 +1006,7 @@
 		 */
 		datain_src = <4>;
 		datain_chnum = <8>;
-		datain_chmask = <0x7f>;
+		datain_chmask = <0x3f>;

 		/* tdmin_lb src
 		 * 0: tdmoutA
@@ -1017,11 +1018,11 @@
 		 */

 		/*if tdmin_lb >= 3, use external loopback*/
-		datalb_src = <2>;
+		datalb_src = <4>;
 		datalb_chnum = <2>;
 		/*config which data pin as loopback*/
-		/*datalb-lane-mask-in = <0 1>;*/
-		datalb_chmask = <0x1>;
+		datalb-lane-mask-in = <0 1>;
+		datalb_chmask = <0x3>;

 		status = "okay";
 	};
```

## Documentation/devicetree/bindings/amlogic/input/amlogic-adc-keypad.txt
```
Device-Tree bindings for input/keyboard/adc_keypad.c keyboard driver

Required properties:
- compatible: Must be "amlogic, adc_keypad".
- key_name: Specify the name of different key.
- key_num:  Specify the quantity of the keys.
- key_code: Set the function code corresponding to different key.
- key_chan: Set the channel to detect the key, can be set from 0 to 7.
- key_val: The adc sampling value of different key, can be set from 0 to 1023.
- key_tolerance: tolerance of the adc sampling value, recommend maximum value of 40.

Optional properties:
- status: Shall be "ok" or "okay" if enabled or "disabled" if disabled.
          Default is "ok".

Example:
	adc_keypad{
			compatible = "amlogic, adc_keypad";
			status = "okay";
			key_name = "left", "right","up", "down", "enter";
			key_num = <5>;
			key_code = <106 105 103 108 28>;
			key_chan = <2 2 3 3 3>;
			key_val =  <516 253 516 750 0>; //voltage=0/252/478/692/824mV, val=voltage/1800mV*1023
			key_tolerance = <40 40 40 40 40>;
   };
```

## Documentation/devicetree/bindings/amlogic/input/amlogic-saradc.txt
```
Amlogic Successive Approximation Register (SAR) A/D Converter bindings

Required properties:
- compatible: Must be "amlogic, saradc".
- clocks: The clock provided by the SoC to the device.
- clock-names: Shall be "saradc_clk" for the device.
- resets: Shall be "GCLK_IDX_SARADC" for the device.
- reg: Physical base address of the controller and length of memory mapped
       region.

Optional properties:
- status: Shall be "ok" or "okay" if enabled or "disabled" if disabled.
          Default is "ok".

Example:
	saradc: saradc {
		compatible = "amlogic, saradc";
		status = "okay";
		clocks = <&clock CLK_XTAL>;
		clock-names = "saradc_clk";
		resets = <&clock GCLK_IDX_SARADC>;
		reg = <0x0 0xc1108680 0x0 0x30
		0x0 0xc883c3d8 0x0 0x08>;
	};
```

## Documentation/devicetree/bindings/amlogic/input/amlogic-ts.txt
```
* Focaltech FT3x27 series touchscreen controller

Required properties:
 - compatible: Should be "focaltech,fts"
 - reg: I2C address of the chip. Should be 0x38
 - irq-gpio: GPIO pin used for IRQ
 - reset-gpio: GPIO pin used for reset
 - x_max: horizontal resolution
 - y_max: vertical resolution
 - max-touch-number: the max touch fingers support

Example:
	i2c1: i2c@1e000 {
		/* ... */

		focaltech_ts@38 {
			compatible = "focaltech,fts";
			status = "okay";
			reg = <0x38>;
			reset-gpio = <&gpio GPIOZ_6 0x00>;
			irq-gpio = <&gpio GPIOZ_3 0x00>;
			x_max = <600>;
			y_max = <1024>;
			max-touch-number = <10>;
		};

		/* ... */
	};


* Goodix GT1X series touchscreen controller

Required properties:
 - compatible: Should be "goodix,gt1x"
 - reg: I2C address of the chip. Should be 0x5d or 0x14
 - irq-gpio: GPIO pin used for IRQ
 - reset-gpio: GPIO pin used for reset

Example:
	i2c1: i2c@1e000 {
		/* ... */

		goodix_ts@5d {
			compatible = "goodix,gt1x";
			status = "okay";
			reg = <0x5d>;
			reset-gpio = <&gpio GPIOZ_6 0x00>;
			irq-gpio = <&gpio GPIOZ_3 0x00>;
		};

		/* ... */
	};


* Goodix GT9XX series touchscreen controller

Required properties:
 - compatible: Should be "goodix,gt9xx"
 - reg: I2C address of the chip. Should be 0x5d or 0x14
 - irq-gpio: GPIO pin used for IRQ
 - reset-gpio: GPIO pin used for reset

Example:
	i2c1: i2c@1e000 {
		/* ... */

		gt9xx@5d {
			compatible = "goodix,gt9xx";
			status = "okay";
			reg = <0x5d>;
			reset-gpio = <&gpio GPIOZ_6 0x00>;
			irq-gpio = <&gpio GPIOZ_3 0x00>;
		};

		/* ... */
	};
```

## Documentation/devicetree/bindings/amlogic/input/cy8c4014_i2c.txt
```
cy8c4014_08: cy8c4014_08@08 {
	compatible = "cy8c4014";
	#sound-dai-cells = <0>;
	reg = <0x8>;
	status = "okay";
};
```

## Documentation/devicetree/bindings/amlogic/input/pca9557_keypad.txt
```
pca9557: pca9557@0x1f {
		compatible = "amlogic,pca9557_keypad";
		reg = <0x1f>;
		key_num = <4>;
		key_name = "fdr", "hotword", "pause", "mute";
		key_value = <106 105 139 116>;
		key_index_mask = <0x4 0x8 0x10 0x20>;
		key_input_mask = <0x3C>;
		status = "okay";
	};
```

## Documentation/devicetree/bindings/amlogic/meson-wdt.txt
```
Meson SoCs Watchdog timer

Required properties:

- compatible : should be one of
		"amlogic,meson-gxbb-wdt"
		"amlogic,meson-gxl-wdt"
		"amlogic,meson-axg-wdt"
		"amlogic,meson-txl-wdt"
		"amlogic,meson-txlx-wdt"
		"amlogic,meson-g12a-wdt"
		"amlogic,meson-tl1-wdt"
- reg : Specifies base physical address and size of the registers.
- clocks : Should be a phandle to the Watchdog clock source, for GXBB the xtal
	   is the default clock source.

Example:

wdt: watchdog@98d0 {
	compatible = "amlogic,meson-gxbb-wdt";
	reg = <0 0x98d0 0x0 0x10>;
	clocks = <&xtal>;
};

wdt: watchdog@0xffd0f0d0 {
	compatible = "amlogic,meson-g12a-wdt";
	status = "okay";
	reg = <0x0 0xffd0f0d0 0x0 0x10>;
	clock-names = "xtal";
	clocks = <&xtal>;
};

wdt: watchdog@0xffd0f0d0 {
	compatible = "amlogic,meson-tl1-wdt";
	status = "okay";
	reg = <0xffd0f0d0 0x10>;
	clock-names = "xtal";
	clocks = <&xtal>;
};
```

## Documentation/devicetree/bindings/amlogic/pwm-meson.txt
```
Amlogic Meson PWM Controller
============================

Required properties:
- compatible: Shall contain "amlogic,meson8b-pwm" or "amlogic,meson-gxbb-pwm".
			-for txlx
				ee
					amlogic,txlx-ee-pwm
				ao
					amlogic,txlx-ao-pwm
			-for g12a
				ee
					amlogic,g12a-ee-pwm
				ao
					amlogic,g12a-ao-pwm
			-for g12b
				ee
					amlogic,g12b-ee-pwm
				ao
					amlogic,g12b-ao-pwm
			-for axg
				ee
					amlogic,axg-ee-pwm
				ao
					amlogic,axg-ao-pwm

			-for gx socs (gxl gxm gxtvbb)
				ee
					amlogic,gx-ee-pwm
				ao
					amlogic,gx-ao-pwm

- #pwm-cells: Should be 3. See pwm.txt in this directory for a description of
  the cells format.

Optional properties:
- clocks: Could contain one or two parents clocks phandle for each of the two
  PWM channels.
- clock-names: Could contain at least the "clkin0" and/or "clkin1" names.

Example:
	for m8b,gxbb:

	pwm_ab: pwm@8550 {
		compatible = "amlogic,meson-gxbb-pwm";
		reg = <0x0 0x08550 0x0 0x10>;
		#pwm-cells = <3>;
		status = "disabled";
		clocks = <&xtal>, <&xtal>;
		clock-names = "clkin0", "clkin1";
	}

	for axg,gxl:

	pwm_ab: pwm@8550 {
		compatible = "amlogic,meson-gxbb-pwm";
		reg = <0x0 0x08550 0x0 0x10>;
		#pwm-cells = <3>;
		status = "disabled";
		clocks = <&xtal>, <&xtal>,<&xtal>,<&xtal>;
		clock-names = "clkin0", "clkin1","clkin2","clkin3";
	}
```

## Documentation/devicetree/bindings/amlogic/reboot-meson.txt
```
Amlogic Meson Reboot

Required properties:
 - compatible: must be "amlogic,reboot"

 - sys_reset: should be 0x84000009
 - sys_poweroff: should be 0x84000008
   refere to Power_State_Coordination_Interface_PDD_v1_1_DEN0022D.pdf,page 34.

Examples:

	reboot {
		compatible = "amlogic,reboot";
		sys_reset = <0x84000009>;
		sys_poweroff = <0x84000008>;
	};
```

## Documentation/devicetree/bindings/arm/arm_gpu.txt
```
ARM Mali GPU device tree bindings
------------------------------------

Boards with Mali-450 GPU shall have the following properties:
  Required root node property:
    compatible: "arm,mali-450"

Boards with Mali-t82x GPU shall have the following properties:
  Required root node property:
    compatible: "arm,malit602", "arm,malit60x", "arm,malit6xx", "arm,mali-midgard"
```
