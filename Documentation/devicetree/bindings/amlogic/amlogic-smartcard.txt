## Documentation/devicetree/bindings/arm/mediatek/mediatek,wdma.yaml
```yaml
# SPDX-License-Identifier: (GPL-2.0-only OR BSD-2-Clause)
%YAML 1.2
---
$id: http://devicetree.org/schemas/arm/mediatek/mediatek,wdma.yaml#
$schema: http://devicetree.org/meta-schemas/core.yaml#

title: Mediatek Write Direct Memory Access

maintainers:
  - Matthias Brugger <matthias.bgg@gmail.com>

description: |
  Mediatek Write Direct Memory Access(WDMA) component used to write
  the data into DMA.

properties:
  compatible:
    items:
      - enum:
        - mediatek,mt8183-mdp3-wdma

  mediatek,mdp3-id:
    $ref: /schemas/types.yaml#/definitions/uint32
    maxItems: 1
    description: |
      There may be multiple blocks with the same function but
      different addresses in MDP3.
      In order to distinguish the connection with other blocks,
      a unique ID is needed to dynamically use one or more identical
      blocks to implement multiple pipelines.

  reg:
    maxItems: 1

  mediatek,gce-client-reg:
    $ref: /schemas/types.yaml#/definitions/phandle-array
    description: |
      The register of client driver can be configured by gce with 4 arguments
      defined in this property, such as phandle of gce, subsys id,
      register offset and size.
      Each GCE subsys id is mapping to a client defined in the header
      include/dt-bindings/gce/<chip>-gce.h.

  power-domains:
    maxItems: 1

  clocks:
    minItems: 1

  iommus:
    maxItems: 1

additionalProperties: false

examples:
  - |
    #include <dt-bindings/clock/mt8183-clk.h>
    #include <dt-bindings/gce/mt8183-gce.h>
    #include <dt-bindings/power/mt8183-power.h>
    #include <dt-bindings/memory/mt8183-larb-port.h>

    mdp3_wdma: mdp3_wdma@14006000 {
      compatible = "mediatek,mt8183-mdp3-wdma";
      mediatek,mdp3-id = <0>;
      reg = <0x14006000 0x1000>;
      mediatek,gce-client-reg = <&gce SUBSYS_1400XXXX 0x6000 0x1000>;
      power-domains = <&spm MT8183_POWER_DOMAIN_DISP>;
      clocks = <&mmsys CLK_MM_MDP_WDMA0>;
      iommus = <&iommu>;
    };
```

## Documentation/devicetree/bindings/arm/meson/m8b_smp_mem.txt
```
Meson SRAM and PERIPH base:
----------------------------

Meson8 baby SoC uses sram and periph registers for the bringup
of the cores. Once the core gets powered up it executes the code
that is residing at the agreed address.

Required node properties:
- compatible : should be "amlogic,meson8b-cpuconfig"

Example:

	cpucfg@c4300000 {
			compatible = "amlogic,meson8b-cpuconfig";
			reg = <0xc4300000 0x1000>,
			      <0xd9000000 0x20000>;
	};
```

## Documentation/devicetree/bindings/clock/amlogic,meson-clkc.txt
```
* Amlogic Meson Clock and Reset Unit

The Amlogic Meson clock controller generates and supplies clock to various
controllers of the SoC.

Required Properties:

- compatible: Should be one of the following:
	"amlogic,gxl-aoclkc"   - for gxl ao clock
	"amlogic,gxl-clkc"     - for gxl ee clock
	"amlogic,axg-clkc"     - for axg ee clock
	"amlogic,axg-aoclkc"    - for axg ao clock
	"amlogic,txl-clkc"      - for txl ee clock
	"amlogic,txl-aoclkc"    - for txl ao clock
	"amlogic,txlx-clkc"     - for txlx ee clock
	"amlogic,txlx-aoclkc"    - for txlx ao clock
	"amlogic,g12a-clkc"	- for g12a ee clock
	"amlogic,g12a-aoclkc"   - for g12a ao clock
	"amlogic,g12b-clkc-1"   - for g12b ee part1 clock
	"amlogic,g12b-clkc-2"   - for g12b ee part2 clock
	"amlogic,g12b-aoclkc"   - for g12b ao clock
	"amlogic,tl1-clkc"      - for tl1 ee clock
	"amlogic,tl1-aoclkc"    - for tl1 ao clock
	"amlogic,tl1-measure"    - for tl1 clock measurement
	"amlogic,sm1-clkc-1"   - for sm1 ee part1 clock
	"amlogic,sm1-clkc-2"   - for sm1 ee part2 clock
	"amlogic,sm1-aoclkc"   - for sm1 ao clock

- reg: physical base address of the clock controller and length of memory
       mapped region.

- #clock-cells: should be 1.

- #reset-cells: should be 1.

Example: gxl AO Clock controller node:

	clkc_AO: clock-controller@040 {
		compatible = "amlogic,gxl-aoclkc";
		reg = <0x0 0x040 0x0 0x4>;
		#clock-cells = <1>;
		#reset-cells = <1>;
	};

Example: UART controller node that consumes the clock and reset generated
  by the clock controller:

	uart_AO: serial@4c0 {
		compatible = "amlogic,meson-uart";
		reg = <0x4c0 0x14>;
		interrupts = <0 90 1>;
		clocks = <&clkc_AO CLKID_AO_UART1>;
		resets = <&clkc_AO RESET_AO_UART1>;
		status = "disabled";
	};
```

## Documentation/devicetree/bindings/clock/fsl,imx-blk-ctrl.yaml
```yaml
# SPDX-License-Identifier: (GPL-2.0-only)
%YAML 1.2
---
$id: http://devicetree.org/schemas/clock/fsl,imx-blk-ctrl.yaml#
$schema: http://devicetree.org/meta-schemas/core.yaml#

title: NXP i.MX BLK_CTRL

description: |
  i.MX BLK_CTRL is a conglomerate of different GPRs that are
  dedicated to a specific subsystem. Because it usually contains
  clocks amongst other things, it needs access to the i.MX clocks
  API. All the other functionalities it provides can work just fine
  from the clock subsystem tree.

maintainers:
  - Abel Vesa <abel.vesa@nxp.com>

properties:
  reg:
    maxItems: 1

  compatible:
    items:
      - const: fsl,imx8mp-blk-ctrl
      - const: syscon

  power-domains:
    maxItems: 1

  '#clock-cells':
    const: 1

  '#reset-cells':
    const: 1

required:
  - compatible
  - reg
  - power-domains
  - '#clock-cells'
  - '#reset-cells'

additionalProperties: false

examples:
  - |
    audio-blk-ctrl: blk-ctrl@30e20000 {
       compatible = "fsl,imx8mp-blk-ctrl", "syscon";
       reg = <0x30e20000 0x10000>;
       power-domains = <&audiomix_pd>;

       #clock-cells = <1>;
       #reset-cells = <1>;
    };
```

## Documentation/devicetree/bindings/clock/mediatek,mt8189-clock.yaml
```yaml
# SPDX-License-Identifier: (GPL-2.0 OR BSD-2-Clause)
%YAML 1.2
---
$id: http://devicetree.org/schemas/clock/mediatek,mt8189-clock.yaml#
$schema: http://devicetree.org/meta-schemas/core.yaml#

title: MediaTek Functional Clock Controller for MT8189

maintainers:
  - Chris Chen <chris-qj.chen@mediatek.com>

description: |
  The clock architecture in MediaTek like below
  PLLs -->
          dividers -->
                      muxes
                           -->
                              clock gate

  The devices provide clock gate control in different IP blocks.

properties:
  compatible:
    items:
      - enum:
          - mediatek,mt8189-dbg_ao
          - mediatek,mt8189-dem
          - mediatek,mt8189-emicfg_ao_mem
          - mediatek,mt8189-audiosys
          - mediatek,mt8189-ufscfg_ao
          - mediatek,mt8189-ufscfg_pdn
          - mediatek,mt8189-iic_wrap_ws
          - mediatek,mt8189-iic_wrap_e
          - mediatek,mt8189-iic_wrap_s
          - mediatek,mt8189-iic_wrap_en
          - mediatek,mt8189-mfgsys
          - mediatek,mt8189-dispsys
          - mediatek,mt8189-imgsys1
          - mediatek,mt8189-imgsys2
          - mediatek,mt8189-vdec_core
          - mediatek,mt8189-venc
          - mediatek,mt8189-camsys_main
          - mediatek,mt8189-camsys_rawa
          - mediatek,mt8189-camsys_rawb
          - mediatek,mt8189-ipesys
          - mediatek,mt8189-vlp_ao_ckgen
          - mediatek,mt8189-vlpcfg_reg_bus
          - mediatek,mt8189-dvfsrc_top
          - mediatek,mt8189-vlp_ckgen
          - mediatek,mt8189-scp_i2c
          - mediatek,mt8189-scp
          - mediatek,mt8189-vadsys
          - mediatek,mt8189-mm_infra
          - mediatek,mt8189-gce_d
          - mediatek,mt8189-gce_m
          - mediatek,mt8189-mdpsys
      - const: syscon


  reg:
    maxItems: 1

  '#clock-cells':
    const: 1

required:
  - compatible
  - reg
  - '#clock-cells'

additionalProperties: false

examples:
  - |
    soc {
      #address-cells = <2>;
      #size-cells = <2>;

      imp_iic_wrap_ws_clk: syscon@11b21000 {
        compatible = "mediatek,mt8189-iic_wrap_ws", "syscon";
        reg = <0 0x11b21000 0 0x1000>;
        #clock-cells = <1>;
      };
    };
```

## Documentation/devicetree/bindings/clock/mediatek,mt8189-sys-clock.yaml
```yaml
# SPDX-License-Identifier: (GPL-2.0 OR BSD-2-Clause)
%YAML 1.2
---
$id: http://devicetree.org/schemas/clock/mediatek,mt8189-sys-clock.yaml#
$schema: http://devicetree.org/meta-schemas/core.yaml#

title: MediaTek System Clock Controller for MT8189

maintainers:
  - Chris Chen <chris-qj.chen@mediatek.com>

description: |
  The clock architecture in MediaTek like below
  PLLs -->
          dividers -->
                      muxes
                           -->
                              clock gate

  The apmixedsys provides most of PLLs which generated from SoC 26m.
  The topckgen provides dividers and muxes which provide the clock source to other IP blocks.
  The infra_ao provides clock gate in infrastructure IP blocks.
  The peri_ao provides clock gate in peripheral IP blocks.
  The device nodes also provide the system control capacity for configuration.

properties:
  compatible:
    items:
      - enum:
          - mediatek,mt8189-apmixedsys
          - mediatek,mt8189-infra_ao
          - mediatek,mt8189-peri_ao
          - mediatek,mt8189-topckgen
      - const: syscon

  reg:
    maxItems: 1

  '#clock-cells':
    const: 1

required:
  - compatible
  - reg
  - '#clock-cells'

additionalProperties: false

examples:
  - |
    soc {
      #address-cells = <2>;
      #size-cells = <2>;

      topckgen_clk: syscon@10000000 {
        compatible = "mediatek,mt8189-topckgen", "syscon";
        reg = <0 0x10000000 0 0x1000>;
        #clock-cells = <1>;
      };
    };
```

## Documentation/devicetree/bindings/cpufreq/cpufreq-imx6q.txt
```
iMX6q/iMX6dl/iMX6sl specific CPUFREQ settings

iMX6q/iMX6dl/iMX6sl has limitation that a couple of voltage rails (VDDSOC_CAP and VDDPU_CAP)
must track VDDARM_CAP within 50mV:
VDDARM_CAP - VDDSOC_CAP/VDDPU_CAP <= 50mV

The VDDSOC_CAP and VDDPU_CAP operating points for various VDDARM_CAP settings are listed below.

Required properties:
- fsl,soc-operating-points: Refer to Documentation/devicetree/bindings/power/opp.txt
  for details. It is a voltage frequency tuple.

- For other entries in the example below please refer to Documentation/devicetree/bindings/cpufreq/cpufreq-cpu0.txt

Examples:

cpus {
	#address-cells = <1>;
	#size-cells = <0>;

	cpu@0 {
		compatible = "arm,cortex-a9";
		reg = <0>;
		next-level-cache = <&L2>;
		operating-points = <
			/* kHz    uV */
			1200000 1275000
			996000  1250000
			792000  1175000
			396000  1075000
		>;
		fsl,soc-operating-points = <
			/* ARM kHz  SOC-PU uV */
			1200000       1275000
			996000        1250000
			792000        1175000
			396000        1175000
		>;
		clock-latency = <61036>; /* two CLK32 periods */
	};

	cpu@1 {
		compatible = "arm,cortex-a9";
		reg = <1>;
		next-level-cache = <&L2>;
	};

	cpu@2 {
		compatible = "arm,cortex-a9";
		reg = <2>;
		next-level-cache = <&L2>;
	};

	cpu@3 {
		compatible = "arm,cortex-a9";
		reg = <3>;
		next-level-cache = <&L2>;
	};
};
```

## Documentation/devicetree/bindings/crypto/aml-crypto.txt
```
* Amlogic HW cryptographic accelerators

These are the HW cryptographic accelerators found on Amlogic products.

* Advanced Encryption Standard (AES)

Required properties:
- compatible : Should be "amlogic,aes" for aes-128/192/256 or "amlogic,aes_g12a_dma" for aes-128/256
- dev_name : Should be "aml_aes"
- interrupts: Should contain the IRQ line for the AES.
- resets: Should contain the clock to enable the module
- reg:  Should contain the base address of regs

Example:
aml_aes{
	compatible = "amlogic,aes";
	dev_name = "aml_aes";
	interrupts = <0 36 1>;
	resets = <&clock GCLK_IDX_BLK_MOV>;
	reg = <0x0 0xc8832000 0x0 0x2c4
		0x0 0xda832000 0x0 0xe4>;
};

* Triple Data Encryption Standard (Triple DES)

Required properties:
- compatible : Should be "amlogic,des,tdes".
- dev_name : Should be "aml_aes"
- interrupts: Should contain the IRQ line for the TDES.
- resets: Should contain the clock to enable the module
- reg:  Should contain the base address of regs

Example:
aml_tdes{
	compatible = "amlogic,des,tdes";
	dev_name = "aml_tdes";
	interrupts = <0 36 1>;
	resets = <&clock GCLK_IDX_BLK_MOV>;
	reg = <0x0 0xc8832000 0x0 0x2c4
		0x0 0xda832000 0x0 0xe4>;
};

* Secure Hash Algorithm (SHA1/SHA224/SHA256)

Required properties:
- compatible : Should be "amlogic,sha".
- dev_name : Should be "aml_sha"
- interrupts: Should contain the IRQ line for the SHA.
- resets: Should contain the clock to enable the module
- reg:  Should contain the base address of regs

Example:
aml_sha{
	compatible = "amlogic,sha";
	dev_name = "aml_sha";
	interrupts = <0 36 1>;
	resets = <&clock GCLK_IDX_BLK_MOV>;
	reg = <0x0 0xc8832000 0x0 0x2c4
		0x0 0xda832000 0x0 0xe4>;
};

* New DMA for GXL and beyond
* Dma engine for crypto operations
Required properties:
- compatible : Should be "amlogic,aml_gxl_dma" or "amlogic,aml_txlx_dma".
- reg:  Should contain the base address of regs
- interrupts: Should contain the IRQ line for DMA.

Example:
aml_dma {
	compatible = "amlogic,aml_gxl_dma";
	reg = <0x0 0xff63e000 0x0 0x48>;
	interrupts = <0 180 1>;
};

* Advanced Encryption Standard (AES)

Required properties:
- compatible : Should be "amlogic,aes".
- dev_name : Should be "aml_aes"

Example:
aml_aes{
	compatible = "amlogic,aes_dma";
	dev_name = "aml_aes_dma";
};


* Triple Data Encryption Standard (Triple DES)

Required properties:
- compatible : Should be "amlogic,des,tdes".
- dev_name : Should be "aml_aes"

Example:
aml_tdes{
	compatible = "amlogic,des_dma,tdes_dma";
	dev_name = "aml_tdes_dma";
};
* Secure Hash Algorithm (SHA1/SHA224/SHA256/HMAC)

Required properties:
- compatible : Should be "amlogic,sha".
- dev_name : Should be "aml_sha"

Example:
aml_sha{
	compatible = "amlogic,sha_dma";
	dev_name = "aml_sha_dma";
};
```
