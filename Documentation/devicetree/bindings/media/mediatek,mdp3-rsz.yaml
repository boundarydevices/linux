## Documentation/devicetree/bindings/media/mediatek,mt8365-seninf.yaml
```yaml
# SPDX-License-Identifier: (GPL-2.0-only OR BSD-2-Clause)
# Copyright (c) 2023 MediaTek, BayLibre
%YAML 1.2
---
$id: http://devicetree.org/schemas/media/mediatek,mt8365-seninf.yaml#
$schema: http://devicetree.org/meta-schemas/core.yaml#

title: MediaTek Sensor Interface 3.0

maintainers:
  - Laurent Pinchart <laurent.pinchart@ideasonboard.com>
  - Julien Stephan <jstephan@baylibre.com>
  - Andy Hsieh <andy.hsieh@mediatek.com>

description:
  The ISP3.0 SENINF is the CSI-2 and parallel camera sensor interface found in
  multiple MediaTek SoCs. It can support up to three physical CSI-2
  input ports, configured in DPHY (2 or 4 data lanes) or CPHY depending on the soc.
  On the output side, SENINF can be connected either to CAMSV instance or
  to the internal ISP. CAMSV is used to bypass the internal ISP processing
  in order to connect either an external ISP, or a sensor (RAW, YUV).

properties:
  compatible:
    const: mediatek,mt8365-seninf

  reg:
    maxItems: 1

  interrupts:
    maxItems: 1

  power-domains:
    maxItems: 1

  clocks:
    items:
      - description: Seninf camsys clock
      - description: Seninf top mux clock

  clock-names:
    items:
      - const: camsys
      - const: top_mux

  phys:
    minItems: 1
    maxItems: 4
    description:
      phandle to the PHYs connected to CSI0/A, CSI1, CSI2 and CSI0B

  phy-names:
    minItems: 1
    items:
      - const: csi0
      - const: csi1
      - const: csi2
      - const: csi0b

  ports:
    $ref: /schemas/graph.yaml#/properties/ports

    properties:
      port@0:
        $ref: /schemas/graph.yaml#/$defs/port-base
        unevaluatedProperties: false
        description: CSI0 or CSI0A port

        properties:
          endpoint:
            $ref: video-interfaces.yaml#
            unevaluatedProperties: false

            properties:
              clock-lanes:
                maxItems: 1
              data-lanes:
                minItems: 1
                maxItems: 4

      port@1:
        $ref: /schemas/graph.yaml#/$defs/port-base
        unevaluatedProperties: false
        description: CSI1 port

        properties:
          endpoint:
            $ref: video-interfaces.yaml#
            unevaluatedProperties: false

            properties:
              clock-lanes:
                maxItems: 1
              data-lanes:
                minItems: 1
                maxItems: 4

      port@2:
        $ref: /schemas/graph.yaml#/$defs/port-base
        unevaluatedProperties: false
        description: CSI2 port

        properties:
          endpoint:
            $ref: video-interfaces.yaml#
            unevaluatedProperties: false

            properties:
              clock-lanes:
                maxItems: 1
              data-lanes:
                minItems: 1
                maxItems: 4

      port@3:
        $ref: /schemas/graph.yaml#/$defs/port-base
        unevaluatedProperties: false
        description: CSI0B port

        properties:
          endpoint:
            $ref: video-interfaces.yaml#
            unevaluatedProperties: false

            properties:
              clock-lanes:
                maxItems: 1
              data-lanes:
                minItems: 1
                maxItems: 2

      port@4:
        $ref: /schemas/graph.yaml#/properties/port
        description: connection point for cam0

      port@5:
        $ref: /schemas/graph.yaml#/properties/port
        description: connection point for cam1

      port@6:
        $ref: /schemas/graph.yaml#/properties/port
        description: connection point for camsv0

      port@7:
        $ref: /schemas/graph.yaml#/properties/port
        description: connection point for camsv1

      port@8:
        $ref: /schemas/graph.yaml#/properties/port
        description: connection point for camsv2

      port@9:
        $ref: /schemas/graph.yaml#/properties/port
        description: connection point for camsv3

    required:
      - port@0
      - port@1
      - port@2
      - port@3
      - port@4
      - port@5
      - port@6
      - port@7
      - port@8
      - port@9

required:
  - compatible
  - interrupts
  - clocks
  - clock-names
  - power-domains
  - ports

additionalProperties: false

examples:
  - |
    #include <dt-bindings/clock/mediatek,mt8365-clk.h>
    #include <dt-bindings/interrupt-controller/irq.h>
    #include <dt-bindings/interrupt-controller/arm-gic.h>
    #include <dt-bindings/phy/phy.h>
    #include <dt-bindings/power/mediatek,mt8365-power.h>

    soc {
          #address-cells = <2>;
          #size-cells = <2>;

          seninf: seninf@15040000 {
                compatible = "mediatek,mt8365-seninf";
                reg = <0 0x15040000 0 0x6000>;
                interrupts = <GIC_SPI 210 IRQ_TYPE_LEVEL_LOW>;
                clocks = <&camsys CLK_CAM_SENIF>,
                         <&topckgen CLK_TOP_SENIF_SEL>;
                clock-names = "camsys", "top_mux";

                power-domains = <&spm MT8365_POWER_DOMAIN_CAM>;

                phys = <&mipi_csi0 PHY_TYPE_DPHY>;
                phy-names = "csi0";

                ports {
                      #address-cells = <1>;
                      #size-cells = <0>;

                      port@0 {
                            reg = <0>;
                            seninf_in1: endpoint {
                              clock-lanes = <2>;
                              data-lanes = <1 3 0 4>;
                              remote-endpoint = <&isp1_out>;
                            };
                      };

                      port@1 {
                          reg = <1>;
                      };

                      port@2 {
                            reg = <2>;
                      };

                      port@3 {
                            reg = <3>;
                      };

                      port@4 {
                            reg = <4>;
                            seninf_camsv1_endpoint: endpoint {
                                remote-endpoint = <&camsv1_endpoint>;
                            };
                      };

                      port@5 {
                            reg = <5>;
                      };

                      port@6 {
                            reg = <6>;
                      };

                      port@7 {
                            reg = <7>;
                      };

                      port@8 {
                            reg = <8>;
                      };

                      port@9 {
                            reg = <9>;
                      };

                };
          };
    };

...
```

## Documentation/devicetree/bindings/media/mediatek-camsv.yaml
```yaml
# SPDX-License-Identifier: (GPL-2.0-Only OR BSD-2-Clause)
%YAML 1.2
---
$id: http://devicetree.org/schemas/media/mediatek-camsv.yaml#
$schema: http://devicetree.org/meta-schemas/core.yaml#

title: MediaTek CAMSV Device Tree Bindings

maintainers:
  - Phi-Bang Nguyen <pnguyen@baylibre.com>

description: |
  The CAMSVs is a set of DMA engines connected to the SENINF CSI-2
  receivers. The number of CAMSVs depend on the SoC model.

properties:
  compatible:
    const: mediatek,mt8365-camsv
    const: mediatek,mt8183-camsv

  reg:
    minItems: 1

  interrupts:
    maxItems: 1

  power-domains:
    maxItems: 1

  clocks:
    items:
      - description: cam clock
      - description: camtg clock
      - description: camsv clock

  clock-names:
    items:
      - const: camsys_cam_cgpdn
      - const: camsys_camtg_cgpdn
      - const: camsys_camsv

  iommus:
    items:
      - const: M4U_PORT_CAM_IMGO

  mediatek,larb:
    items:
      - const: larb3
      - const: larb6

  ports:
    $ref: /schemas/graph.yaml#/properties/ports

    properties:
      port@0:
        $ref: /schemas/graph.yaml#/properties/port
        unevaluatedProperties: false
        description: connection point for camsv0

        patternProperties:
          endpoint:
            $ref: video-interfaces.yaml#
            unevaluatedProperties: false

    required:
      - port@0

required:
  - compatible
  - interrupts
  - clocks
  - clock-names
  - power-domains
  - iommus
  - mediatek,larb
  - ports

additionalProperties: false

examples:
  - |
    camsv0: camsv@1a050000 {
        compatible = "mediatek,mt8365-camsv";
        reg = <0 0x1a050000 0 0x1000>;
        interrupts = <GIC_SPI 258 IRQ_TYPE_LEVEL_LOW>;
        clocks = <&camsys CLK_CAM_CAM>,
                <&camsys CLK_CAM_CAMTG>,
                <&camsys CLK_CAM_CAMSV0>;
        clock-names = "camsys_cam_cgpdn", "camsys_camtg_cgpdn",
                    "camsys_camsv";
        iommus = <&iommu M4U_PORT_CAM_IMGO>;
        mediatek,larb = <&larb3>, <&larb6>;
        power-domains = <&scpsys MT8365_POWER_DOMAIN_CAM>;
        status = "disabled";

        ports {
            #address-cells = <1>;
            #size-cells = <0>;
            port@0 {
                reg = <0>;
                camsv0_endpoint: endpoint {
                    remote-endpoint =
                        <&seninf_camsv0_endpoint>;
                };
            };
        };
    };
...
```
