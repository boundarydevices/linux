## Documentation/devicetree/bindings/media/mediatek-seninf.yaml
```yaml
# SPDX-License-Identifier: (GPL-2.0-Only OR BSD-2-Clause)
%YAML 1.2
---
$id: http://devicetree.org/schemas/media/mediatek-seninf.yaml#
$schema: http://devicetree.org/meta-schemas/core.yaml#

title: MediaTek Sensor Interface (CSI) Device Tree Bindings

maintainers:
  - Louis Kuo <louis.kuo@mediatek.com>

description: |
  The SENINF is the CSI-2 and parallel camera sensor interface found in
  multiple MediaTek SoCs. It has three physical CSI-2 input ports, CSI0,
  CSI1 and CSI2, that support up to four data lanes in D-PHY mode.
  Additionally, the CSI0 port can support C-PHY mode with up to three
  trios, and can be split in two independent ports CSI0A and CSI0B (in
  D-PHY mode with two data lanes) to connect two separate sensors.


properties:
  compatible:
    const: mediatek,mt8183-seninf

  reg:
    minItems: 1

  interrupts:
    maxItems: 1

  power-domains:
    maxItems: 1

  clocks:
    items:
      - description: Seninf camsys clock
      - description: Seninf top mux clock

  clock-names:
    items:
      - const: cam_seninf
      - const: top_mux_seninf

  phys:
    items:
      - description: CSI0 C/D-PHY (3 trios, 4 data lanes + 1 clock lane)
      - description: CSI1 D-PHY (4 data lanes + 1 clock lane)
      - description: CSI2 D-PHY (4 data lanes + 1 clock lane)
      - description: CSI0A D-PHY (2 data lanes + 1 clock lane)
      - description: CSI0B D-PHY (2 data lanes + 1 clock lane)

  phy-names:
    items:
      - const: csi0
      - const: csi1
      - const: csi2
      - const: csi0a
      - const: csi0b

  ports:
    $ref: /schemas/graph.yaml#/properties/ports

    properties:
      port@0:
        $ref: /schemas/graph.yaml#/$defs/port-base
        unevaluatedProperties: false
        description: CSI0 or CSI0A port

        patternProperties:
          endpoint:
            $ref: video-interfaces.yaml#
            unevaluatedProperties: false

            properties:
              clock-lanes:
                minItems: 1
              data-lanes:
                minItems: 1
                maxItems: 4

      port@1:
        $ref: /schemas/graph.yaml#/$defs/port-base
        unevaluatedProperties: false
        description: CSI1 port

        patternProperties:
          endpoint:
            $ref: video-interfaces.yaml#
            unevaluatedProperties: false

            properties:
              clock-lanes:
                minItems: 1
              data-lanes:
                minItems: 1
                maxItems: 4

      port@2:
        $ref: /schemas/graph.yaml#/$defs/port-base
        unevaluatedProperties: false
        description: CSI2 port

        patternProperties:
          endpoint:
            $ref: video-interfaces.yaml#
            unevaluatedProperties: false

            properties:
              clock-lanes:
                minItems: 1
              data-lanes:
                minItems: 1
                maxItems: 4

      port@3:
        $ref: /schemas/graph.yaml#/$defs/port-base
        unevaluatedProperties: false
        description: CSI0B port

        patternProperties:
          endpoint:
            $ref: video-interfaces.yaml#
            unevaluatedProperties: false

            properties:
              clock-lanes:
                minItems: 1
              data-lanes:
                minItems: 1
                maxItems: 2

      port@4:
        $ref: /schemas/graph.yaml#/$defs/port-base
        unevaluatedProperties: false
        description: connection point for cam0

        patternProperties:
          endpoint:
            $ref: video-interfaces.yaml#
            unevaluatedProperties: false

      port@5:
        $ref: /schemas/graph.yaml#/$defs/port-base
        unevaluatedProperties: false
        description: connection point for cam1

        patternProperties:
          endpoint:
            $ref: video-interfaces.yaml#
            unevaluatedProperties: false

      port@6:
        $ref: /schemas/graph.yaml#/$defs/port-base
        unevaluatedProperties: false
        description: connection point for camsv0

        patternProperties:
          endpoint:
            $ref: video-interfaces.yaml#
            unevaluatedProperties: false

      port@7:
        $ref: /schemas/graph.yaml#/$defs/port-base
        unevaluatedProperties: false
        description: connection point for camsv1

        patternProperties:
          endpoint:
            $ref: video-interfaces.yaml#
            unevaluatedProperties: false

      port@8:
        $ref: /schemas/graph.yaml#/$defs/port-base
        unevaluatedProperties: false
        description: connection point for camsv2

        patternProperties:
          endpoint:
            $ref: video-interfaces.yaml#
            unevaluatedProperties: false

      port@9:
        $ref: /schemas/graph.yaml#/$defs/port-base
        unevaluatedProperties: false
        description: connection point for camsv3

        patternProperties:
          endpoint:
            $ref: video-interfaces.yaml#
            unevaluatedProperties: false

    required:
      - port@0
      - port@1
      - port@2
      - port@3
      - port@4
      - port@5
      - port@6
      - port@7
      - port@8
      - port@9

required:
  - compatible
  - interrupts
  - clocks
  - clock-names
  - power-domains
  - ports

additionalProperties: false

examples:
  - |
    #include <dt-bindings/clock/mt8183-clk.h>
    #include <dt-bindings/interrupt-controller/irq.h>
    #include <dt-bindings/interrupt-controller/arm-gic.h>
    #include <dt-bindings/power/mt8183-power.h>

    seninf: seninf@1a040000 {
        compatible = "mediatek,mt8183-seninf";
        reg = <0 0x1a040000 0 0x8000>;
        interrupts = <GIC_SPI 251 IRQ_TYPE_LEVEL_LOW>;
        clocks = <&camsys CLK_CAM_SENINF>,
        <&topckgen CLK_TOP_MUX_SENINF>;
        clock-names = "cam_seninf", "top_mux_seninf";
        power-domains = <&scpsys MT8183_POWER_DOMAIN_CAM>;

        phys = <&mipi_rx 0>, <&mipi_rx 1>, <&mipi_rx 2>,
               <&mipi_rx 3>, <&mipi_rx 4>;
        phy-names = "csi0", "csi1", "csi2", "csi0a", "csi0b";

        status = "disabled";

        ports {
            #address-cells = <1>;
            #size-cells = <0>;

            port@0 {
                mipi_ar0330_1: endpoint {
                    clock-lanes = <1>;
                    data-lanes = <0 2>;
                    remote-endpoint = <&ar0330_1_endpoint>;
                };
            };

            port@1 {
                mipi_ar0330_2: endpoint {
                    clock-lanes = <2>;
                    data-lanes = <1 3>;
                    remote-endpoint = <&ar0330_2_endpoint>;
                };
            };

            port@2 {
                reg = <3>;
            };

            port@3 {
                reg = <3>;
            };

            port@4 {
                reg = <4>;
            };

            port@5 {
                reg = <5>;
            };

            port@6 {
                reg = <6>;
                seninf_camsv0_endpoint: endpoint {
                    remote-endpoint = <&camsv0_endpoint>;
                };
            };

            port@7 {
                reg = <7>;
                seninf_camsv1_endpoint: endpoint {
                    remote-endpoint = <&camsv1_endpoint>;
                };
            };

            port@8 {
                reg = <8>;
                seninf_camsv2_endpoint: endpoint {
                    remote-endpoint = <&camsv2_endpoint>;
                };
            };

            port@9 {
                reg = <9>;
                seninf_camsv3_endpoint: endpoint {
                    remote-endpoint = <&camsv3_endpoint>;
                };
            };
        };
    };

    mipi_rx: mipi-dphy@11c80000 {
        compatible = "mediatek,mt8183-mipi-dphy";
        reg = <0 0x11C80000 0 0x6000>;
        #phy-cells = <1>;
    };

    i2c2 {
        #address-cells = <1>;
        #size-cells = <0>;
        sensor@10 {
            compatible = "onnn,ar0330";
            reg = <0x10>;

            pinctrl-names = "default";
            pinctrl-0 = <&cam0_pins_default>;

            clocks = <&topckgen CLK_TOP_MUX_CAMTG>;
            clock-frequency = <24000000>;

            reset-gpios = <&pio 157 GPIO_ACTIVE_LOW>;

            vddpll-supply = <&mt6358_vldo28_reg>;
            vaa-supply = <&mt6358_vcama1_reg>;
            vddio-supply = <&mt6358_vcamio_reg>;

            port@0 {
                ar0330_1_endpoint: endpoint {
                    remote-endpoint = <&mipi_ar0330_1>;
                    bus-type = <4>;
                    clock-lanes = <0>;
                    data-lanes = <1 2>;
                };
            };
        };
    };

    i2c4 {
        #address-cells = <1>;
        #size-cells = <0>;
        sensor@10 {
            compatible = "onnn,ar0330";
            reg = <0x10>;

            pinctrl-names = "default";
            pinctrl-0 = <&cam1_pins_default>;

            clocks = <&topckgen CLK_TOP_MUX_CAMTG2>;
            clock-frequency = <24000000>;

            reset-gpios = <&pio 102 GPIO_ACTIVE_LOW>;

            vddpll-supply = <&mt6358_vldo28_reg>;
            vaa-supply = <&mt6358_vcama2_reg>;
            vddio-supply = <&mt6358_vcamio_reg>;

            port@0 {
                ar0330_2_endpoint: endpoint {
                    remote-endpoint = <&mipi_ar0330_2>;
                    bus-type = <4>;
                    clock-lanes = <0>;
                    data-lanes = <1 2>;
                };
            };
        };
    };
...
```

## Documentation/devicetree/bindings/mfd/fsl,imx-mix.yaml
```yaml
# SPDX-License-Identifier: GPL-2.0
%YAML 1.2
---
$id: http://devicetree.org/schemas/mfd/fsl,imx-mix.yaml#
$schema: http://devicetree.org/meta-schemas/core.yaml#

title: Freescale i.MX mix

description: |
  i.MX mix is a conglomerate of different GPRs that are
  usually dedicated to one subsystem. These GPRs can be
  further split between different types of drivers, once
  the MFD populates all the devices based on its devicetree
  subnodes.

maintainers:
  - Abel Vesa <abel.vesa@nxp.com>

properties:
  reg:
    maxItems: 1
  compatible:
    const: fsl,imx8mp-mix

required:
  - compatible
  - reg

examples:
  - |
    audiomix: mix@30e20000 {
       compatible = "fsl,imx8mp-mix";
       reg = <0x30e20000 0x10000>;
    };
```

## Documentation/devicetree/bindings/mfd/max77958.txt
```
The MAX77958
is a complete solution for USB Type-C CC detection and PD protocol implementation

Required properties :
 - compatible : "max77958"

Example:

&i2c_6 {
	status = "okay";
	max77958: max77958usbc@25 {
		compatible = "max77958";
		reg = <0x25>;
		max77958,irq-gpio = <&tlmm 92 0x00>;
	};
};
```

## Documentation/devicetree/bindings/mlb/mlb150.txt
```
* Freescale Media Local Bus Host Controller (MLB) for i.MX

The Media Local Bus Host Controller on Freescale i.MX family
provides an interface for MOST network.

Required properties:
- compatible : Should be "fsl,<chip>-mlb"
- reg : Should contain mlb registers location and length
- interrupts : Should contain mlb interrupt

Examples:
mlb@0218c000 {
	compatible = "fsl,imx6q-mlb";
	reg = <0x0218c000 0x4000>;
	interrupts = <0 53 0x04 0 117 0x04 0 126 0x04>;
	clocks = <&clks 139>, <&clks 175>;
	clock-names = "mlb3p", "mlb6p";
	status = "disabled";
};
```

## Documentation/devicetree/bindings/mtd/aml-spifc.txt
```
Amlogic SPI Flash Controller

Required properties:
- compatible : Should be "amlogic,aml-spi-nor"
- reg : Offset and range of the register set for the controller device, different value for different IC.
- clocks : Handle to spi-nor flash controller clock, please refer to IC spec.
- read-capability : read capability of this flash, please refer to flash spec. 0:normal,1:fast,2:dual read,3:quad read.
- spifc-io-width : the io number of spifc on the board.
- cs_gpios : we use cs pin as gpio.

Example:
spifc: spifc@c1108c80 {
	status = "disabled";
	compatible = "amlogic,aml-spi-nor";
	reg = <0x0 0xc1108c80 0x0 0x80>;
	pinctrl-names = "default";
	pinctrl-0 = <&spifc_all_pins>;
	clocks = <&clkc CLKID_CLK81>;
	clock-names = "core";
	spi-nor@0 {
		compatible = "jedec,spi-nor";
		spifc-frequency = <40000000>;
		read-capability = <2>;
		spifc-io-width = <2>;
		cs_gpios = <&gpio BOOT_11 GPIO_ACTIVE_HIGH>;
	};
};
```

## Documentation/devicetree/bindings/net/can/microchip,mcp25xxfd.txt
```
* Microchip MCP2517/18FD stand-alone CAN controller device tree bindings

Required properties:
 - compatible: Should be one of the following:
   - "microchip,mcp2517fd" for MCP2517FD.
   - "microchip,mcp2518fd" for MCP2518FD.
   - "microchip,mcp25xxfd" to autodetect chip variant.
 - reg: SPI chip select.
 - clocks: The clock feeding the CAN controller.
 - interrupt-parent: The parent interrupt controller.
 - interrupts: Should contain IRQ line for the CAN controller.

Optional properties:
 - vdd-supply: Regulator that powers the CAN controller.
 - xceiver-supply: Regulator that powers the CAN transceiver.
 - rx-int-gpios: GPIO phandle of GPIO connected to to INT1 pin of the
   MCP25XXFD, which signals a pending RX interrupt.

Example:
	can0: can@0 {
		compatible = "microchip,mcp25xxfd";
		reg = <0>;
		clocks = <&can0_osc>;
		pinctrl-names = "default";
		pinctrl-0 = <&can0_pins>;
		spi-max-frequency = <20000000>;
		interrupt-parent = <&gpio>;
		interrupts = <13 IRQ_TYPE_LEVEL_LOW>;
		rx-int-gpios = <&gpio 27 GPIO_ACTIVE_LOW>;
		vdd-supply = <&reg5v0>;
		xceiver-supply = <&reg5v0>;
	};
```

## Documentation/devicetree/bindings/net/realtek.txt
```
Realtek PHY properties.

These properties cover the base properties Realtek PHYs.

Optional properties:
 - rtl821x,clkout-disable: disable CLKOUT clock.
 - rtl821x,aldps-disable : disable ALDPS mode.
```

## Documentation/devicetree/bindings/nvmem/mt635x-efuse.yaml
```yaml
# SPDX-License-Identifier: (GPL-2.0 OR BSD-2-Clause)
%YAML 1.2
---
$id: http://devicetree.org/schemas/nvmem/mt635x-efuse.yaml#
$schema: http://devicetree.org/meta-schemas/core.yaml#

title: MediaTek mt635x-efuse Device Tree Bindings

description: |
  This binding is intended to represent mt635x-efuse which is found in most MediaTek SOCs.


properties:
  compatible:
    enum:
      - mediatek,mt6359p-efuse

examples:
  - |
      pmic_efuse: pmic-efuse {
        compatible = "mediatek,mt6359p-efuse";
        #address-cells = <1>;
        #size-cells = <1>;
        thermal_efuse_data1: e-data1 {
          reg = <0x3e 10>;
        };
      };

...
```

## Documentation/devicetree/bindings/phy/fsl,imx-pcie-phy.txt
```
* Freescale i.MX PCIE PHY binding

Required properties:
- compatible:	Should be "fsl,imx-pcie-phy"
- #phys-cells:	must be 0 (see phy-bindings.txt in this directory)
- reg:		The base address and length of the registers
- clocks:	Phandles to the clocks for each clock listed in clock-names
- clock-names:	Must contain "phy"
- clk_mode:	Specify the reference clock source. Three clock sources can be
  used as PCIe PHY reference clock on iMX8MP PCIe. Use clk_mode to specify it.
  1: PLL_XO, 2: EXT_OSC, 3: PLL_SYS.
- power-domains: Phandle to the power domain that the device is part of

Example:
	pcie_phy: pcie-phy@32f00000 {
		compatible = "fsl,imx8mp-pcie-phy";
		reg = <0x0 0x32f00000 0x0 0x10000>;
		clocks = <&clk IMX8MP_CLK_PCIE_PHY>;
		clock-names = "phy";
		assigned-clocks = <&clk IMX8MP_CLK_PCIE_PHY>;
		assigned-clock-parents = <&clk IMX8MP_CLK_24M>;
		#phy-cells = <0>;
		power-domains = <&pcie_pd>;
		status = "disabled";
	};
```
