## Documentation/devicetree/bindings/phy/fsl,samsung-hdmi-phy.yaml
```yaml
# SPDX-License-Identifier: GPL-2.0
%YAML 1.2
---
$id: http://devicetree.org/schemas/phy/fsl,samsung-hdmi-phy.yaml#
$schema: http://devicetree.org/meta-schemas/core.yaml#

title: Freesclae iMX8MP HDMI PHY WITH SAMSUNG IP BLOCK

maintainers:
  - Sandor Yu <Sandor.yu@nxp.com>

properties:
  compatible:
    enum:
      - fsl,samsung-hdmi-phy

  reg:
    maxItems: 1

  clock-output-names:
    description:
      The HDMI PHY Pixel output clock name.

  "#clock-cells":
    const: 0

  "#phy-cells":
    const: 0

  clocks:
    maxItems: 2
    items:
      - description: apb for system control and register configuration
      - description: ref for crystal-oscillator reference PLL clock input.

  clock-names:
    - const: apb
    - const: ref

  reset:
    maxItems: 1

required:
  - compatible
  - reg
  - "#clock-cells"
  - "#phy-cells"
  - clocks
  - clock-names
  - reset

optional:
  - clock-output-names

additionalProperties: false

examples:
  - |
    hdmiphy: hdmiphy@32fdff00 {
      compatible = "fsl,samsung-hdmi-phy";
      reg = <0x32fdff00 0x100>;
      clocks = <&hdmimix_clk IMX8MP_CLK_HDMIMIX_TX_PHY_APB_CLK>,
               <&hdmimix_clk IMX8MP_CLK_HDMIMIX_GLOBAL_XTAL24M_CLK>;
      clock-names = "apb", "ref";
      resets = <&hdmimix_reset IMX_HDMIMIX_HDMI_PHY_RESET>;
      clock-output-names = "hdmi_pclk";
      #phy-cells = <0>;
      #clock-cells = <0>;
    };

    hdmi: hdmi@32fd8000 {
      compatible = "fsl,imx8mp-hdmi";
      ...
      phys = <&hdmiphy>;
      phy-names = "hdmi";
      ...
    };

    lcdif3: lcd-controller@32fc6000 {
      compatible = "fsl,imx8mp-lcdif3";
      ...
      clocks = <&hdmiphy 0>, ...;
      clock-names = "pix", ...;
      ...
    };
```

## Documentation/devicetree/bindings/phy/mediatek,lvds-phy.yaml
```yaml
# SPDX-License-Identifier: (GPL-2.0-only OR BSD-2-Clause)
# Copyright (c) 2023 MediaTek
%YAML 1.2
---
$id: http://devicetree.org/schemas/phy/mediatek,lvds-phy.yaml#
$schema: http://devicetree.org/meta-schemas/core.yaml#

title: MediaTek Low-Voltage Differential Signaling (LVDS) PHY

maintainers:
  - Chun-Kuang Hu <chunkuang.hu@kernel.org>
  - Philipp Zabel <p.zabel@pengutronix.de>
  - Chunfeng Yun <chunfeng.yun@mediatek.com>

description: |
  The LVDS PHY serializes the four differential pairs of 8-bit parallel
  output from the LVDS encoder and drives the LVDS pads.

properties:
  $nodename:
    pattern: "^lvds_phy@[0-9a-f]+$"

  compatible:
    oneOf:
      - items:
          - enum:
              - mediatek,mt8365-lvds-tx
  reg:
    maxItems: 1

  clocks:
    items:
      - description: PLL clock

  clock-output-names:
    items:
      - const: lvdx_tx_pll

  "#phy-cells":
    const: 0

  "#clock-cells":
    const: 0

required:
  - compatible
  - reg
  - clocks
  - clock-output-names
  - "#phy-cells"
  - "#clock-cells"

additionalProperties: false

examples:
  - |
    #include <dt-bindings/clock/mediatek,mt8365-clk.h>
    lvds_tx: lvds-phy@11c00800 {
        compatible = "mediatek,mt8365-lvds-tx";
        reg = <0x11c00800 0x30>;
        clocks = <&clk26m>;
        clock-output-names = "lvdx_tx_pll";
        #clock-cells = <0>;
        #phy-cells = <0>;
    };

...
```

## Documentation/devicetree/bindings/phy/mediatek,mtk8195-hdmi-phy.yaml
```yaml
# SPDX-License-Identifier: (GPL-2.0-only OR BSD-2-Clause)
# Copyright (c) 2020 MediaTek
%YAML 1.2
---
$id: http://devicetree.org/schemas/phy/mediatek,hdmi-phy.yaml#
$schema: http://devicetree.org/meta-schemas/core.yaml#

title: MediaTek High Definition Multimedia Interface (HDMI) PHY binding for mt8195

maintainers:
  - Chun-Kuang Hu <chunkuang.hu@kernel.org>
  - Philipp Zabel <p.zabel@pengutronix.de>
  - Chunfeng Yun <chunfeng.yun@mediatek.com>

description: |
  The HDMI PHY serializes the HDMI encoder's three channel 10-bit parallel
  output and drives the HDMI pads.

properties:
  $nodename:
    pattern: "^hdmi-phy@[0-9a-f]+$"

  compatible:
    enum:
      - mediatek,mt8195-hdmi-phy
      - mediatek,mt8188-hdmi-phy

  reg:
    maxItems: 1

  clocks:
    items:
      - description: PLL reference clock

  clock-names:
    items:
      - const: hdmi_xtal_sel

  clock-output-names:
    items:
      - const: hdmi_txpll

  "#phy-cells":
    const: 0

  "#clock-cells":
    const: 0

required:
  - compatible
  - reg
  - clocks
  - clock-names
  - clock-output-names
  - "#phy-cells"
  - "#clock-cells"

additionalProperties: false

examples:
  - |
    hdmi_phy: hdmi-phy@11d5f000 {
        compatible = "mediatek,mt8195-hdmi-phy";
        reg = <0 0x11d5f000 0 0x100>;
        clocks = <&topckgen 77>;
        clock-names = "hdmi_xtal_sel";
        clock-output-names = "hdmi_txpll";
        #clock-cells = <0>;
        #phy-cells = <0>;
    };

...
```

## Documentation/devicetree/bindings/phy/phy-mtk-dphy.yaml
```yaml
# SPDX-License-Identifier: (GPL-2.0-Only OR BSD-2-Clause)
%YAML 1.2
---
$id: http://devicetree.org/schemas/phy/phy-mtk-dphy.yaml#
$schema: http://devicetree.org/meta-schemas/core.yaml#

title: Mediatek Sensor Interface MIPI D-PHY Device Tree Bindings

maintainers:
  - Florian Sylvestre <fsylvestre@baylibre.com>

description: |
  The SENINF D-PHY is a set of D-PHY connected to the SENINF CSI-2
  receivers. The number of PHYs depends on the SoC model.

properties:
  compatible:
    const: mediatek,mt8167-mipi-dphy

  reg:
    minItems: 1

  '#phy-cells':
    const: 1

required:
  - compatible
  - reg
  - '#phy-cells'

additionalProperties: false

examples:
  - |
    mipi_dphy: mipi-dphy@10011800 {
        compatible = "mediatek,mt8167-mipi-dphy";
        reg-names = "mipi_rx_config";
        reg = <0 0x10011800 0 0x60>;
        #phy-cells = <1>;
    };
...
```

## Documentation/devicetree/bindings/pinctrl/mediatek,eint.yaml
```yaml
# SPDX-License-Identifier: (GPL-2.0-only OR BSD-2-Clause)
%YAML 1.2
---
$id: http://devicetree.org/schemas/pinctrl/mediatek,eint.yaml#
$schema: http://devicetree.org/meta-schemas/core.yaml#

title: MediaTek External Interrupt Controller (EINT)

maintainers:
  - Shu-yun Wu <shu-yun.wu@mediatek.com>

properties:
  compatible:
    const: mediatek,mtk-eint

  reg:
    description:
      Physical address base for EINT base registers.

  reg-names:
    description:
      EINT base regiater names.

  interrupts:
    description:
      The interrupt specifier for the EINT block

  mediatek,instance-num:
    description: The number of instances for the EINT controller
    $ref: /schemas/types.yaml#/definitions/uint32

  mediatek,total-pin-number:
    description: Total number of pins managed by EINT controller
    $ref: /schemas/types.yaml#/definitions/uint32

  mediatek,pins:
    description:
      Sequence of pins information. Each pin is defined by a tuple-
      < gpio index, offset in group, eint number, use debounce >
    $ref: /schemas/types.yaml#/definitions/uint8-matrix
    items:
      items:
        - description:
            The gpio index
        - description:
            The offset in the group
        - description:
            The eint number
        - description:
            Use debounce or not

required:
  - compatible
  - reg
  - reg-names
  - interrupts
  - mediatek,instance-num
  - mediatek,total-pin-number
  - mediatek,pins

additionalProperties: false

examples:
  - |
    #include <dt-bindings/interrupt-controller/arm-gic.h>

    soc {
      #address-cells = <2>;
      #size-cells = <2>;

      eint: apirq@11ce0000 {
        compatible = "mediatek,mtk-eint";
        reg = <0 0x11ce0000 0 0x1000>,
              <0 0x11de0000 0 0x1000>,
              <0 0x11e60000 0 0x1000>,
              <0 0x1c01e000 0 0x1000>,
              <0 0x11f00000 0 0x1000>;
        reg-names = "eint-e", "eint-s", "eint-w", "eint-c", "eint-n";
        interrupts = <GIC_SPI 239 IRQ_TYPE_LEVEL_HIGH 0>;
        mediatek,instance-num = <5>;
        mediatek,total-pin-number = <210>;
        mediatek,pins = <0 0 0 1>,<1 0 1 1>,<2 0 2 1>,<3 0 3 1>,
          <4 0 4 1>,<5 0 5 1>,<6 0 6 1>,<7 0 7 1>,
          <8 0 8 1>,<9 0 9 1>,<10 0 10 1>,<11 0 11 1>;
      };
    };
```
