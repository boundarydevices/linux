## Documentation/devicetree/bindings/media/mediatek,mdp3-rsz.yaml
```yaml
# SPDX-License-Identifier: (GPL-2.0-only OR BSD-2-Clause)
%YAML 1.2
---
$id: http://devicetree.org/schemas/media/mediatek,mdp3-rsz.yaml#
$schema: http://devicetree.org/meta-schemas/core.yaml#

title: Mediatek Resizer

maintainers:
  - Daoyuan Huang <daoyuan.huang@mediatek.com>
  - Moudy Ho <moudy.ho@mediatek.com>

description: |
  One of Media Data Path 3 (MDP3) components used to do frame resizing.

properties:
  compatible:
    items:
      - enum:
        - mediatek,mt8183-mdp3-rsz

  mediatek,mdp3-id:
    $ref: /schemas/types.yaml#/definitions/uint32
    maxItems: 1
    description: |
      There may be multiple blocks with the same function but
      different addresses in MDP3.
      In order to distinguish the connection with other blocks,
      a unique ID is needed to dynamically use one or more identical
      blocks to implement multiple pipelines.

  reg:
    maxItems: 1

  mediatek,gce-client-reg:
    $ref: /schemas/types.yaml#/definitions/phandle-array
    description: |
      The register of client driver can be configured by gce with 4 arguments
      defined in this property, such as phandle of gce, subsys id,
      register offset and size.
      Each GCE subsys id is mapping to a client defined in the header
      include/dt-bindings/gce/<chip>-gce.h.

  clocks:
    minItems: 1

additionalProperties: false

examples:
  - |
    #include <dt-bindings/clock/mt8183-clk.h>
    #include <dt-bindings/gce/mt8183-gce.h>

    mdp3_rsz0: mdp3_rsz0@14003000 {
      compatible = "mediatek,mt8183-mdp3-rsz";
      mediatek,mdp3-id = <0>;
      reg = <0x14003000 0x1000>;
      mediatek,gce-client-reg = <&gce SUBSYS_1400XXXX 0x3000 0x1000>;
      clocks = <&mmsys CLK_MM_MDP_RSZ0>;
    };

    mdp3_rsz1: mdp3_rsz1@14004000 {
      compatible = "mediatek,mt8183-mdp3-rsz";
      mediatek,mdp3-id = <1>;
      reg = <0x14004000 0x1000>;
      mediatek,gce-client-reg = <&gce SUBSYS_1400XXXX 0x4000 0x1000>;
      clocks = <&mmsys CLK_MM_MDP_RSZ1>;
    };
```

## Documentation/devicetree/bindings/media/mediatek,mdp3-split.yaml
```yaml
# SPDX-License-Identifier: (GPL-2.0-only OR BSD-2-Clause)
%YAML 1.2
---
$id: http://devicetree.org/schemas/media/mediatek,mdp3-split.yaml#
$schema: http://devicetree.org/meta-schemas/core.yaml#

title: MediaTek Media Data Path 3 SPLIT Device Tree Bindings

maintainers:
  - Matthias Brugger <matthias.bgg@gmail.com>
  - Moudy Ho <moudy.ho@mediatek.com>

description: |
  One of Media Data Path 3 (MDP3) components used to split hdmi rx into two stream

properties:
  compatible:
    enum:
      - mediatek,mt8195-mdp3-split

  reg:
    maxItems: 1

  mediatek,gce-client-reg:
    $ref: /schemas/types.yaml#/definitions/phandle-array
    items:
      items:
        - description: phandle of GCE
        - description: GCE subsys id
        - description: register offset
        - description: register size
    description: The register of client driver can be configured by gce with
      4 arguments defined in this property. Each GCE subsys id is mapping to
      a client defined in the header include/dt-bindings/gce/<chip>-gce.h.

  clocks:
    items:
      - description: Engine Clock
      - description: HDMI Clock
      - description: MDHI Clock
      - description: Digital Clock
      - description: Digital Clock
      - description: Digital Clock
      - description: HS Clock

  power-domains:
    maxItems: 1

required:
  - compatible
  - reg
  - mediatek,gce-client-reg
  - clocks
  - power-domains

additionalProperties: false

examples:
  - |
    #include <dt-bindings/clock/mt8195-clk.h>
    #include <dt-bindings/gce/mt8195-gce.h>
    #include <dt-bindings/power/mt8195-power.h>

    mdp3-split0@14f06000 {
      compatible = "mediatek,mt8195-mdp3-split";
      reg = <0x14f06000 0x1000>;
      mediatek,gce-client-reg = <&gce1 SUBSYS_14f0XXXX 0x6000 0x1000>;
      clocks = <&vppsys1 CLK_VPP1_VPP_SPLIT>,
               <&vppsys1 CLK_VPP1_HDMI_META>,
               <&vppsys1 CLK_VPP1_VPP_SPLIT_HDMI>,
               <&vppsys1 CLK_VPP1_DGI_IN>,
               <&vppsys1 CLK_VPP1_DGI_OUT>,
               <&vppsys1 CLK_VPP1_VPP_SPLIT_DGI>,
               <&vppsys1 CLK_VPP1_VPP_SPLIT_26M>;
      power-domains = <&spm MT8195_POWER_DOMAIN_VPPSYS0>;
    };
```

## Documentation/devicetree/bindings/media/mediatek,mdp3-tdshp.yaml
```yaml
# SPDX-License-Identifier: (GPL-2.0-only OR BSD-2-Clause)
%YAML 1.2
---
$id: http://devicetree.org/schemas/media/mediatek,mdp3-tdshp.yaml#
$schema: http://devicetree.org/meta-schemas/core.yaml#

title: MediaTek Media Data Path 3 TDSHP Device Tree Bindings

maintainers:
  - Matthias Brugger <matthias.bgg@gmail.com>
  - Moudy Ho <moudy.ho@mediatek.com>

description: |
  One of Media Data Path 3 (MDP3) components used to improve image
  sharpness and contrast.

properties:
  compatible:
    enum:
      - mediatek,mt8195-mdp3-tdshp

  reg:
    maxItems: 1

  mediatek,gce-client-reg:
    $ref: /schemas/types.yaml#/definitions/phandle-array
    items:
      items:
        - description: phandle of GCE
        - description: GCE subsys id
        - description: register offset
        - description: register size
    description: The register of client driver can be configured by gce with
      4 arguments defined in this property. Each GCE subsys id is mapping to
      a client defined in the header include/dt-bindings/gce/<chip>-gce.h.

  clocks:
    minItems: 1

  power-domains:
    maxItems: 1

required:
  - compatible
  - reg
  - mediatek,gce-client-reg
  - clocks
  - power-domains

additionalProperties: false

examples:
  - |
    #include <dt-bindings/clock/mt8195-clk.h>
    #include <dt-bindings/gce/mt8195-gce.h>
    #include <dt-bindings/power/mt8195-power.h>

    mdp3-tdshp0@14007000 {
      compatible = "mediatek,mt8195-mdp3-tdshp";
      reg = <0x14007000 0x1000>;
      mediatek,gce-client-reg = <&gce1 SUBSYS_1400XXXX 0x7000 0x1000>;
      clocks = <&vppsys0 CLK_VPP0_MDP_TDSHP>;
      power-domains = <&spm MT8195_POWER_DOMAIN_VPPSYS0>;
    };
```

## Documentation/devicetree/bindings/media/mediatek,mdp3-wrot.yaml
```yaml
# SPDX-License-Identifier: (GPL-2.0-only OR BSD-2-Clause)
%YAML 1.2
---
$id: http://devicetree.org/schemas/media/mediatek,mdp3-wrot.yaml#
$schema: http://devicetree.org/meta-schemas/core.yaml#

title: Mediatek Write DMA with Rotation

maintainers:
  - Daoyuan Huang <daoyuan.huang@mediatek.com>
  - Moudy Ho <moudy.ho@mediatek.com>

description: |
  One of Media Data Path 3 (MDP3) components used to write DMA with frame rotation.

properties:
  compatible:
    items:
      - enum:
        - mediatek,mt8183-mdp3-wrot

  mediatek,mdp3-id:
    $ref: /schemas/types.yaml#/definitions/uint32
    maxItems: 1
    description: |
      There may be multiple blocks with the same function but
      different addresses in MDP3.
      In order to distinguish the connection with other blocks,
      a unique ID is needed to dynamically use one or more identical
      blocks to implement multiple pipelines.

  reg:
    maxItems: 1

  mediatek,gce-client-reg:
    $ref: /schemas/types.yaml#/definitions/phandle-array
    description: |
      The register of client driver can be configured by gce with 4 arguments
      defined in this property, such as phandle of gce, subsys id,
      register offset and size.
      Each GCE subsys id is mapping to a client defined in the header
      include/dt-bindings/gce/<chip>-gce.h.

  power-domains:
    maxItems: 1

  clocks:
    minItems: 1

  iommus:
    maxItems: 1

additionalProperties: false

examples:
  - |
    #include <dt-bindings/clock/mt8183-clk.h>
    #include <dt-bindings/gce/mt8183-gce.h>
    #include <dt-bindings/power/mt8183-power.h>
    #include <dt-bindings/memory/mt8183-larb-port.h>

    mdp3_wrot0: mdp3_wrot0@14005000 {
      compatible = "mediatek,mt8183-mdp3-wrot";
      mediatek,mdp3-id = <0>;
      reg = <0x14005000 0x1000>;
      mediatek,gce-client-reg = <&gce SUBSYS_1400XXXX 0x5000 0x1000>;
      power-domains = <&spm MT8183_POWER_DOMAIN_DISP>;
      clocks = <&mmsys CLK_MM_MDP_WROT0>;
      iommus = <&iommu>;
    };
```

## Documentation/devicetree/bindings/media/mediatek,mt8365-camsv.yaml
```yaml
# SPDX-License-Identifier: (GPL-2.0-only OR BSD-2-Clause)
# Copyright (c) 2023 MediaTek, BayLibre
%YAML 1.2
---
$id: http://devicetree.org/schemas/media/mediatek,mt8365-camsv.yaml#
$schema: http://devicetree.org/meta-schemas/core.yaml#

title: MediaTek CAMSV 3.0

maintainers:
  - Laurent Pinchart <laurent.pinchart@ideasonboard.com>
  - Julien Stephan <jstephan@baylibre.com>
  - Andy Hsieh <andy.hsieh@mediatek.com>

description:
  The CAMSV is a set of DMA engines connected to the SENINF CSI-2
  receivers. The number of CAMSVs depend on the SoC model.

properties:
  compatible:
    const: mediatek,mt8365-camsv

  reg:
    items:
      - description: camsv base
      - description: img0 base
      - description: tg base

  interrupts:
    maxItems: 1

  power-domains:
    maxItems: 1

  clocks:
    items:
      - description: cam clock
      - description: camtg clock
      - description: camsv clock

  clock-names:
    items:
      - const: cam
      - const: camtg
      - const: camsv

  iommus:
    maxItems: 1

  ports:
    $ref: /schemas/graph.yaml#/properties/ports

    properties:
      port@0:
        $ref: /schemas/graph.yaml#/properties/port
        description: connection point for camsv0

    required:
      - port@0

required:
  - compatible
  - interrupts
  - clocks
  - clock-names
  - power-domains
  - iommus
  - ports

additionalProperties: false

examples:
  - |
    #include <dt-bindings/interrupt-controller/arm-gic.h>
    #include <dt-bindings/interrupt-controller/irq.h>
    #include <dt-bindings/clock/mediatek,mt8365-clk.h>
    #include <dt-bindings/memory/mediatek,mt8365-larb-port.h>
    #include <dt-bindings/power/mediatek,mt8365-power.h>

    soc {
        #address-cells = <2>;
        #size-cells = <2>;

        camsv1: camsv@15050000 {
            compatible = "mediatek,mt8365-camsv";
            reg = <0 0x15050000 0 0x0040>,
                  <0 0x15050208 0 0x0020>,
                  <0 0x15050400 0 0x0100>;
            interrupts = <GIC_SPI 186 IRQ_TYPE_LEVEL_LOW>;
            clocks = <&camsys CLK_CAM>,
                     <&camsys CLK_CAMTG>,
                     <&camsys CLK_CAMSV0>;
            clock-names = "cam", "camtg", "camsv";
            iommus = <&iommu M4U_PORT_CAM_IMGO>;
            power-domains = <&spm MT8365_POWER_DOMAIN_CAM>;

            ports {
                #address-cells = <1>;
                #size-cells = <0>;
                port@0 {
                    reg = <0>;
                    camsv1_endpoint: endpoint {
                        remote-endpoint = <&seninf_camsv1_endpoint>;
                    };
                };
            };
        };
    };
...
```
