## Documentation/devicetree/bindings/pinctrl/mediatek,mt8189-pinctrl.yaml
```yaml
# SPDX-License-Identifier: (GPL-2.0-only OR BSD-2-Clause)
%YAML 1.2
---
$id: http://devicetree.org/schemas/pinctrl/mediatek,mt8189-pinctrl.yaml#
$schema: http://devicetree.org/meta-schemas/core.yaml#

title: MediaTek MT8189 Pin Controller

maintainers:
  - Shuyun Wu <shu-yun.wu@mediatek.com>

description:
  The MediaTek's MT8189 Pin controller is used to control SoC pins.

properties:
  compatible:
    const: mediatek,mt8189-pinctrl

  gpio-controller: true

  '#gpio-cells':
    description:
      Number of cells in GPIO specifier. Since the generic GPIO binding is used,
      the amount of cells must be specified as 2. See the below mentioned gpio
      binding representation for description of particular cells.
    const: 2

  gpio-ranges:
    description: GPIO valid number range.
    maxItems: 1

  gpio-line-names: true

  reg:
    description:
      Physical address base for GPIO base registers. There are 10 GPIO physical
      address base in mt8189.
    maxItems: 10

  reg-names:
    description:
      GPIO base register names.
    maxItems: 10

  interrupt-controller: true

  '#interrupt-cells':
    const: 2

  mediatek,rsel-resistance-in-si-unit:
    type: boolean
    description:
      Identifying i2c pins pull up/down type which is RSEL. It can support RSEL
      define or si unit value(ohm) to set different resistance.

# PIN CONFIGURATION NODES
patternProperties:
  '-pins$':
    type: object
    additionalProperties: false
    patternProperties:
      '^pins':
        type: object
        additionalProperties: false
        description: |
          A pinctrl node should contain at least one subnodes representing the
          pinctrl groups available on the machine. Each subnode will list the
          pins it needs, and how they should be configured, with regard to muxer
          configuration, pullups, drive strength, input enable/disable and input
          schmitt.
          An example of using macro:
          pincontroller {
            /* GPIO0 set as multifunction GPIO0 */
            gpio-pins {
              pins {
                pinmux = <PINMUX_GPIO0__FUNC_GPIO0>;
              }
            };
            /* GPIO8 set as multifunction SDA0 */
            i2c0-pins {
              pins {
                pinmux = <PINMUX_GPIO8__FUNC_SDA0>;
              }
            };
          };
        $ref: pinmux-node.yaml

        properties:
          pinmux:
            description:
              Integer array, represents gpio pin number and mux setting.
              Supported pin number and mux varies for different SoCs, and are
              defined as macros in dt-bindings/pinctrl/<soc>-pinfunc.h directly.

          drive-strength:
            enum: [2, 4, 6, 8, 10, 12, 14, 16]

          drive-strength-microamp:
            enum: [125, 250, 500, 1000]

          bias-pull-down:
            oneOf:
              - type: boolean
              - enum: [100, 101, 102, 103]
                description: mt8189 pull down PUPD/R0/R1 type define value.
              - enum: [200, 201, 202, 203, 204, 205, 206, 207]
                description: mt8189 pull down RSEL type define value.
              - enum: [75000, 5000]
                description: mt8189 pull down RSEL type si unit value(ohm).
            description: |
              For pull down type is normal, it don't need add RSEL & R1R0 define
              and resistance value.
              For pull down type is PUPD/R0/R1 type, it can add R1R0 define to
              set different resistance. It can support "MTK_PUPD_SET_R1R0_00" &
              "MTK_PUPD_SET_R1R0_01" & "MTK_PUPD_SET_R1R0_10" &
              "MTK_PUPD_SET_R1R0_11" define in mt8189.
              For pull down type is RSEL, it can add RSEL define & resistance
              value(ohm) to set different resistance by identifying property
              "mediatek,rsel-resistance-in-si-unit".
              It can support "MTK_PULL_SET_RSEL_000" & "MTK_PULL_SET_RSEL_001"
              & "MTK_PULL_SET_RSEL_010" & "MTK_PULL_SET_RSEL_011"
              & "MTK_PULL_SET_RSEL_100" & "MTK_PULL_SET_RSEL_101"
              & "MTK_PULL_SET_RSEL_110" & "MTK_PULL_SET_RSEL_111"
              define in mt8189. It can also support resistance value(ohm)
              "75000" & "5000" in mt8189.

              An example of using RSEL define:
              pincontroller {
                i2c0_pin {
                  pins {
                    pinmux = <PINMUX_GPIO8__FUNC_SDA0>;
                    bias-pull-down = <MTK_PULL_SET_RSEL_001>;
                  }
                };
              };
              An example of using si unit resistance value(ohm):
              &pio {
                mediatek,rsel-resistance-in-si-unit;
              }
              pincontroller {
                i2c6_pin {
                  pins {
                    pinmux = <PINMUX_GPIO63__FUNC_SCL6>;
                    bias-pull-down = <75000>;
                  }
                };
              };

          bias-pull-up:
            oneOf:
              - type: boolean
              - enum: [100, 101, 102, 103]
                description: mt8189 pull up PUPD/R0/R1 type define value.
              - enum: [200, 201, 202, 203, 204, 205, 206, 207]
                description: mt8189 pull up RSEL type define value.
              - enum: [1000, 1500, 2000, 3000, 4000, 5000, 10000, 75000]
                description: mt8189 pull up RSEL type si unit value(ohm).
            description: |
              For pull up type is normal, it don't need add RSEL & R1R0 define
              and resistance value.
              For pull up type is PUPD/R0/R1 type, it can add R1R0 define to
              set different resistance. It can support "MTK_PUPD_SET_R1R0_00" &
              "MTK_PUPD_SET_R1R0_01" & "MTK_PUPD_SET_R1R0_10" &
              "MTK_PUPD_SET_R1R0_11" define in mt8189.
              For pull up type is RSEL, it can add RSEL define & resistance
              value(ohm) to set different resistance by identifying property
              "mediatek,rsel-resistance-in-si-unit".
              It can support "MTK_PULL_SET_RSEL_000" & "MTK_PULL_SET_RSEL_001"
              & "MTK_PULL_SET_RSEL_010" & "MTK_PULL_SET_RSEL_011"
              & "MTK_PULL_SET_RSEL_100" & "MTK_PULL_SET_RSEL_101"
              & "MTK_PULL_SET_RSEL_110" & "MTK_PULL_SET_RSEL_111"
              define in mt8189. It can also support resistance value(ohm) "1000"
              & "1500" & "2000" & "3000" & "4000" & "5000" & "10000" & "75000"
              in mt8189.
              An example of using RSEL define:
              pincontroller {
                i2c6-pins {
                  pins {
                    pinmux = <pinmux = <PINMUX_GPIO63__FUNC_SCL6>;
                    bias-pull-up = <MTK_PULL_SET_RSEL_001>;
                  }
                };
              };
              An example of using si unit resistance value(ohm):
              &pio {
                mediatek,rsel-resistance-in-si-unit;
              }
              pincontroller {
                i2c6-pins {
                  pins {
                    pinmux = <pinmux = <PINMUX_GPIO63__FUNC_SCL6>;
                    bias-pull-up = <1000>;
                  }
                };
              };

          bias-disable: true

          output-high: true

          output-low: true

          input-enable: true

          input-disable: true

          input-schmitt-enable: true

          input-schmitt-disable: true

        required:
          - pinmux

allOf:
  - $ref: pinctrl.yaml#

required:
  - compatible
  - reg
  - interrupt-controller
  - '#interrupt-cells'
  - gpio-controller
  - '#gpio-cells'
  - gpio-ranges

additionalProperties: false

examples:
  - |
    #include <dt-bindings/pinctrl/mt8189-pinfunc.h>
    #include <dt-bindings/interrupt-controller/arm-gic.h>

    soc {
      #address-cells = <2>;
      #size-cells = <2>;

      pio: pinctrl@10005000 {
        compatible = "mediatek,mt8189-pinctrl";
        reg = <0 0x10005000 0 0x1000>,
              <0 0x11b50000 0 0x1000>,
              <0 0x11c50000 0 0x1000>,
              <0 0x11c60000 0 0x1000>,
              <0 0x11d20000 0 0x1000>,
              <0 0x11d30000 0 0x1000>,
              <0 0x11d40000 0 0x1000>,
              <0 0x11e20000 0 0x1000>,
              <0 0x11e30000 0 0x1000>,
              <0 0x11f20000 0 0x1000>;
        reg-names = "gpio_base",
                    "iocfg_lm_base",
                    "iocfg_rb0_base",
                    "iocfg_rb1_base",
                    "iocfg_bm0_base",
                    "iocfg_bm1_base",
                    "iocfg_bm2_base",
                    "iocfg_lt0_base",
                    "iocfg_lt1_base",
                    "iocfg_rt_base";
        gpio-controller;
        #gpio-cells = <2>;
        gpio-ranges = <&pio 0 0 182>;
        interrupt-controller;
        #interrupt-cells = <2>;
      };
    };
```

## Documentation/devicetree/bindings/power/power_domain.txt
```
* Generic power domains

System on chip designs are often divided into multiple power domains that
can be used for power gating of selected IP blocks for power saving by
reduced leakage current.

This device tree binding can be used to bind power domain consumer devices
with their power domains provided by power domain providers. A power domain
provider can be represented by any node in the device tree and can provide
one or more power domains. A consumer node can refer to the provider by
a phandle and a set of phandle arguments (so called power domain specifier)
of length specified by #power-domain-cells property in the power domain
provider node.

==Power domain providers==

Required properties:
 - #power-domain-cells : Number of cells in a power domain specifier;
   Typically 0 for nodes representing a single power domain and 1 for nodes
   providing multiple power domains (e.g. power controllers), but can be
   any value as specified by device tree binding documentation of particular
   provider.

Example:

	power: power-controller@12340000 {
		compatible = "foo,power-controller";
		reg = <0x12340000 0x1000>;
		#power-domain-cells = <1>;
	};

The node above defines a power controller that is a power domain provider
and expects one cell as its phandle argument.

==Power domain consumers==

Required properties:
 - power-domains : A phandle and power domain specifier as defined by bindings
                   of power controller specified by phandle.

Example:

	leaky-device@12350000 {
		compatible = "foo,i-leak-current";
		reg = <0x12350000 0x1000>;
		power-domains = <&power 0>;
	};

The node above defines a typical power domain consumer device, which is located
inside power domain with index 0 of power controller represented by node with
label "power".
```

## Documentation/devicetree/bindings/regulator/max17135-regulator.txt
```
Maxim MAX17135 Voltage Regulator

The MAX17135 is a complete power-management IC for E-paper displays that
provides source- and gate-driver power supplies, a high-speed VCOM amplifier,
and a temperature sensor. It is interfaced to the host controller using an
i2c interface.

Required properties :
- compatible : "maxim,max17135"
- reg: Specifies the i2c slave address of the pmic block.
- vneg_pwrup: the timing for VNEG power up
- gvee_pwrup: the timing for GVEE power up
- vpos_pwrup: the timing for VPOS power up
- gvdd_pwrup: the timing for GVDD power up
- gvdd_pwrdn: the timing for GVDD power down
- vpos_pwrdn: the timing for VPOS power down
- gvee_pwrdn: the timing for GVEE power down
- vneg_pwrdn: the timing for VNEG power down
- gpio_pmic_pwrgood: gpio setting for EPDC_PWRSTAT
- gpio_pmic_vcom_ctrl: gpio setting for EPDC_VCOM
- gpio_pmic_wakeup: gpio setting for EPDC_PWRWAKEUP
- gpio_pmic_v3p3: gpio setting for EPDC_PWRCTRL0
- gpio_pmic_intr: gpio setting for EPDC_PWRINT

Optional properties :
- SENSOR-supply: the gpio regulator to control the supply for this chip


Regulators: The regulators of max17135 that have to be instantiated should be
included in a sub-node named 'regulators'. Regulator nodes included in this
sub-node should be of the format as listed below.

        regulator_name {
                standard regulator bindings here
        };

Example:
	max17135@48 {
		compatible = "maxim,max17135";
		reg = <0x48>;
		vneg_pwrup = <1>;
		gvee_pwrup = <1>;
		vpos_pwrup = <2>;
		gvdd_pwrup = <1>;
		gvdd_pwrdn = <1>;
		vpos_pwrdn = <2>;
		gvee_pwrdn = <1>;
		vneg_pwrdn = <1>;
		SENSOR-supply = <&reg_sensor>;
		gpio_pmic_pwrgood = <&gpio2 21 0>;
		gpio_pmic_vcom_ctrl = <&gpio3 17 0>;
		gpio_pmic_wakeup = <&gpio3 20 0>;
		gpio_pmic_v3p3 = <&gpio2 20 0>;
		gpio_pmic_intr = <&gpio2 25 0>;

		regulators {
			DISPLAY_reg: DISPLAY {
				regulator-name = "DISPLAY";
			};

			GVDD_reg: GVDD {
				regulator-name = "GVDD";
				regulator-min-microvolt = <20000000>;
				regulator-max-microvolt = <20000000>;
			};

			GVEE_reg: GVEE {
				regulator-name = "GVEE";
				/* 2's-compliment, -22000000 */
				regulator-min-microvolt = <0xfeb04e80>;
				regulator-max-microvolt = <0xfeb04e80>;
			};

			HVINN_reg: HVINN {
				regulator-name = "HVINN";
				/* 2's-compliment, -22000000 */
				regulator-min-microvolt = <0xfeb04e80>;
				regulator-max-microvolt = <0xfeb04e80>;
			};

			HVINP_reg: HVINP {
				regulator-name = "HVINP";
				regulator-min-microvolt = <20000000>;
				regulator-max-microvolt = <20000000>;
			};

			VCOM_reg: VCOM {
				regulator-name = "VCOM";
				/* 2's-compliment, -4325000 */
				regulator-min-microvolt = <0xffbe0178>;
				/* 2's-compliment, -500000 */
				regulator-max-microvolt = <0xfff85ee0>;
			};

			VNEG_reg: VNEG {
				regulator-name = "VNEG";
				/* 2's-compliment, -15000000 */
				regulator-min-microvolt = <0xff1b1e40>;
				regulator-max-microvolt = <0xff1b1e40>;
			};

			VPOS_reg: VPOS {
				regulator-name = "VPOS";
				regulator-min-microvolt = <15000000>;
				regulator-max-microvolt = <15000000>;
			};

			V3P3_reg: V3P3 {
				regulator-name = "V3P3";
			};
		};
	};
```
