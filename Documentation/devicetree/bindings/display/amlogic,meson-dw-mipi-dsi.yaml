## Documentation/devicetree/bindings/display/amlogic,meson-dw-mipi-dsi.yaml
```yaml
# SPDX-License-Identifier: (GPL-2.0 OR BSD-2-Clause)
# Copyright 2020 BayLibre, SAS
%YAML 1.2
---
$id: "http://devicetree.org/schemas/display/amlogic,meson-dw-mipi-dsi.yaml#"
$schema: "http://devicetree.org/meta-schemas/core.yaml#"

title: Amlogic specific extensions to the Synopsys Designware MIPI DSI Host Controller

maintainers:
  - Neil Armstrong <narmstrong@baylibre.com>

description: |
  The Amlogic Meson Synopsys Designware Integration is composed of
  - A Synopsys DesignWare MIPI DSI Host Controller IP
  - A TOP control block controlling the Clocks & Resets of the IP

allOf:
  - $ref: dsi-controller.yaml#

properties:
  compatible:
    enum:
      - amlogic,meson-axg-dw-mipi-dsi

  reg:
    maxItems: 1

  clocks:
    minItems: 2

  clock-names:
    minItems: 2
    items:
      - const: pclk
      - const: px_clk
      - const: meas_clk

  resets:
    minItems: 1

  reset-names:
    items:
      - const: top

  phys:
    minItems: 1

  phy-names:
    items:
      - const: dphy

  ports:
    type: object

    properties:
      port@0:
        type: object
        description: Input node to receive pixel data.
      port@1:
        type: object
        description: DSI output node to panel.

    required:
      - port@0
      - port@1

required:
  - compatible
  - reg
  - clocks
  - clock-names
  - resets
  - reset-names
  - phys
  - phy-names
  - ports

additionalProperties: false

examples:
  - |
    dsi@7000 {
          compatible = "amlogic,meson-axg-dw-mipi-dsi";
          reg = <0x6000 0x400>;
          resets = <&reset_top>;
          reset-names = "top";
          clocks = <&clk_pclk>, <&clk_px>;
          clock-names = "pclk", "px_clk";
          phys = <&mipi_dphy>;
          phy-names = "dphy";

          ports {
              #address-cells = <1>;
              #size-cells = <0>;

              /* VPU VENC Input */
              mipi_dsi_venc_port: port@0 {
                  reg = <0>;

                  mipi_dsi_in: endpoint {
                       remote-endpoint = <&dpi_out>;
                  };
              };

              /* DSI Output */
              mipi_dsi_panel_port: port@1 {
                  reg = <1>;

                  mipi_out_panel: endpoint {
                      remote-endpoint = <&mipi_in_panel>;
                  };
              };
          };
    };
```

## Documentation/devicetree/bindings/display/amlogic,meson-vpu.txt
```
Amlogic Meson Display Controller
================================

The Amlogic Meson Display controller is composed of several components
that are going to be documented below:

DMC|---------------VPU (Video Processing Unit)----------------|------HHI------|
   | vd1   _______     _____________    _________________     |               |
D  |-------|      |----|            |   |                |    |   HDMI PLL    |
D  | vd2   | VIU  |    | Video Post |   | Video Encoders |<---|-----VCLK      |
R  |-------|      |----| Processing |   |                |    |               |
   | osd2  |      |    |            |---| Enci ----------|----|-----VDAC------|
R  |-------| CSC  |----| Scalers    |   | Encp ----------|----|----HDMI-TX----|
A  | osd1  |      |    | Blenders   |   | Encl ----------|----|---------------|
M  |-------|______|----|____________|   |________________|    |               |
___|__________________________________________________________|_______________|


VIU: Video Input Unit
---------------------

The Video Input Unit is in charge of the pixel scanout from the DDR memory.
It fetches the frames addresses, stride and parameters from the "Canvas" memory.
This part is also in charge of the CSC (Colorspace Conversion).
It can handle 2 OSD Planes and 2 Video Planes.

VPP: Video Post Processing
--------------------------

The Video Post Processing is in charge of the scaling and blending of the
various planes into a single pixel stream.
There is a special "pre-blending" used by the video planes with a dedicated
scaler and a "post-blending" to merge with the OSD Planes.
The OSD planes also have a dedicated scaler for one of the OSD.

VENC: Video Encoders
--------------------

The VENC is composed of the multiple pixel encoders :
 - ENCI : Interlace Video encoder for CVBS and Interlace HDMI
 - ENCP : Progressive Video Encoder for HDMI
 - ENCL : LCD LVDS Encoder
The VENC Unit gets a Pixel Clocks (VCLK) from a dedicated HDMI PLL and clock
tree and provides the scanout clock to the VPP and VIU.
The ENCI is connected to a single VDAC for Composite Output.
The ENCI and ENCP are connected to an on-chip HDMI Transceiver.

Device Tree Bindings:
---------------------

VPU: Video Processing Unit
--------------------------

Required properties:
- compatible: value should be different for each SoC family as :
	- GXBB (S905) : "amlogic,meson-gxbb-vpu"
	- GXL (S905X, S905D) : "amlogic,meson-gxl-vpu"
	- GXM (S912) : "amlogic,meson-gxm-vpu"
	- TXL (T962X, T962E) : "amlogic,meson-txl-vpu"
	- TXLX (T962X, T962E) : "amlogic,meson-txlx-vpu"
	- AXG (A113G, A113D) : "amlogic,meson-axg-vpu"
	- G12A (S905D2) : "amlogic,meson-g12a-vpu"
	followed by the common "amlogic,meson-gx-vpu"
- reg: base address and size of he following memory-mapped regions :
	- vpu
	- hhi
	- dmc
- reg-names: should contain the names of the previous memory regions
- interrupts: should contain the VENC Vsync interrupt number

Required nodes:

The connections to the VPU output video ports are modeled using the OF graph
bindings specified in Documentation/devicetree/bindings/graph.txt.

The following table lists for each supported model the port number
corresponding to each VPU output.

		Port 0		Port 1
-----------------------------------------
 S905 (GXBB)	CVBS VDAC	HDMI-TX
 S905X (GXL)	CVBS VDAC	HDMI-TX
 S905D (GXL)	CVBS VDAC	HDMI-TX
 S912 (GXM)	CVBS VDAC	HDMI-TX

Example:

	drm_amhdmitx: drm-amhdmitx {
		status = "disabled";
		compatible = "amlogic,drm-amhdmitx";
		dev_name = "meson-amhdmitx";
		interrupts = <GIC_SPI 3 IRQ_TYPE_EDGE_RISING>;
		drm_feature = <1>;
		ports {
			port {
				#address-cells = <1>;
				#size-cells = <0>;
				hdmi_in_vpu: endpoint@0 {
					reg = <0>;
					remote-endpoint = <&vpu_out_hdmi>;
				};
			};
		};
	};

	drm_lcd: drm-lcd {
		status = "disabled";
		compatible = "amlogic,drm-lcd";
		dev_name = "meson-lcd";
		ports {
			port {
				#address-cells = <1>;
				#size-cells = <0>;
				lcd_in_vpu: endpoint@0 {
					reg = <0>;
					remote-endpoint = <&vpu_out_lcd>;
				};
			};
		};
	};

	drm_vpu: drm-vpu@0xff900000  {
		status = "disabled";
		compatible = "amlogic,meson-g12a-vpu";
		reg = <0x0 0xff900000 0x0 0x40000>,
			  <0x0 0xff63c000 0x0 0x2000>,
			  <0x0 0xff638000 0x0 0x2000>;
		reg-names = "base", "hhi", "dmc";
		interrupts = <GIC_SPI 3 IRQ_TYPE_EDGE_RISING>;
		dma-coherent;
		vpu_out: port {
			#address-cells = <1>;
			#size-cells = <0>;

			vpu_out_hdmi: endpoint@0 {
				reg = <0>;
				remote-endpoint = <&hdmi_in_vpu>;
			};
			vpu_out_lcd: endpoint@1 {
				reg = <1>;
				remote-endpoint = <&lcd_in_vpu>;
			};
		};
	};

	drm_subsystem: drm-subsystem {
		status = "okay";
		compatible = "amlogic,drm-subsystem";
		ports = <&vpu_out>;
	};
```

## Documentation/devicetree/bindings/display/mediatek/mediatek,cec2.yaml
```yaml
# SPDX-License-Identifier: (GPL-2.0-only OR BSD-2-Clause)
%YAML 1.2
---
$id: http://devicetree.org/schemas/display/mediatek/mediatek,cec2.yaml#
$schema: http://devicetree.org/meta-schemas/core.yaml#

title: MediaTek HDMI CEC v2 Controller

maintainers:
  - CK Hu <ck.hu@mediatek.com>
  - Jitao shi <jitao.shi@mediatek.com>

description: |
  The HDMI CEC controller handles hotplug detection and CEC communication.

properties:
  compatible:
    enum:
      - mediatek,cec2

  reg:
    maxItems: 1

  interrupts:
    maxItems: 1

  clocks:
    items:
      - description: CEC 66M H clock
      - description: CEC 66M B clock
      - description: HDMI 32K clock
      - description: HDMI 26M cloci

  clock-names:
    items:
      - const: cec_66m_h
      - const: cec_66m_b
      - const: hdmi_32k
      - const: hdmi_26m

  hdmi:
    maxItems: 1

required:
  - compatible
  - reg
  - interrupts
  - clocks
  - clock-names
  - hdmi

additionalProperties: false

examples:
  - |
    #include <dt-bindings/clock/mt8195-clk.h>
    #include <dt-bindings/interrupt-controller/arm-gic.h>
    #include <dt-bindings/interrupt-controller/irq.h>

    soc {
        #address-cells = <2>;
        #size-cells = <2>;

        cec: cec@10014000 {
            compatible = "mediatek,cec2";
            reg = <0 0x10014000 0 0x100>;
            interrupts = <GIC_SPI 680 IRQ_TYPE_LEVEL_HIGH 0>;
            clocks = <&infracfg_ao CLK_INFRA_AO_CEC_66M_H>,
                    <&infracfg_ao CLK_INFRA_AO_CEC_66M_B>,
                    <&infracfg_ao CLK_INFRA_AO_HDMI_32K>,
                    <&infracfg_ao CLK_INFRA_AO_HDMI_26M>;
            clock-names = "cec_66m_h",
                    "cec_66m_b",
                    "hdmi_32k",
                    "hdmi_26m";
            hdmi = <&hdmi0>;
        };
    };
...
```

## Documentation/devicetree/bindings/display/mediatek/mediatek,mt8195-hdmi-ddc.yaml
```yaml
# SPDX-License-Identifier: (GPL-2.0-only OR BSD-2-Clause)
%YAML 1.2
---
$id: http://devicetree.org/schemas/display/mediatek/mediatek,mt8195-hdmi-ddc.yaml#
$schema: http://devicetree.org/meta-schemas/core.yaml#

title: MediaTek HDMI Display Data Channel (DDC) v2

maintainers:
  - AngeloGioacchino Del Regno <angelogioacchino.delregno@collabora.com>
  - CK Hu <ck.hu@mediatek.com>

properties:
  compatible:
    oneOf:
      - const: mediatek,mt8195-hdmi-ddc
      - items:
          - const: mediatek,mt8188-hdmi-ddc
          - const: mediatek,mt8195-hdmi-ddc

  clocks:
    maxItems: 1

  clock-names:
    items:
      - const: ddc-i2c

  power-domains:
    maxItems: 1

required:
  - compatible
  - clocks
  - clock-names

additionalProperties: false

examples:
  - |
    hdmiddc0: ddc-i2c {
        compatible = "mediatek,mt8195-hdmi-ddc";
        clocks = <&clk26m>;
        clock-names = "ddc-i2c";
    };
...
```

## Documentation/devicetree/bindings/display/mediatek/mediatek,mt8195-hdmi.yaml
```yaml
# SPDX-License-Identifier: (GPL-2.0-only OR BSD-2-Clause)
%YAML 1.2
---
$id: http://devicetree.org/schemas/display/mediatek/mediatek,mt8195-hdmi.yaml#
$schema: http://devicetree.org/meta-schemas/core.yaml#

title: MediaTek HDMI-TX v2 Encoder

maintainers:
  - AngeloGioacchino Del Regno <angelogioacchino.delregno@collabora.com>
  - CK Hu <ck.hu@mediatek.com>

description: |
  The MediaTek HDMI-TX v2 encoder can generate HDMI format data based on
  the HDMI Specification 2.0b.

properties:
  compatible:
    enum:
      - mediatek,mt8188-hdmi
      - mediatek,mt8195-hdmi

  reg:
    maxItems: 1

  interrupts:
    maxItems: 1

  clocks:
    items:
      - description: HDMI APB clock
      - description: HDCP top clock parent
      - description: HDCP top clock
      - description: HDCP reference clock
      - description: VPP HDMI Split clock

  clock-names:
    items:
      - const: bus
      - const: hdcp-parent
      - const: hdcp
      - const: hdcp24m
      - const: hdmi-split

  phys:
    maxItems: 1

  phy-names:
    items:
      - const: hdmi

  pinctrl-0: true

  pinctrl-names:
    items:
      - const: default

  power-domains:
    maxItems: 1

  ddc-i2c-bus:
    maxItems: 1

  ports:
    $ref: /schemas/graph.yaml#/properties/ports

    properties:
      port@0:
        $ref: /schemas/graph.yaml#/properties/port
        description:
          Input port, usually connected to the output port of a DPI

    required:
      - port@0

required:
  - compatible
  - reg
  - clocks
  - clock-names
  - interrupts
  - power-domains
  - phys
  - phy-names
  - ports

additionalProperties: false

examples:
  - |
    #include <dt-bindings/clock/mt8195-clk.h>
    #include <dt-bindings/interrupt-controller/arm-gic.h>
    #include <dt-bindings/power/mt8195-power.h>

    soc {
        #address-cells = <2>;
        #size-cells = <2>;

        hdmi-tx@1c300000 {
            compatible = "mediatek,mt8195-hdmi-tx";
            reg = <0 0x1c300000 0 0x1000>;
            clocks = <&topckgen CLK_TOP_HDMI_APB>,
                     <&topckgen CLK_TOP_HDCP>,
                     <&topckgen CLK_TOP_HDCP_24M>,
                     <&vppsys1 CLK_VPP1_VPP_SPLIT_HDMI>;
            clock-names = "bus", "hdcp", "hdcp24m", "hdmi-split";
            interrupts = <GIC_SPI 677 IRQ_TYPE_LEVEL_HIGH 0>;
            phys = <&hdmi_phy>;
            phy-names = "hdmi";
            power-domains = <&spm MT8195_POWER_DOMAIN_HDMI_TX>;
            pinctrl-names = "default";
            pinctrl-0 = <&hdmi_pins>;
            ddc-i2c-bus = <&hdmiddc0>;
            #sound-dai-cells = <0>;

            ports {
                #address-cells = <1>;
                #size-cells = <0>;

                port@0 {
                    reg = <0>;

                    hdmi_in: endpoint {
                        remote-endpoint = <&dpi1_out>;
                    };
                };
            };
        };
    };
```

## Documentation/devicetree/bindings/display/mediatek/mediatek,padding.yaml
```yaml
# SPDX-License-Identifier: (GPL-2.0-only OR BSD-2-Clause)
%YAML 1.2
---
$id: http://devicetree.org/schemas/display/mediatek/mediatek,rdma.yaml#
$schema: http://devicetree.org/meta-schemas/core.yaml#

title: MediaTek Padding

maintainers:
  - Chun-Kuang Hu <chunkuang.hu@kernel.org>
  - Philipp Zabel <p.zabel@pengutronix.de>

description: |
  MediaTek Padding component is designed to add right and bottom padding
  to a picture. For example, given a 480x480 picture, by adding 50 pixel
  and 100 pixel to right and bottom padding, the picture size will become
  530x580. Additionally, the background color of paddings can be configured
  in RGB format.

properties:
  compatible:
    oneOf:
      - items:
        - const: mediatek,mt8188-vdo1-padding

  reg:
    maxItems: 1

  power-domains:
    description: A phandle and PM domain specifier as defined by bindings of
      the power controller specified by phandle. See
      Documentation/devicetree/bindings/power/power-domain.yaml for details.

  clocks:
    items:
      - description: RDMA Clock

  mediatek,gce-client-reg:
    description: The register of client driver can be configured by gce with
      4 arguments defined in this property, such as phandle of gce, subsys id,
      register offset and size. Each GCE subsys id is mapping to a client
      defined in the header include/dt-bindings/gce/<chip>-gce.h.
    $ref: /schemas/types.yaml#/definitions/phandle-array
    maxItems: 1

required:
  - compatible
  - reg
  - power-domains
  - clocks

additionalProperties: false

examples:
  - |
    #include <dt-bindings/interrupt-controller/arm-gic.h>
    #include <dt-bindings/clock/mt8188-clk.h>
    #include <dt-bindings/power/mt8188-power.h>
    #include <dt-bindings/gce/mt8188-gce.h>
    #include <dt-bindings/memory/mt8188-larb-port.h>

    soc {
        #address-cells = <2>;
        #size-cells = <2>;

        vdo1_padding0: vdo1_padding0@1c11d000 {
            compatible = "mediatek,mt8188-vdo1-padding";
            reg = <0 0x1c11d000 0 0x1000>;
            clocks = <&vdosys1 CLK_VDO1_PADDING0>;
            power-domains = <&spm MT8188_POWER_DOMAIN_VDOSYS1>;
            mediatek,gce-client-reg = <&gce0 SUBSYS_1c11XXXX 0xd000 0x1000>;
        };
    };
```
