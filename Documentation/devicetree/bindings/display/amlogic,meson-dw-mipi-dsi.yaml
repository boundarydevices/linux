## Documentation/devicetree/bindings/iio/adc/mediatek-mt635x-auxadc.yaml
```yaml
# SPDX-License-Identifier: (GPL-2.0 OR BSD-2-Clause)
%YAML 1.2
---
$id: http://devicetree.org/schemas/iio/adc/mediatek-mt635x-auxadc.yaml#
$schema: http://devicetree.org/meta-schemas/core.yaml#

title: MediaTek mt635x-auxadc

maintainers:
  - Kevin.Shen <Kevin.Shen@mediatek.com>

description: |
  This binding is intended to represent mt635x-auxadc which is found in most MediaTek SOCs.


properties:
  compatible:
    enum:
      - mediatek,mt6359p-auxadc

additionalProperties: false
```

## Documentation/devicetree/bindings/input/mtk-kpd.yaml
```yaml
# SPDX-License-Identifier: GPL-2.0
%YAML 1.2
---
version: 1

$id: http://devicetree.org/schemas/input/mtk-keypad.yaml#
$schema: http://devicetree.org/meta-schemas/core.yaml#

title: Mediatek's Keypad Controller device tree bindings

maintainer:
  - Fengping Yu <fengping.yu@mediatek.com>

description: |
  Mediatek's Keypad controller is used to interface a SoC with a matrix-type
  keypad device. The keypad controller supports multiple row and column lines.
  A key can be placed at each intersection of a unique row and a unique column.
  The keypad controller can sense a key-press and key-release and report the
  event using a interrupt to the cpu.

properties:
  compatible:
    oneOf:
      - const: "mediatek,mt6779-keypad"
      - const: "mediatek,mt6873-keypad"

  clock-names:
    description: Names of the clocks listed in clocks property in the same order
    maxItems: 1

  clocks:
    description: Must contain one entry, for the module clock
    refs: devicetree/bindings/clocks/clock-bindings.txt for details.

  interrupts:
    description: A single interrupt specifier
    maxItems: 1

  linux,keymap:
    description: The keymap for keys as described in the binding document
    refs: devicetree/bindings/input/matrix-keymap.txt
    minItems: 1
    maxItems: 16

  pinctrl-0:
    description: Specify pin control groups used for this controller
    refs: devicetree/bindings/pinctrl/pinctrl-bindings.txt

  pinctrl-names:
    description: Names for optional pin modes
    maxItems: 1

  reg:
    description: The base address of the Keypad register bank
    maxItems: 1

  wakeup-source:
    description: use any event on keypad as wakeup event
    type: boolean

  keypad,num-columns:
    description: Number of column lines connected to the keypad controller,
    it is not equal to PCB columns number, instead you should add required value
    for each IC

  keypad,num-rows:
    description: Number of row lines connected to the keypad controller, it is
    not equal to PCB rows number, instead you should add required value for each IC

  mediatek,debounce-us:
    description: Debounce interval in microseconds, if not specified, the default
    value is 16000
    maximum: 256000

  mediatek,double-keys:
    description: use double key matrix instead of single key
    type: boolean

required:
  - compatible
  - reg
  - interrupts
  - linux,keymap
  - pinctrl
  - clocks
  - clock-names

examples:
  - |

  keypad: kp@10010000 {
    compatible = "mediatek,mt6779-keypad";
    reg = <0 0x10010000 0 0x1000>;
    linux,keymap = < MATRIX_KEY(0x00, 0x00, KEY_VOLUMEDOWN) >;
    interrupts = <GIC_SPI 75 IRQ_TYPE_EDGE_FALLING>;
    clocks = <&clk26m>;
    clock-names = "kpd";
    pinctrl-names = "default";
    pinctrl-0 = <&kpd_gpios_def_cfg>;
  };
```

## Documentation/devicetree/bindings/input/touchscreen/amlogic-ts.txt
```
* Focaltech FT3x27 series touchscreen controller

Required properties:
 - compatible: Should be "focaltech,fts"
 - reg: I2C address of the chip. Should be 0x38
 - irq-gpio: GPIO pin used for IRQ
 - reset-gpio: GPIO pin used for reset
 - x_max: horizontal resolution
 - y_max: vertical resolution
 - max-touch-number: the max touch fingers support

Example:
	i2c1: i2c@1e000 {
		/* ... */

		focaltech_ts@0x38 {
			compatible = "focaltech,fts";
			status = "okay";
			reg = <0x38>;
			reset-gpio = <&gpio GPIOZ_2 0x00>;
			irq-gpio = <&gpio GPIOZ_3 0x00>;
			x_max = <600>;
			y_max = <1024>;
			max-touch-number = <10>;
		};

		/* ... */
	};
```

## Documentation/devicetree/bindings/input/touchscreen/goodix.txt
```
Device tree bindings for Goodix GT9xx series touchscreen controller

Required properties:

 - compatible		: Should be "goodix,gt911"
				 or "goodix,gt9110"
				 or "goodix,gt912"
				 or "goodix,gt927"
				 or "goodix,gt9271"
				 or "goodix,gt928"
				 or "goodix,gt967"
 - reg			: I2C address of the chip. Should be 0x5d or 0x14
 - interrupt-parent	: Interrupt controller to which the chip is connected
 - interrupts		: Interrupt to which the chip is connected
 - gpios		: GPIOS the chip is connected to: first one is the
			  interrupt gpio and second one the reset gpio.
Optional properties:

 - esd-recovery-timeout-ms : ESD poll time (in milli seconds) for the driver to
                            check if ESD occurred and in that case reset the
                            device. ESD is disabled if this property is not set
                            or is set to 0.

Example:

	i2c@00000000 {
		/* ... */

		gt928@5d {
			compatible = "goodix,gt928";
			reg = <0x5d>;
			interrupt-parent = <&gpio>;
			interrupts = <0 0>;

			gpios = <&gpio1 0 0>, /* INT */
				<&gpio1 1 0>; /* RST */
		};

		/* ... */
	};
```

## Documentation/devicetree/bindings/input/touchscreen/hyn,cst226.txt
```
* Neonode infrared touchscreen controller

Required properties:
- compatible: must be "hyn,cst226"
- reg: I2C address of the chip
- interrupts: interrupt to which the chip is connected
- reset-gpios: reset gpio the chip is connected to
- x-size: horizontal resolution of touchscreen
- y-size: vertical resolution of touchscreen

Optional properties:
- irq-gpios : interrupt gpio the chip is connected to
- vdd-supply: Regulator controlling the controller supply

Example:

	i2c@00000000 {
		/* ... */

	hyn@1A {
		compatible = "hyn,cst226";
		status = "okay";
		reg = <0x1a>;
		reset-gpio = <&gpio GPIOA_5 0x00>;
		irq-gpio = <&gpio GPIOA_6 0x00>;
	};

		/* ... */
	};
```

## Documentation/devicetree/bindings/input/touchscreen/imx6ul_tsc.txt
```
* Freescale i.MX6UL Touch Controller

Required properties:
- compatible: must be "fsl,imx6ul-tsc"

Example:
	&tsc {
		pinctrl-names = "default";
		pinctrl-0 = <&pinctrl_tsc>;
		status = "okay";
		xnur-gpio = <&gpio1 3 0>;
		measure_delay_time = <0xfff>;
		pre_charge_time = <0xffff>;
	};
```

## Documentation/devicetree/bindings/is31fl3236a.txt
```
is31fl3236a: is31f3236a@0x78 {
			compatible = "issi,is31fl3236,gva";
			reg = <0x3c>;
			status = "okay";
			led1_b {
				label="LED1_B";
				reg_offset = <1>;
			};
			led1_g {
				label="LED1_G";
				reg_offset = <2>;
			};
			led1_r {
				label="LED1_R";
				reg_offset = <3>;
			};
			led2_b {
				label="LED2_B";
				reg_offset = <4>;
			};
			led2_g {
				label="LED2_G";
				reg_offset = <5>;
			};
			led2_r {
				label="LED2_R";
				reg_offset = <6>;
			};
			led3_b {
				label="LED3_B";
				reg_offset = <7>;
			};
			led3_g {
				label="LED3_G";
				reg_offset = <8>;
			};
			led3_r {
				label="LED3_R";
				reg_offset = <9>;
			};
			led4_b {
				label="LED4_B";
				reg_offset = <10>;
			};
			led4_g {
				label="LED4_G";
				reg_offset = <11>;
			};
			led4_r {
				label="LED4_R";
				reg_offset = <12>;
			};
	 };
```

## Documentation/devicetree/bindings/media/i2c/onnn,ar0430.yaml
```yaml
# SPDX-License-Identifier: (GPL-2.0-only OR BSD-2-Clause)
%YAML 1.2
---
$id: http://devicetree.org/schemas/media/i2c/onnn,ar0430.yaml#
$schema: http://devicetree.org/meta-schemas/core.yaml#

title: ON Semiconductor AR0430 MIPI CSI-2 sensor

maintainers:
  - Suhrid Subramaniam <suhrid.subramaniam@mediatek.com>

description: |-
  The AR0430 is a raw CMOS image sensor with MIPI CSI-2 and
  I2C-compatible control interface.

properties:
  compatible:
    const: onnn,ar0430

  reg:
    maxItems: 1

  clocks:
    maxItems: 1

  assigned-clocks:
    maxItems: 1

  assigned-clock-parents:
    maxItems: 1

  clock-frequency: true

  vaa-supply:
    description:
      Definition of the regulator used as analog (2.8 V) voltage supply.

  vddio-supply:
    description:
      Definition of the regulator used as digital I/O (1.8 V) voltage supply.

  vdd-supply:
    description:
      Definition of the regulator used as digital core (1.0 V) voltage supply.

  reset-gpios:
    description: reset GPIO, usually active low
    maxItems: 1

  port:
    $ref: /schemas/graph.yaml#/$defs/port-base
    unevaluatedProperties: false
    description: |
      Video output port.

    properties:
      endpoint:
        $ref: /schemas/media/video-interfaces.yaml#
        unevaluatedProperties: false

        properties:
          data-lanes:
            anyOf:
              - items:
                  - const: 1
              - items:
                  - const: 1
                  - const: 2
              - items:
                  - const: 1
                  - const: 2
                  - const: 3
                  - const: 4

required:
  - compatible
  - reg
  - clocks
  - assigned-clocks
  - assigned-clock-parents
  - clock-frequency
  - vaa-supply
  - vdd-supply
  - vddio-supply
  - port

additionalProperties: false

examples:
  - |
    #include <dt-bindings/clock/mediatek,mt8188-clk.h>
    #include <dt-bindings/gpio/gpio.h>

    i2c {
        #address-cells = <1>;
        #size-cells = <0>;

        ar0430: camera-sensor@36 {
            compatible = "onnn,ar0430";
            reg = <0x36>;
            pinctrl-names = "default";
            pinctrl-0 = <&cam0_pins_default>;
            clocks = <&topckgen CLK_TOP_CAMTG_SEL>;
            assigned-clocks = <&topckgen CLK_TOP_CAMTG_SEL>;
            assigned-clock-parents = <&topckgen CLK_TOP_USB20_192M_D8>;
            clock-frequency = <24000000>;
            reset-gpios = <&pio 106 GPIO_ACTIVE_LOW>;
            vaa-supply =   <&vcama_reg>;
            vddio-supply = <&cam0_pdn>;
            vdd-supply =   <&vcamd_reg>;

            port {
                ar0430_1_endpoint: endpoint {
                    remote-endpoint = <&seninf_in1>;
                    data-lanes = <1 2 3 4>;
                };
            };
        };
    };
```

## Documentation/devicetree/bindings/media/mediatek,mdp3-color.yaml
```yaml
# SPDX-License-Identifier: (GPL-2.0-only OR BSD-2-Clause)
%YAML 1.2
---
$id: http://devicetree.org/schemas/media/mediatek,mdp3-color.yaml#
$schema: http://devicetree.org/meta-schemas/core.yaml#

title: MediaTek Media Data Path 3 COLOR Device Tree Bindings

maintainers:
  - Matthias Brugger <matthias.bgg@gmail.com>
  - Moudy Ho <moudy.ho@mediatek.com>

description: |
  One of Media Data Path 3 (MDP3) components used to adjust hue, luma and
  saturation to get better picture quality.

properties:
  compatible:
    enum:
      - mediatek,mt8195-mdp3-color

  reg:
    maxItems: 1

  mediatek,gce-client-reg:
    $ref: /schemas/types.yaml#/definitions/phandle-array
    items:
      items:
        - description: phandle of GCE
        - description: GCE subsys id
        - description: register offset
        - description: register size
    description: The register of client driver can be configured by gce with
      4 arguments defined in this property. Each GCE subsys id is mapping to
      a client defined in the header include/dt-bindings/gce/<chip>-gce.h.

  clocks:
    minItems: 1

  power-domains:
    maxItems: 1

required:
  - compatible
  - reg
  - mediatek,gce-client-reg
  - clocks
  - power-domains

additionalProperties: false

examples:
  - |
    #include <dt-bindings/clock/mt8195-clk.h>
    #include <dt-bindings/gce/mt8195-gce.h>
    #include <dt-bindings/power/mt8195-power.h>

    mdp3-color0@14008000 {
      compatible = "mediatek,mt8195-mdp3-color";
      reg = <0x14008000 0x1000>;
      mediatek,gce-client-reg = <&gce1 SUBSYS_1400XXXX 0x8000 0x1000>;
      clocks = <&vppsys0 CLK_VPP0_MDP_COLOR>;
      power-domains = <&spm MT8195_POWER_DOMAIN_VPPSYS0>;
    };
```

## Documentation/devicetree/bindings/media/mediatek,mdp3-hdr.yaml
```yaml
# SPDX-License-Identifier: (GPL-2.0-only OR BSD-2-Clause)
%YAML 1.2
---
$id: http://devicetree.org/schemas/media/mediatek,mdp3-hdr.yaml#
$schema: http://devicetree.org/meta-schemas/core.yaml#

title: MediaTek Media Data Path 3 HDR Device Tree Bindings

maintainers:
  - Matthias Brugger <matthias.bgg@gmail.com>
  - Moudy Ho <moudy.ho@mediatek.com>

description: |
  One of Media Data Path 3 (MDP3) components used to perform HDR to SDR

properties:
  compatible:
    enum:
      - mediatek,mt8195-mdp3-hdr

  reg:
    maxItems: 1

  mediatek,gce-client-reg:
    $ref: /schemas/types.yaml#/definitions/phandle-array
    items:
      items:
        - description: phandle of GCE
        - description: GCE subsys id
        - description: register offset
        - description: register size
    description: The register of client driver can be configured by gce with
      4 arguments defined in this property. Each GCE subsys id is mapping to
      a client defined in the header include/dt-bindings/gce/<chip>-gce.h.

  clocks:
    minItems: 1

  power-domains:
    maxItems: 1

required:
  - compatible
  - reg
  - mediatek,gce-client-reg
  - clocks
  - power-domains

additionalProperties: false

examples:
  - |
    #include <dt-bindings/clock/mt8195-clk.h>
    #include <dt-bindings/gce/mt8195-gce.h>
    #include <dt-bindings/power/mt8195-power.h>

    mdp3-hdr0@14004000 {
      compatible = "mediatek,mt8195-mdp3-hdr";
      reg = <0x14004000 0x1000>;
      mediatek,gce-client-reg = <&gce1 SUBSYS_1400XXXX 0x4000 0x1000>;
      clocks = <&vppsys0 CLK_VPP0_MDP_HDR>;
      power-domains = <&spm MT8195_POWER_DOMAIN_VPPSYS0>;
    };
```

## Documentation/devicetree/bindings/media/mediatek,mdp3-merge.yaml
```yaml
# SPDX-License-Identifier: (GPL-2.0-only OR BSD-2-Clause)
%YAML 1.2
---
$id: http://devicetree.org/schemas/media/mediatek,mdp3-merge.yaml#
$schema: http://devicetree.org/meta-schemas/core.yaml#

title: MediaTek Media Data Path 3 MERGE Device Tree Bindings

maintainers:
  - Matthias Brugger <matthias.bgg@gmail.com>
  - Moudy Ho <moudy.ho@mediatek.com>

description: |
  One of Media Data Path 3 (MDP3) components used to merge
  two slice-per-line inputs into one side-by-side output.

properties:
  compatible:
    enum:
      - mediatek,mt8195-mdp3-merge

  reg:
    maxItems: 1

  mediatek,gce-client-reg:
    $ref: /schemas/types.yaml#/definitions/phandle-array
    items:
      items:
        - description: phandle of GCE
        - description: GCE subsys id
        - description: register offset
        - description: register size
    description: The register of client driver can be configured by gce with
      4 arguments defined in this property. Each GCE subsys id is mapping to
      a client defined in the header include/dt-bindings/gce/<chip>-gce.h.

  clocks:
    minItems: 1

  power-domains:
    maxItems: 1

required:
  - compatible
  - reg
  - mediatek,gce-client-reg
  - clocks
  - power-domains

additionalProperties: false

examples:
  - |
    #include <dt-bindings/clock/mt8195-clk.h>
    #include <dt-bindings/gce/mt8195-gce.h>
    #include <dt-bindings/power/mt8195-power.h>

    mdp3-merge0@14f1a000 {
      compatible = "mediatek,mt8195-mdp3-merge";
      reg = <0x14f1a000 0x1000>;
      mediatek,gce-client-reg = <&gce1 SUBSYS_14f1XXXX 0xa000 0x1000>;
      clocks = <&vppsys1 CLK_VPP1_SVPP2_VPP_MERGE>;
      power-domains = <&spm MT8195_POWER_DOMAIN_VPPSYS1>;
    };
```
