## Documentation/devicetree/bindings/display/panel/startek,kd070fhfid078.yaml
```yaml
# SPDX-License-Identifier: GPL-2.0-only OR BSD-2-Clause
%YAML 1.2
---
$id: http://devicetree.org/schemas/display/panel/startek,kd070fhfid078.yaml#
$schema: http://devicetree.org/meta-schemas/core.yaml#

title: Startek Electronic Technology Co. kd070fhfid078 7 inch TFT LCD panel

maintainers:
  - Tommy Chen <tommyyl.chen@mediatek.com>

allOf:
  - $ref: panel-common.yaml#

properties:
  compatible:
    const: startek,kd070fhfid078

  enable-gpios: true

  iovcc-supply:
    description: Reference to the regulator powering the panel IO pins.

  reg:
    maxItems: 1
    description: DSI virtual channel

  reset-gpios: true

  port: true

  power-supply: true

additionalProperties: false

required:
  - compatible
  - enable-gpios
  - iovcc-supply
  - reg
  - reset-gpios
  - port
  - power-supply

examples:
  - |
    #include <dt-bindings/gpio/gpio.h>

    dsi0 {
        #address-cells = <1>;
        #size-cells = <0>;

        panel@0 {
            compatible = "startek,kd070fhfid078";
            reg = <0>;
            backlight = <&backlight_lcd0>;
            reset-gpios = <&pio 108 GPIO_ACTIVE_HIGH>;
            dcdc-gpios = <&pio 48 GPIO_ACTIVE_HIGH>;
            iovcc-supply = <&mt6360_ldo2>;
            pp3300-supply = <&mt6360_ldo1>;

            port {
                panel_in: endpoint {
                    remote-endpoint = <&dsi_out>;
                };
            };
        };
    };

...
```

## Documentation/devicetree/bindings/dsp/mediatek,mt8365-dsp.yaml
```yaml
# SPDX-License-Identifier: (GPL-2.0 OR BSD-2-Clause)
%YAML 1.2
---
$id: http://devicetree.org/schemas/dsp/mediatek,mt8365-dsp.yaml#
$schema: http://devicetree.org/meta-schemas/core.yaml#

title: MediaTek mt8365 DSP core

maintainers:
  - Aary Patil <aary.patil@mediatek.com>

description: |
  MediaTek mt8365 SoC contains a DSP core used for
  advanced pre- and post- audio processing.

properties:
  compatible:
    const: mediatek,mt8365-dsp

  reg:
    items:
      - description: Address and size of the DSP config registers

  reg-names:
    items:
      - const: cfg

  clocks:
    items:
      - description: mux for audio dsp clock
      - description: 26M clock
      - description: mux for audio dsp local bus
      - description: default audio dsp local bus clock source
      - description: default audio dsp local bus clock D2
      - description: default audio dsp local bus clock D4
      - description: default audio dsp local bus clock D8
      - description: power domain audio dsp clock 26M
      - description: power domain audio dsp clock 32K

  clock-names:
    items:
      - const: CLK_DSP_SEL
      - const: CLK26M_CK
      - const: AD_SYS_26M_D2
      - const: DSPPLL_CK
      - const: DSPPLL_D2
      - const: DSPPLL_D4
      - const: DSPPLL_D8
      - const: PDN_DSP_26M
      - const: PDN_DSP_32K

  interrupts:
    description: Interrupts for the DSP

  power-domains:
    maxItems: 1

  memory-region:
    items:
      - description: dma buffer between host and DSP.
      - description: DSP system memory.
      - description: SRAM memory.

required:
  - compatible
  - reg
  - reg-names
  - interrupts
  - power-domains
  - clocks
  - clock-names

additionalProperties: false

examples:
  - |
    #include <dt-bindings/clock/mediatek,mt8365-clk.h>
    #include <dt-bindings/interrupt-controller/arm-gic.h>
    #include <dt-bindings/power/mediatek,mt8365-power.h>
    adsp@1d062000 {
        compatible = "mediatek,mt8365-dsp";
        reg = <0x1d062000 0x01000>; /* DSPCFG reg */
        reg-names = "cfg"; /* config shared-dram size from reserve-mem */
        interrupts = <GIC_SPI 208 IRQ_TYPE_LEVEL_HIGH>, /* ADSP IPI NOTIFY IRQ */
                     <GIC_SPI 53 IRQ_TYPE_LEVEL_LOW>; /* dsp_wdt IRQ */
        power-domains = <&spm MT8365_POWER_DOMAIN_DSP>;
        clocks =
            <&topckgen CLK_TOP_DSP_SEL>,
            <&topckgen CLK_TOP_CLK26M_D52>,
            <&topckgen CLK_TOP_SYS_26M_D2>,
            <&topckgen CLK_TOP_DSPPLL>,
            <&topckgen CLK_TOP_DSPPLL_D2>,
            <&topckgen CLK_TOP_DSPPLL_D4>,
            <&topckgen CLK_TOP_DSPPLL_D8>,
            <&topckgen CLK_TOP_DSP_26M>,
            <&topckgen CLK_TOP_DSP_32K>;
        clock-names =
            "CLK_DSP_SEL",
            "CLK26M_CK",
            "AD_SYS_26M_D2",
            "DSPPLL_CK",
            "DSPPLL_D2",
            "DSPPLL_D4",
            "DSPPLL_D8",
            "PDN_DSP_26M",
            "PDN_DSP_32K";
    };
```

## Documentation/devicetree/bindings/fb/fsl_epdc_fb.txt
```
* Freescale MXC Electrophoretic Display Controller (EPDC)

Required properties:
- compatible: Should be "fsl,<chip>-epdc".  Supported chips include
  imx6dl and imx6sl
- reg: Address and length of the register set for EPDC
- interrupts: Should contain EPDC interrupts
- clocks: the clocks for EPDC
- pinctrl-names: should be "default"
- pinctrl-0: should be pinctrl_ipu1_1 or pinctrl_ipu2_1, which depends on the
  IPU connected.
- V3P3_supply: power supply for EPDC_PWRCTRL0 from pmic
- VCOM_supply: power supply for EPDC_VCOM0 from pmic
- DISPLAY_supply: power supply enable for pmic

Examples:

imx6_epdc@0x020f8000 {
	compatible = "fsl,imx6dl-epdc";
	reg = <0x020f8000 4000>;
	interrupts = <0 97 0x04>;
	clocks = <&clks 133>, <&clks 137>;  /* ipu2, ipu2_di1 */
	clock-names = "epdc-axi", "epdc-pix";
	pinctrl-names = "default";
	pinctrl-0 = <&pinctrl_epdc_0>;
	V3P3_supply = <&V3P3_reg>;
	VCOM_supply = <&VCOM_reg>;
	DISPLAY_supply = <&DISPLAY_reg>;
	status = "disabled";
};
```

## Documentation/devicetree/bindings/fb/fsl_ipuv3_fb.txt
```
* FSL IPUv3 Display/FB

The FSL IPUv3 is Image Processing Unit version 3, a part of video and graphics
subsystem in an application processor. The goal of the IPU is to provide
comprehensive support for the flow of data from an image sensor or/and to a
display device.

Two IPU units are on the imx6q SOC while only one IPU unit on the imx6dl SOC.
Each IPU unit has two display interfaces.

For LDB/LVDS panel, there are two LVDS channels(LVDS0 and LVDS1) which can
transfer video data, these two channels can be used as
split/dual/single/separate mode.
-split mode means display data from DI0 or DI1 will send to both channels
 LVDS0+LVDS1.
-dual mode means display data from DI0 or DI1 will be duplicated on LVDS0
 and LVDS1, it said, LVDS0 and LVDS1 has the same content.
-single mode means only work for DI0/DI1->LVDS0 or DI0/DI1->LVDS1.
-separate mode means you can make DI0/DI1->LVDS0 and DI0/DI1->LVDS1 work
 at the same time.
 "ldb=spl0/1"	--      split mode on DI0/1
 "ldb=dul0/1"	--      dual mode on DI0/1
 "ldb=sin0/1"	--      single mode on LVDS0/1
 "ldb=sep0/1"	--      separate mode begin from LVDS0/1

Required properties for IPU:
- bypass_reset :Bypass reset to avoid display channel being.
  stopped by probe since it may start to work in bootloader: 0 or 1.
- compatible : should be "fsl,imx6q-ipu".
- reg : the register address range.
- interrupts : the error and sync interrupts request.
- clocks : the clock sources that it depends on.
- clock-names:  the related clock names.
- resets : IPU reset specifier.  See reset.txt and fsl,imx-src.txt in
  Documentation/devicetree/bindings/reset/ for details.

Required properties for fb:
- compatible : should be "fsl,mxc_sdc_fb".
- disp_dev : display device: "ldb", "lcd", "hdmi", "mipi_dsi".
- mode_str : video mode string: "LDB-XGA" or "LDB-1080P60" for ldb,
  "CLAA-WVGA" for lcd, "TRULY-WVGA" for TRULY mipi_dsi lcd panel,
  "1920x1080M@60" for hdmi.
- default_bpp : default bits per pixel: 8/16/24/32
- int_clk : use internal clock as pixel clock: 0 or 1
- late_init : to avoid display channel being re-initialized
  as we've probably setup the channel in bootloader: 0 or 1
- interface_pix_fmt : display interface pixel format as below:
	RGB666		IPU_PIX_FMT_RGB666
	RGB565		IPU_PIX_FMT_RGB565
	RGB24		IPU_PIX_FMT_RGB24
	BGR24		IPU_PIX_FMT_BGR24
	GBR24		IPU_PIX_FMT_GBR24
	YUV444		IPU_PIX_FMT_YUV444
	LVDS666		IPU_PIX_FMT_LVDS666
	YUYV		IPU_PIX_FMT_YUYV
	UYVY		IPU_PIX_FMT_UYVY
	YVYV		IPU_PIX_FMT_YVYU
	VYUY		IPU_PIX_FMT_VYUY

Required properties for display:
- compatible : should be "fsl,lcd" for lcd panel, "fsl,imx6q-ldb" for ldb
- reg : the register address range if necessary to have.
- interrupts : the error and sync interrupts if necessary to have.
- clocks : the clock sources that it depends on if necessary to have.
- clock-names: the related clock names if necessary to have.
- ipu_id : ipu id for the first display device: 0 or 1
- disp_id : display interface id for the first display interface: 0 or 1
- default_ifmt : save as above display interface pixel format for lcd
- pinctrl-names : should be "default"
- pinctrl-0 : should be pinctrl_ipu1_1 or pinctrl_ipu2_1, which depends on the
  IPU connected.
- sec_ipu_id : secondary ipu id for the second display device(ldb only): 0 or 1
- sec_disp_id : secondary display interface id for the second display
  device(ldb only): 0 or 1
- ext_ref : reference resistor select for ldb only: 0 or 1
- mode : ldb mode as below:
	spl0		LDB_SPL_DI0
	spl1		LDB_SPL_DI1
	dul0		LDB_DUL_DI0
	dul1		LDB_DUL_DI1
	sin0		LDB_SIN0
	sin1		LDB_SIN1
	sep0		LDB_SEP0
	sep1		LDB_SEP1
- gpr : the mux controller for the display engine's display interfaces and the display encoder
	(only valid for mipi dsi now).
- disp-power-on-supply : the regulator to control display panel's power.
			(only valid for mipi dsi now).
- resets : the gpio pin to reset the display device(only valid for mipi display panel now).
- lcd_panel : the video mode name for the display device(only valid for mipi display panel now).
- dev_id : the display engine's identity within the system, which intends to replace ipu_id
	   (only valid for mipi dsi now).

Example for IPU:
		ipu1: ipu@02400000 {
			compatible = "fsl,imx6q-ipu";
			reg = <0x02400000 0x400000>;
			interrupts = <0 6 0x4 0 5 0x4>;
			clocks = <&clks 130>, <&clks 131>, <&clks 132>,
				 <&clks 39>, <&clks 40>,
				 <&clks 135>, <&clks 136>;
			clock-names = "bus", "di0", "di1",
				      "di0_sel", "di1_sel",
				      "ldb_di0", "ldb_di1";
			resets = <&src 2>;
			bypass_reset = <0>;
		};

Example for fb:
		fb0 {
			compatible = "fsl,mxc_sdc_fb";
			disp_dev = "ldb";
			interface_pix_fmt = "RGB666";
			mode_str ="LDB-XGA";
			default_bpp = <16>;
			int_clk = <0>;
			late_init = <0>;
			status = "okay";
		};

Example for ldb display:
		ldb@020e0000 {
			ipu_id = <1>;
			disp_id = <0>;
			ext_ref = <1>;
			mode = "sep0";
			sec_ipu_id = <1>;
			sec_disp_id = <1>;
			status = "okay";
		};

Example for mipi dsi display:
		mipi_dsi: mipi@021e0000 {
			compatible = "fsl,imx6q-mipi-dsi";
			reg = <0x021e0000 0x4000>;
			interrupts = <0 102 0x04>;
			gpr = <&gpr>;
			clocks = <&clks 138>, <&clks 204>;
			clock-names = "mipi_pllref_clk", "mipi_cfg_clk";
			dev_id = <0>;
			disp_id = <0>;
			lcd_panel = "TRULY-WVGA";
			disp-power-on-supply = <&reg_mipi_dsi_pwr_on>
			resets = <&mipi_dsi_reset>;
			status = "okay";
		};
```

## Documentation/devicetree/bindings/firmware/nxp,isp-mu.yaml
```yaml
# SPDX-License-Identifier: (GPL-2.0-only OR BSD-2-Clause)
%YAML 1.2
---
$id: http://devicetree.org/schemas/firmware/nxp,isp-mu.yaml#
$schema: http://devicetree.org/meta-schemas/core.yaml#

title: NXP i.MX ISP Firmware Communication Protocol

maintainers:
  - Robert Chiras <robert.chiras@nxp.com>

description:
The ISP firmware is a free-RTOS code running on M0 core inside the Camera
domain on i.MX95. Inside the Camera domain, there are multiple Messaging Units
used by the firmware in order to communicate with other cores willing to submit
jobs to ISP core.
This driver is using the mailbox system in order to send/receive messages to
and from ISP firmware.
It also provides the ISP firmware protocol used for communication with it.

properties:
  compatible:
    const: nxp,imx-isp-mu

  mboxes:
    description:
      A list of phandles of TX MU channels followed by a list of phandles of
      RX MU channels. The number of expected tx and rx channels is 1 TX and
      1 RX channels, per instance.
    oneOf:
      - items:
          - description: TX MU channel
          - description: RX MU channel

  mbox-names:
    oneOf:
      - items:
          - const: tx0
          - const: rx0
          - const: tx1
          - const: rx1
          - const: tx2
          - const: rx2
          - const: tx3
          - const: rx3
          - const: tx4
          - const: rx4
          - const: tx5
          - const: rx5
          - const: tx6
          - const: rx6
          - const: tx7
          - const: rx7
          - const: tx8
          - const: rx8

required:
  - compatible
  - mbox-names
  - mboxes

additionalProperties: false

examples:
  - |


    isp-mu {
        compatible = "nxp,imx-isp-mu";
        mboxes = <&cameramix_mu1 0 3
                  &cameramix_mu1 1 3
                  &cameramix_mu2 0 3
                  &cameramix_mu2 1 3
                  &cameramix_mu3 0 3
                  &cameramix_mu3 1 3
                  &cameramix_mu4 0 3
                  &cameramix_mu4 1 3
                  &cameramix_mu5 0 3
                  &cameramix_mu5 1 3
                  &cameramix_mu6 0 3
                  &cameramix_mu6 1 3
                  &cameramix_mu7 0 3
                  &cameramix_mu7 1 3
                  &cameramix_mu8 0 3
                  &cameramix_mu8 1 3
                  &cameramix_mu9 0 3
                  &cameramix_mu9 1 3>;
        mbox-names = "tx0", "rx0",
                     "tx1", "rx1",
                     "tx2", "rx2",
                     "tx3", "rx3",
                     "tx4", "rx4",
                     "tx5", "rx5",
                     "tx6", "rx6",
                     "tx7", "rx7",
                     "tx8", "rx8";
    };
```

## Documentation/devicetree/bindings/gpu/mtk,apu-drm.yaml
```yaml
# SPDX-License-Identifier: GPL-2.0-only OR BSD-2-Clause
%YAML 1.2
---
$id: http://devicetree.org/schemas/gpu/mediatek,apu-drm.yaml#
$schema: http://devicetree.org/meta-schemas/core.yaml#

title: AI Processor Unit DRM

properties:
  compatible:
    const: mediatek,apu-drm

  remoteproc:
    maxItems: 2
    description:
      Handle to remoteproc devices controlling the APU

  iova:
    maxItems: 1
    description:
      Address and size of virtual memory that could used by the APU

required:
  - compatible
  - remoteproc
  - iova

additionalProperties: false

examples:
  - |
    apu@0 {
      compatible = "mediatek,apu-drm";
      remoteproc = <&vpu0>, <&vpu1>;
      iova = <0 0x60000000 0 0x10000000>;
    };

...
```

## Documentation/devicetree/bindings/iio/adc/amlogic,meson-saradc.txt
```
* Amlogic Meson SAR (Successive Approximation Register) A/D converter

Required properties:
- compatible:	depending on the SoC this should be one of:
			- "amlogic,meson-g12a-saradc" for G12A
			- "amlogic,meson-txlx-saradc" for TXLX
			- "amlogic,meson-axg-saradc" for AXG
			- "amlogic,meson-txl-saradc" for TXL
			- "amlogic,meson-gxl-saradc" for GXL
			- "amlogic,meson-gxm-saradc" for GXM
			- "amlogic,meson-m8b-saradc" for M8B
along with the generic "amlogic,meson-saradc"

- reg:		the physical base address and length of the registers

- interrupts:	the interrupt indicating end of sampling

- clocks:	phandle and clock identifier (see clock-names)

- clock-names:	mandatory clocks:
			- "xtal" for the reference clock (typically XTAL)
			- "saradc_clk" for the SAR ADC (sampling) clock
		optional clocks:
			- "clk81_gate" for the clk81 clock gate

- #io-channel-cells: must be 1, see ../iio-bindings.txt

Optional properties:
- status: Shall be "ok" or "okay" if enabled or "disabled" if disabled.
		  Default is "ok".

Example:
saradc:saradc {
	compatible = "amlogic,meson-axg-saradc";
	status = "okay";
	#io-channel-cells = <1>;
	clocks = <&xtal>, <&clkc CLKID_SARADC_GATE>;
	clock-names = "xtal", "saradc_clk";
	interrupts = <GIC_SPI 73 IRQ_TYPE_EDGE_RISING>;
	reg = <0x0 0xff809000 0x0 0x38>;
}
```
