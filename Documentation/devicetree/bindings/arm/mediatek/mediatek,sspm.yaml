## Documentation/devicetree/bindings/media/mediatek,mt8189-seninf-core.yaml
```yaml
# SPDX-License-Identifier: (GPL-2.0-only OR BSD-2-Clause)
# Copyright (c) 2023 MediaTek, BayLibre
%YAML 1.2
---
$id: http://devicetree.org/schemas/media/mediatek,mt8189-seninf-core.yaml#
$schema: http://devicetree.org/meta-schemas/core.yaml#

title: MediaTek Sensor Interface 6S

maintainers:
  - Rongdong Wang <rongdong.wang@mediatek.com>
  - Andy Hsieh <andy.hsieh@mediatek.com>

description:
  The ISP6S SENINF is the CSI-2 interface found in multiple MediaTek SoCs.
  It can support up to two physical CSI-2 input ports, configured in DPHY
  (2 or 4 data lanes) or CPHY depending on the soc. On the output side,
  SENINF can be connected to CAMSV instance. CAMSV is used to bypass
  the internal ISP processing in order to connect either an external
  ISP, or a sensor (RAW, YUV).

properties:
  compatible:
    enum:
      - mediatek,mt8189-seninf-core

  reg:
    maxItems: 1

  reg-names:
    items:
    - const: base

  interrupts:
    maxItems: 1

  clocks:
    items:
      - description: Camsys seninf cgpdn clock
      - description: Top mux seninf clock
      - description: Top mux seninf clock
      - description: Top mux camtg clock
      - description: Top mux camtg1 clock
      - description: Top mux camtg2 clock
      - description: Top f26m clock D2
      - description: Top univp 192m D8
      - description: Top univpll D6 D8
      - description: Top univp 192m D4
      - description: Top clock 26m
      - description: Top univp 192m D16
      - description: Top univp 192m D32

  clock-names:
    items:
    - const: CAMSYS_SENINF_CGPDN
    - const: TOP_MUX_SENINF
    - const: TOP_MUX_SENINF1
    - const: TOP_MUX_CAMTG
    - const: TOP_MUX_CAMTG1
    - const: TOP_MUX_CAMTG2
    - const: TOP_F26M_CK_D2
    - const: TOP_UNIVP_192M_D8
    - const: TOP_UNIVPLL_D6_D8
    - const: TOP_UNIVP_192M_D4
    - const: TOP_CLK26M
    - const: TOP_UNIVP_192M_D16
    - const: TOP_UNIVP_192M_D32

  power-domains:
    maxItems: 2

  seninf_csi_port_0:
    type: object
    properties:
      compatible:
        const: mediatek,mt8189-seninf
      csi-port:
        enum: ["0", "0A"]
      phys:
        maxItems: 1
      phy-names:
        items:
          - const: csi0
      status:
        enum: ["okay", "disabled"]
      ports:
        $ref: /schemas/graph.yaml#/properties/ports
    required:
      - compatible
      - csi-port
      - phys
      - phy-names
      - ports

  seninf_csi_port_1:
    type: object
    properties:
      compatible:
        const: mediatek,mt8189-seninf
      csi-port:
        enum: ["1", "1A"]
      phys:
        maxItems: 1
      phy-names:
        items:
          - const: csi1
      status:
        enum: ["okay", "disabled"]
      ports:
        $ref: /schemas/graph.yaml#/properties/ports
    required:
      - compatible
      - csi-port
      - phys
      - phy-names
      - ports

required:
  - compatible
  - reg
  - interrupts
  - clocks
  - clock-names
  - power-domains
  - seninf_csi_port_0

additionalProperties: false

examples:
  - |
    #include <dt-bindings/clock/mediatek,mt8189-clk.h>
    #include <dt-bindings/interrupt-controller/irq.h>
    #include <dt-bindings/interrupt-controller/arm-gic.h>
    #include <dt-bindings/phy/phy.h>
    #include <dt-bindings/power/mediatek,mt8189-power.h>

    soc {
          #address-cells = <2>;
          #size-cells = <2>;

          seninf_top: seninf_top@1a004000 {
            compatible = "mediatek,mt8189-seninf-core";
            reg = <0 0x1a004000 0 0x8000>;
            reg-names = "base";
            interrupts = <GIC_SPI 316 IRQ_TYPE_LEVEL_HIGH 0>;
            clocks = <&camsys_main_clk CLK_CAM_M_SENINF>,
                      <&topckgen_clk CLK_TOP_SENINF_SEL>,
                      <&topckgen_clk CLK_TOP_SENINF1_SEL>,
                      <&vlp_cksys_clk CLK_VLP_CK_CAMTG0_SEL>,
                      <&vlp_cksys_clk CLK_VLP_CK_CAMTG1_SEL>,
                      <&vlp_cksys_clk CLK_VLP_CK_CAMTG2_SEL>,
                      <&topckgen_clk CLK_TOP_F26M_CK_D2>,
                      <&topckgen_clk CLK_TOP_UNIVPLL_192M_D8>,
                      <&topckgen_clk CLK_TOP_UNIVPLL_D6_D8>,
                      <&topckgen_clk CLK_TOP_UNIVPLL_192M_D4>,
                      <&topckgen_clk CLK_TOP_TCK_26M_MX9>,
                      <&topckgen_clk CLK_TOP_UNIVPLL_192M_D16>,
                      <&topckgen_clk CLK_TOP_UNIVPLL_192M_D32>;
            clock-names = "CAMSYS_SENINF_CGPDN",
                      "TOP_MUX_SENINF",
                      "TOP_MUX_SENINF1",
                      "TOP_MUX_CAMTG",
                      "TOP_MUX_CAMTG1",
                      "TOP_MUX_CAMTG2",
                      "TOP_F26M_CK_D2",
                      "TOP_UNIVP_192M_D8",
                      "TOP_UNIVPLL_D6_D8",
                      "TOP_UNIVP_192M_D4",
                      "TOP_CLK26M",
                      "TOP_UNIVP_192M_D16",
                      "TOP_UNIVP_192M_D32";

            power-domains = <&scpsys MT8189_POWER_DOMAIN_CAM_MAIN>,
                      <&scpsys MT8189_POWER_DOMAIN_CSI_RX>;

            seninf_csi_port_0: seninf_csi_port_0 {
              compatible = "mediatek,mt8189-seninf";
              csi-port = "0";
              phys = <&mipi_csi0 PHY_TYPE_DPHY>;
              phy-names = "csi0";
              status = "disabled";

              ports {
                    #address-cells = <1>;
                    #size-cells = <0>;

                    port@0 {
                          reg = <0>;
                    };

                    port@1 {
                        reg = <1>;
                        seninf0_camsv2_endpoint: endpoint {
                          remote-endpoint =
                          <&camsv2_seninf0_endpoint>;
                        };
                    };
              };
            };
          };
        };

...
```

## Documentation/devicetree/bindings/memory-controllers/mediatek,mminfra.yaml
```yaml
# SPDX-License-Identifier: (GPL-2.0-only OR BSD-2-Clause)
# Copyright (c) 2025 MediaTek Inc.
%YAML 1.2
---
$id: http://devicetree.org/schemas/memory-controllers/mediatek,mminfra.yaml#
$schema: http://devicetree.org/meta-schemas/core.yaml#

title: MediaTek Multimedia Infrastructure

maintainers:
  - Zhengnan Chen <zhengan.chen@mediatek.com>

description: |
  The main function of Multimedia Infrastructure(mminfra) is
  Hardware Restore Engine(HRE).
  HRE is used to perform backup and restore hw register setting on
  MediaTek platform.
  GCE is macroscopically located within mminfra, and some critical
  GCE register backups depend on mminfra.

properties:
  compatible:
    enum:
      - mediatek,mt8189-mminfra

  clocks:
    description: |
      gce_d and gce_m and gce_26m are mandatory.
    items:
      - description: gce_d is used for one of gce register setting.
      - description: gce_m is used for another of gce register setting.
      - description: gce_26m is also used for all gce register setting.

  clock-names:
    minItems: 3
    maxItems: 3

  power-domains:
    maxItems: 1

  mediatek,mminfra:
    $ref: /schemas/types.yaml#/definitions/phandle
    description: a phandle to the mminfra_config_clk syscon node.

required:
  - compatible
  - clocks
  - clock-names
  - power-domains
  - mediatek,mminfra

additionalProperties: false

examples:
  - |+
    #include <dt-bindings/clock/mediatek,mt8189-clk.h>
    #include <dt-bindings/power/mediatek,mt8189-power.h>

    mminfra {
      compatible = "mediatek,mt8189-mminfra";
      clocks = <&mminfra_config_clk CLK_MMINFRA_GCE_D>,
               <&mminfra_config_clk CLK_MMINFRA_GCE_M>,
               <&mminfra_config_clk CLK_MMINFRA_GCE_26M>;
      clock-names = "gce_d", "gce_m", "gce_26m";
      power-domains = <&scpsys MT8189_POWER_DOMAIN_MM_INFRA>;
      mediatek,mminfra = <&mminfra_config_clk>;
    };
```

## Documentation/devicetree/bindings/mfd/mediatek,mt6375.yaml
```yaml
# SPDX-License-Identifier: (GPL-2.0-only OR BSD-2-Clause)
%YAML 1.2
---
$id: http://devicetree.org/schemas/mfd/mediatek,mt6375.yaml#
$schema: http://devicetree.org/meta-schemas/core.yaml#

title: MediaTek MT6375 SubPMIC

maintainers:
  - ShuFan Lee <shufan_lee@richtek.com>

description: |
  MT6375 is a highly-integrated smart power management IC, which includes a
  single cell Li-Ion/Li-Polymer switching battery charger, a USB Type-C &
  Power Delivery (PD) controller.

properties:
  compatible:
    const: mediatek,mt6375

  reg:
    maxItems: 1

  wakeup-source: true

  interrupts:
    maxItems: 1

  interrupt-controller: true

  "#interrupt-cells":
    const: 1

  tcpc:
    type: object
    $ref: /schemas/usb/mediatek,mt6375-tcpc.yaml#

required:
  - compatible
  - reg
  - interrupts
  - interrupt-controller
  - "#interrupt-cells"
  - tcpc

additionalProperties: false

examples:
  - |
    #include <dt-bindings/interrupt-controller/irq.h>
    #include <dt-bindings/usb/pd.h>
    #include <dt-bindings/mfd/mt6375.h>
    i2c {
      #address-cells = <1>;
      #size-cells = <0>;

      pmic@34 {
        compatible = "mediatek,mt6375";
        reg = <0x34>;
        wakeup-source;
        interrupts-extended = <&gpio26 3 IRQ_TYPE_LEVEL_LOW>;
        interrupt-controller;
        #interrupt-cells = <1>;

        tcpc: tcpc {
          compatible = "mediatek,mt6375-tcpc";
          interrupts = <MT6375_PD_EVT>;

          usb_con_p0: connector {
            compatible = "usb-c-connector";
            label = "USB-C";
            data-role = "dual";
            power-role = "dual";
            try-power-role = "sink";
            source-pdos = <PDO_FIXED(5000, 500, PDO_FIXED_DUAL_ROLE | PDO_FIXED_USB_COMM | PDO_FIXED_DATA_SWAP)>;
            sink-pdos = <PDO_FIXED(5000, 2000, PDO_FIXED_DUAL_ROLE | PDO_FIXED_USB_COMM | PDO_FIXED_DATA_SWAP)>;
            op-sink-microwatt = <10000000>;

            ports {
              #address-cells = <1>;
              #size-cells = <0>;

              port@0 {
                reg = <0>;
                endpoint {
                  remote-endpoint = <&usb_hs>;
                };
              };
              port@1 {
                reg = <1>;
                endpoint {
                  remote-endpoint = <&usb_ss>;
                };
              };
              port@2 {
                reg = <2>;
                endpoint {
                  remote-endpoint = <&dp_aux>;
                };
              };
            };
          };
        };

      };
    };
```

## Documentation/devicetree/bindings/phy/mediatek,mt8189-csi-rx.yaml
```yaml
# SPDX-License-Identifier: (GPL-2.0-only OR BSD-2-Clause)
# Copyright (c) 2023 MediaTek, BayLibre
%YAML 1.2
---
$id: http://devicetree.org/schemas/phy/mediatek,mt8189-csi-rx.yaml#
$schema: http://devicetree.org/meta-schemas/core.yaml#

title: MediaTek Sensor Interface MIPI CSI CD-PHY

maintainers:
  - Rongdong Wang <rongdong.wang@mediatek.com>

description:
  The SENINF CD-PHY is a set of CD-PHY connected to the SENINF CSI-2
  receivers. The number of PHYs depends on the SoC model.
  Depending on the SoC model, each PHYs can be either CD-PHY or D-PHY only
  capable.

properties:
  compatible:
    enum:
      - mediatek,mt8189-csi-rx

  reg:
    maxItems: 1

  phy-type:
    $ref: /schemas/types.yaml#/definitions/uint32
    enum: [10, 11]
    description:
      If the PHY doesn't support mode selection then this set the operating mode.
      See include/dt-bindings/phy/phy.h for constants.

  num-lanes:
    enum: [1, 2, 3, 4]
    description:
      In CPHY mode, num-lanes can be 1, 2, or 3; in DPHY mode, num-lanes can be
      1, 2, or 4.

  '#phy-cells':
    enum: [0, 1]
    description: |
      If the PHY doesn't support mode selection then #phy-cells must be 0 and
      PHY mode is described using phy-type property.
      If the PHY supports mode selection, then #phy-cells must be 1 and mode
      is set in the PHY cells. Supported modes are:
        - PHY_TYPE_DPHY
        - PHY_TYPE_CPHY
      See include/dt-bindings/phy/phy.h for constants.

  mediatek,csi-port:
    $ref: /schemas/types.yaml#/definitions/string
    enum:
      - "0"
      - "1"
      - "0A"
      - "0B"
      - "1A"
      - "1B"

required:
  - compatible
  - reg
  - phy-type
  - num-lanes
  - '#phy-cells'
  - mediatek,csi-port

additionalProperties: false

examples:
  - |
    #include <dt-bindings/phy/phy.h>
    soc {
      #address-cells = <2>;
      #size-cells = <2>;

      mipi_csi0: mipi-csi0@11f50000 {
        compatible = "mediatek,mt8189-csi-rx";
        reg = <0 0x11f50000 0 0x4000>;
        phy-type = <PHY_TYPE_DPHY>;
        status = "disabled";
        num-lanes = <4>;
        #phy-cells = <1>;
        mediatek,csi-port = "0";
      };

      mipi_csi1: mipi-csi1@11f54000 {
        compatible = "mediatek,mt8189-csi-rx";
        reg = <0 0x11f54000 0 0x4000>;
        phy-type = <PHY_TYPE_DPHY>;
        status = "disabled";
        num-lanes = <2>;
        #phy-cells = <1>;
        mediatek,csi-port = "1A";
      };
    };
...
```

## Documentation/devicetree/bindings/usb/mediatek,mt6375-tcpc.yaml
```yaml
# SPDX-License-Identifier: (GPL-2.0-only OR BSD-2-Clause)
%YAML 1.2
---
$id: http://devicetree.org/schemas/usb/mediatek,mt6375-tcpc.yaml#
$schema: http://devicetree.org/meta-schemas/core.yaml#

title: MediatTek MT6375 Type-C Port Switch and Power Delivery controller

maintainers:
  - Yuren Chen <ren_chen@richtek.com>

description: |
  MediaTek MT6375 is a multi-functional device.
  It integrates charger, ADC, regulators (VBUS),
  and TypeC Port Switch with Power Delivery controller.
  This document only describes MT6375 Type-C Port Switch and
  Power Delivery controller.

properties:
  compatible:
    enum:
      - mediatek,mt6375-tcpc

  reg:
    maxItems: 1

  interrupts:
    maxItems: 1

  wakeup-source:
    type: boolean

  connector:
    type: object
    $ref: /schemas/connector/usb-connector.yaml#
    unevaluatedProperties: false

additionalProperties: false

required:
  - compatible
  - connector
  - interrupts

examples:
  - |
    #include <dt-bindings/interrupt-controller/irq.h>
    #include <dt-bindings/usb/pd.h>
    #include <dt-bindings/mfd/mt6375.h>
    i2c {
      #address-cells = <1>;
      #size-cells = <0>;

      mt6375@34 {
        compatible = "mediatek,mt6375";
        reg = <0x34>;
        interrupts-extended = <&pio 9 IRQ_TYPE_LEVEL_LOW>;
        interrupt-controller;
        #interrupt-cells = <1>;

        tcpc {
          compatible = "mediatek,mt6375-tcpc";
          interrupts = <MT6375_PD_EVT>;

          connector {
            compatible = "usb-c-connector";
            label = "USB-C";
            data-role = "dual";
            power-role = "dual";
            try-power-role = "sink";
            source-pdos = <PDO_FIXED(5000, 500, PDO_FIXED_DUAL_ROLE | PDO_FIXED_DATA_SWAP)>;
            sink-pdos = <PDO_FIXED(5000, 2000, PDO_FIXED_DUAL_ROLE | PDO_FIXED_DATA_SWAP)>;
            op-sink-microwatt = <10000000>;

            ports {
              #address-cells = <1>;
              #size-cells = <0>;

              port@0 {
                reg = <0>;
                endpoint {
                  remote-endpoint = <&usb_hs>;
                };
              };
              port@1 {
                reg = <1>;
                endpoint {
                  remote-endpoint = <&usb_ss>;
                };
              };
              port@2 {
                reg = <2>;
                endpoint {
                  remote-endpoint = <&dp_aux>;
                };
              };
            };
          };
        };
      };
    };
...
```
