## Documentation/devicetree/bindings/usb/mediatek,usb_dp_selector.yaml
```yaml
# SPDX-License-Identifier: GPL-2.0-only OR BSD-2-Clause
%YAML 1.2
---
$id: http://devicetree.org/schemas/usb/mediatek,usb_dp_selector.yaml#
$schema: http://devicetree.org/meta-schemas/core.yaml#

title: MediaTek DP/USB selector

maintainers:
  - Chris Chen <chris-qj.chen@mediatek.com>

properties:
  compatible:
      const: mediatek,usb_dp_selector

  reg:
    maxItems: 1

  reg-names:
    maxItems: 1

  mediatek,uds-ver:
    description: Register map version
    $ref: /schemas/types.yaml#/definitions/uint32

  mode-switch:
    description: Flag the port as possible handle of altmode switching
    type: boolean

  orientation-switch:
    description: Flag the port as possible handler of orientation switching
    type: boolean

  port:
    $ref: /schemas/graph.yaml#/properties/port
    description:
      A port node to link the usb_dp_selector to a TypeC controller for the purpose of
      handling altmode muxing and orientation switching.

required:
  - compatible
  - reg
  - orientation-switch
  - port

additionalProperties: false

examples:
  - |
    usb_dp_selector: usb-dp-selector@10011018 {
      compatible = "mediatek,usb_dp_selector";
      reg = <0x10011018 0x4>;
      reg-names = "usb_dp_reg";
      mediatek,uds-ver = <3>;
      orientation-switch;
      mode-switch;
      status = "okay";

      port {
        ssusb_mux_ep_p0: endpoint {
          remote-endpoint = <&tcpc_ssusb_mux_ep_p0>;
        };
      };
    };
...
```

## Documentation/devicetree/bindings/usb/ti,ts3usbca4.yaml
```yaml
# SPDX-License-Identifier: GPL-2.0-only OR BSD-2-Clause
%YAML 1.2
---
$id: http://devicetree.org/schemas/usb/ti,ts3usbca4.yaml#
$schema: http://devicetree.org/meta-schemas/core.yaml#

title: TI TS3USBCA4 TypeC SBU Multiplexer

maintainers:
  - Tommy Chen <tommyyl.chen@mediatek.com>

properties:
  compatible:
      const: ti,ts3usbca4

  reg:
    maxItems: 1

  orientation-switch:
    description: Flag the port as possible handler of orientation switching
    type: boolean

  port:
    $ref: /schemas/graph.yaml#/properties/port
    description:
      A port node to link the ts3usbca4 to a TypeC controller for the purpose of
      handling altmode muxing and orientation switching.

  mux3v3-supply:
    description: phandle to the regulator for the 3.3V supply

required:
  - compatible
  - reg
  - orientation-switch
  - port
  - mux3v3-supply

additionalProperties: false

examples:
  - |
    i2c6 {
        #address-cells = <1>;
        #size-cells = <0>;

        ts3usbca4@5d {
            compatible = "ti,ts3usbca4";
            reg = <0x5d>;
            orientation-switch;
            mux3v3-supply = <&ext_3v3>;
            status = "okay";

            port {
                typec_dp_sbu_mux: endpoint {
                    remote-endpoint = <&tcpc_typec_dp_sbu>;
                };
            };
        };
    };
...
```

## drivers/input/touchscreen/tddi/Kconfig
```kconfig
config TOUCHSCREEN_TDDI
	tristate "TDDI based touch panel controllers"
	depends on I2C
	help
	  Say Y here if you have a TDDI touchscreen connected to your system.
	  If unsure, say N.
```

## drivers/misc/mediatek/sspm/Kconfig
```kconfig
# SPDX-License-Identifier: GPL-2.0

config MTK_TINYSYS_SSPM_SUPPORT
	tristate "Specify Interface Support SSPM"
	default n
	help
	  SSPM is a MediaTek in-house hardware for power management under
	  secure world.
	  Set Y to enable this feature.
	  If unsure, set N to stay with legancy feature.

config MTK_TINYSYS_SSPM_PLT_SUPPORT
	bool "Specify Interface of SSPM on Platform"
	default n
	help
	  SSPM is a MediaTek in-house hardware for power management based
	  on platform.
	  Set Y to enable this feature for specific platform.
	  If unsure, set N to stay with legancy feature.

config MTK_TINYSYS_SSPM_V0
	bool "Specify Interface SSPM Version0"
	help
	  Set Interface SSPM Version as V0.
	  V0 is based on Tinysys IPI mechanism.
	  Set Y to enable this feature.
	  If unsure, set N to stay with original feature.

config MTK_TINYSYS_SSPM_LEGACY
	bool "Specify Interface SSPM Version0"
	help
	  Set Interface SSPM Version as Legacy.
	  Legacy is based on Tinysys IPI mechanism.
	  Set Y to enable this feature.
	  If unsure, set N to stay with original feature.

config MTK_TINYSYS_SSPM_V1
	bool "Specify Interface SSPM Version1"
	help
	  Set Interface SSPM Version as V1.
	  V1 is based on Tinysys IPI mechanism.
	  Set Y to enable this feature.
	  If unsure, set N to stay with original feature.

config MTK_TINYSYS_SSPM_V2
	bool "Specify Interface SSPM Version2"
	help
	  Set Interface SSPM Version as V2.
	  V2 is based on Tinysys IPI mechanism.
	  Set Y to enable this feature.
	  If unsure, set N to stay with original feature.

config MTK_TINYSYS_SSPM_V3
	bool "Specify Interface SSPM Version3"
	help
	  Set Interface SSPM Version as V3.
	  V3 is based on SCMI mechanism.
	  Set Y to enable this feature.
	  If unsure, set N to stay with original feature.

config MTK_MET_MEM_ALLOC
	bool "Using dynamic allocate memory for MET"
	help
	  Set dynamic allocate memory for MET.
	  Set Y to enable this feature.
	  Set N to disable this feature.
	  If unsure, set N to stay with original feature.

config MTK_TINYSYS_SSPM_LOGGER_SUPPORT
	bool "SSPM Debug support"
	help
	  This is a debug interface for SSPM
	  Set Y to enable this feature.
	  Set N to disable this feature.
	  If unsure, Set N to disable it.
```
