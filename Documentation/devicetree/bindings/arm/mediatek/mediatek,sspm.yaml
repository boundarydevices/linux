## Documentation/devicetree/bindings/arm/mediatek/mediatek,sspm.yaml
```yaml
# SPDX-License-Identifier: (GPL-2.0 OR BSD-2-Clause)
%YAML 1.2
---
$id: http://devicetree.org/schemas/arm/mediatek/mediatek,sspm.yaml#
$schema: http://devicetree.org/meta-schemas/core.yaml#

title: MediaTek mt8196 SSPM core

maintainers:
  - Hailong Fan <hailong.fan@mediatek.com>

description:
    The MediaTek SSPM(Secure System Power Manager) controller manages SoC power and operates within the secure domain.

properties:
  compatible:
    const: mediatek,sspm

  reg:
    minItems: 3
    maxItems: 3

  reg-names:
    items:
      - const: sspm_base
      - const: cfgreg
      - const: mbox_share

  interrupts:
    minItems: 1
    description: IPI interrupt

  memory-region:
    items:
      - description: Memory shared by SSPM features.

required:
  - compatible
  - reg
  - reg-names

additionalProperties: false

examples:
  - |
    soc {
        #address-cells = <2>;
        #size-cells = <2>;

        sspm: sspm@1c300000 {
            compatible = "mediatek,sspm";
            reg = <0 0x1c300000 0 0x2c000>,
                  <0 0x1c340000 0 0x10000>,
                  <0 0x1c380000 0 0x80>;

            reg-names = "sspm_base",
                        "cfgreg",
                        "mbox_share";

            interrupts = <0 508 4>;
            memory-region = <&sspm_resv_mem>;
        };
    };
```

## Documentation/devicetree/bindings/display/mediatek/mediatek,lvds.yaml
```yaml
# SPDX-License-Identifier: (GPL-2.0-only OR BSD-2-Clause)
# Copyright (c) 2025 MediaTek
%YAML 1.2
---
$id: http://devicetree.org/schemas/display/mediatek/mediatek,lvds.yaml#
$schema: http://devicetree.org/meta-schemas/core.yaml#

title: MediaTek Low-Voltage Differential Signaling (LVDS) Encoder

maintainers:
  - Chun-Kuang Hu <chunkuang.hu@kernel.org>
  - Philipp Zabel <p.zabel@pengutronix.de>
  - Chunfeng Yun <chunfeng.yun@mediatek.com>

description: |
  The MediaTek LVDS function block is a sink of the display subsystem
  and can drive up to four differential pairs of 8-bit parallel
  output to the LVDS PHY.

properties:
  $nodename:
    pattern: "^lvds@[0-9a-f]+$"

  compatible:
    oneOf:
      - items:
          - enum:
              - mediatek,mt8189-lvds
              - mediatek,mt8365-lvds

  reg:
    maxItems: 1

  clocks:
    items:
      - description: pixel clock
      - description: digital to analog interface clock tree synthesis with different phase
      - description: digital to analog interface clock

  clock-names:
    items:
      - const: pixel
      - const: clkts
      - const: clkdig

  phys:
    maxItems: 1

  phy-names:
    items:
      - const: lvds

  ports:
    $ref: /schemas/graph.yaml#/properties/ports

    properties:
      port@0:
        $ref: /schemas/graph.yaml#/properties/port
        description: Input node to receive pixel data.

      port@1:
        $ref: /schemas/graph.yaml#/properties/port
        description: LVDS output node to panel.

    required:
      - port@0
      - port@1

required:
  - compatible
  - reg
  - clocks
  - clock-names
  - phys
  - phy-names
  - ports

additionalProperties: false

examples:
  - |
    #include <dt-bindings/clock/mediatek,mt8365-clk.h>
    soc {
        #address-cells = <2>;
        #size-cells = <2>;

        lvds: lvds@14019200 {
            compatible = "mediatek,mt8365-lvds";
            reg = <0 0x14019200 0 0x100>;
            clocks = <&mmsys CLK_MM_LVDSTX_PXL>,
                <&mmsys CLK_MM_LVDSTX_CTS>,
                <&topckgen CLK_TOP_LVDSTX_CLKDIG_EN>;
            clock-names = "pixel", "clkts", "clkdig";
            phys = <&lvds_tx>;
            phy-names = "lvds";

            ports {
                #address-cells = <1>;
                #size-cells = <0>;

                port@0 {
                    reg = <0>;
                    lvds_in: endpoint {
                        remote-endpoint = <&dpi_out>;
                    };
                };
                port@1 {
                    reg = <1>;
                    lvds_out: endpoint {
                        remote-endpoint = <&lvds_panel_in>;
                    };
                };
            };
        };
    };

...
```

## Documentation/devicetree/bindings/iio/adc/ti,ads7038.yaml
```yaml
# SPDX-License-Identifier: (GPL-2.0 OR BSD-2-Clause)
%YAML 1.2
---
$id: http://devicetree.org/schemas/iio/adc/ti,ads7038.yaml#
$schema: http://devicetree.org/meta-schemas/core.yaml#

title: Texas Instruments ADS7038 and similar ADCs

maintainers:
  - Andre Werner <andre.werner@systec-electronic.com>

description: |
  Family of 7 channel, 12 bit ADCs with SPI/I2C interface.

  Datasheet: https://www.ti.com/lit/gpn/ads7038

properties:
  compatible:
    enum:
      - ti,ads7038
      - ti,ads7138

  reg:
    maxItems: 1

  spi-max-frequency:
    maximum: 60000000

  vref-supply:
    description: Supplies the reference voltage AVDD

required:
  - compatible
  - reg
  - vref-supply

additionalProperties: false

examples:
  - |
    spi {
        #address-cells = <1>;
        #size-cells = <0>;

        adc@0 {
            compatible = "ti,ads7038";
            reg = <0>;
            vref-supply = <&refin_supply>;
            spi-max-frequency = <10000000>;
        };
    };
```

## Documentation/devicetree/bindings/mailbox/mediatek,tinysys-mbox.yaml
```yaml
# SPDX-License-Identifier: (GPL-2.0-only OR BSD-2-Clause)
%YAML 1.2
---
$id: http://devicetree.org/schemas/mailbox/mediatek,tinysys-mbox.yaml#
$schema: http://devicetree.org/meta-schemas/core.yaml#

title: MediaTek TinySys mailbox controller

maintainers:
  - Hailong Fan <Hailong.Fan@mediatek.com>

description: |
  The MediaTek tinysys-mbox Inter-Processor Communication (IPC) enables the SoC
  to communicate with the Tiny System (tinysys) by passing messages through
  multiple mailbox channels. The MediaTek tinysys-mbox IPC also provides the
  ability for one processor to signal the other processor using interrupts.
  This mailbox controller is typically used as a communication mechanism
  between the main processor and tinysys subsystems, and is often managed
  under the SCMI (System Control and Management Interface) framework.

properties:
  compatible:
    const: mediatek,tinysys_mbox

  reg:
    minItems: 2
    maxItems: 2

  mboxes:
    minItems: 1
    maxItems: 8

  shmem:
    minItems: 2
    maxItems: 2
    description: |
      References to the shared memory regions used for SCMI message
      transmission (TX) and reception (RX).

  interrupts:
    minItems: 2
    maxItems: 2

  "#mbox-cells":
    const: 1

required:
  - compatible
  - reg
  - shmem
  - interrupts
  - "#mbox-cells"

additionalProperties: false

examples:
  - |
    #include <dt-bindings/interrupt-controller/arm-gic.h>
    #include <dt-bindings/interrupt-controller/irq.h>

    tinysys_mbox: tinysys-mbox@1c351000 {
        compatible = "mediatek,tinysys_mbox";
        reg = <0x1c351000 0x1000>,
              <0x1c361000 0x1000>;
        shmem = <&scmi_tx_shmem>, <&scmi_rx_shmem>;
        interrupts = <0 509 4>,
                     <0 510 4>;
        #mbox-cells = <1>;
    };

    scmi_tx_shmem: scmi-tx-shmem@0 {
        compatible = "arm,scmi-shmem";
        reg = <0x0 0x80>;
    };

    scmi_rx_shmem: scmi-rx-shmem@1 {
        compatible = "arm,scmi-shmem";
        reg = <0x0 0x80>;
    };

    firmware {
        scmi: scmi {
            compatible = "arm,scmi";
            mboxes = <&tinysys_mbox 0>, <&tinysys_mbox 1>;
            shmem = <&scmi_tx_shmem>, <&scmi_rx_shmem>;
            mbox-names = "tx", "rx";
        };
    };
```

## Documentation/devicetree/bindings/media/mediatek,mt8189-camsv.yaml
```yaml
# SPDX-License-Identifier: (GPL-2.0-only OR BSD-2-Clause)
# Copyright (c) 2023 MediaTek, BayLibre
%YAML 1.2
---
$id: http://devicetree.org/schemas/media/mediatek,mt8189-camsv.yaml#
$schema: http://devicetree.org/meta-schemas/core.yaml#

title: MediaTek CAMSV 6s

maintainers:
  - Rongdong Wang <rongdong.wang@mediatek.com>
  - Andy Hsieh <andy.hsieh@mediatek.com>

description:
  The CAMSV is a set of DMA engines connected to the SENINF CSI-2
  receivers. The number of CAMSVs depends on the SoC model.

properties:
  compatible:
    const: mediatek,mt8189-camsv

  reg:
    items:
      - description: camsv base

  interrupts:
    maxItems: 1

  mediatek,cammux-id:
    $ref: /schemas/types.yaml#/definitions/uint32
    description: CAMSV mux id

  power-domains:
    maxItems: 1

  clocks:
    items:
      - description: Camsys cam cgpdn
      - description: Camsys camtg cgpdn
      - description: Camsys camsv cgpdn
      - description: Camsys larb13 cgpdn
      - description: Camsys main cam2mm gals cgpdn
      - description: Topckgen top mux camtm

  clock-names:
    items:
      - const: CAMSYS_CAM_CGPDN
      - const: CAMSYS_CAMTG_CGPDN
      - pattern: ^CAMSYS_CAMSV[1-3]_CGPDN$
      - const: CAMSYS_LARB13_CGPDN
      - const: CAMSYS_MAIN_CAM2MM_GALS_CGPDN
      - const: TOPCKGEN_TOP_MUX_CAMTM

  iommus:
    maxItems: 1

  ports:
    $ref: /schemas/graph.yaml#/properties/ports
    patternProperties:
      "^port@[01]$":
        $ref: /schemas/graph.yaml#/properties/port
        description: connection point for camsv
    required:
      - port@0

required:
  - compatible
  - reg
  - interrupts
  - mediatek,cammux-id
  - clocks
  - clock-names
  - iommus
  - power-domains
  - ports

additionalProperties: false

examples:
  - |
    #include <dt-bindings/interrupt-controller/arm-gic.h>
    #include <dt-bindings/interrupt-controller/irq.h>
    #include <dt-bindings/clock/mediatek,mt8189-clk.h>
    #include <dt-bindings/memory/mediatek,mt8189-memory-port.h>
    #include <dt-bindings/power/mediatek,mt8189-power.h>

    soc {
        #address-cells = <2>;
        #size-cells = <2>;

        camsv2: camsv2@1a092000 {
          compatible = "mediatek,mt8189-camsv";
          reg = <0 0x1a092000 0 0x1000>;
          interrupts = <GIC_SPI 143 IRQ_TYPE_LEVEL_HIGH 0>;
          mediatek,cammux-id = <2>;
          clocks = <&camsys_main_clk CLK_CAM_M_CAMSYS_MAIN_CAM>,
                   <&camsys_main_clk CLK_CAM_M_CAMSYS_MAIN_CAMTG>,
                   <&camsys_main_clk CLK_CAM_M_CAMSV1>,
                   <&camsys_main_clk CLK_CAM_M_LARB13>,
                   <&camsys_main_clk CLK_CAM_M_CAM2MM_GALS>,
                   <&topckgen_clk CLK_TOP_CAMTM_SEL>;
          clock-names = "CAMSYS_CAM_CGPDN",
                        "CAMSYS_CAMTG_CGPDN",
                        "CAMSYS_CAMSV1_CGPDN",
                        "CAMSYS_LARB13_CGPDN",
                        "CAMSYS_MAIN_CAM2MM_GALS_CGPDN",
                        "TOPCKGEN_TOP_MUX_CAMTM";
          iommus = <&mm_iommu M4U_L13_P6_CAMSV_4>;
          power-domains = <&scpsys MT8189_POWER_DOMAIN_CAM_MAIN>;

          ports {
            #address-cells = <1>;
            #size-cells = <0>;
            port@0 {
              reg = <0>;
              camsv2_seninf0_endpoint: endpoint {
                remote-endpoint =
                      <&seninf0_camsv2_endpoint>;
              };
            };
          };
        };
      };
...
```
