## Documentation/devicetree/bindings/remoteproc/fsl,imx-dsp-rproc.yaml
```yaml
# SPDX-License-Identifier: (GPL-2.0-only or BSD-2-Clause)
%YAML 1.2
---
$id: http://devicetree.org/schemas/remoteproc/fsl,imx-dsp-rproc.yaml#
$schema: http://devicetree.org/meta-schemas/core.yaml#

title: i.MX DSP Remoteproc Devices

maintainers:
  - Shengjiu Wang <shengjiu.wang@nxp.com>

description:
  This binding provides support for DSP processors found on i.mX family of SoCs

properties:
  compatible:
    enum:
      - fsl,imx8qxp-hifi4
      - fsl,imx8qm-hifi4
      - fsl,imx8mp-hifi4
      - fsl,imx8ulp-hifi4

  clocks:
    description:
      Main functional clock for the remote processor
    minItems: 1
    maxItems: 32

  clock-names:
    description: |
      List of clock names for the remote processor.
      dsp_clkx for clocks of dsp itself.
      per_clkx for clocks of peripherals used by dsp.
    minItems: 1
    maxItems: 26
    items:
      - const: dsp_clk1
      - const: dsp_clk2
      - const: dsp_clk3
      - const: dsp_clk4
      - const: dsp_clk5
      - const: dsp_clk6
      - const: dsp_clk7
      - const: dsp_clk8
      - const: per_clk1
      - const: per_clk2
      - const: per_clk3
      - const: per_clk4
      - const: per_clk5
      - const: per_clk6
      - const: per_clk7
      - const: per_clk8
      - const: per_clk9
      - const: per_clk10
      - const: per_clk11
      - const: per_clk12
      - const: per_clk13
      - const: per_clk14
      - const: per_clk15
      - const: per_clk16
      - const: per_clk17
      - const: per_clk18

  fsl,dsp-ctrl:
    $ref: /schemas/types.yaml#/definitions/phandle
    description:
      Phandle to syscon block which provide access for processor enablement

  mbox-names:
    items:
      - const: tx
      - const: rx
      - const: rxdb

  mboxes:
    description:
      This property is required only if the rpmsg/virtio functionality is used.
      List of <&phandle type channel> - 1 channel for TX, 1 channel for RX, 1 channel for RXDB.
      (see mailbox/fsl,mu.yaml)
    minItems: 1
    maxItems: 3

  firmware-name:
    description: |
      Default name of the firmware to load to the remote processor.

  memory-region:
    description:
      If present, a phandle for a reserved memory area that used for vdev buffer,
      resource table, vring region and others used by remote processor.
    minItems: 1
    maxItems: 32

  reg:
    description: |
      Address space for any remoteproc memories present on the SoC.

  power-domains:
    minItems: 1
    maxItems: 32

required:
  - compatible
  - reg
  - mboxes
  - mbox-names
  - clocks
  - clock-names
  - firmware-name

additionalProperties: false

examples:
  - |
    #include <dt-bindings/clock/imx8mp-clock.h>
    dsp_reserved: dsp@92400000 {
      reg = <0x92400000 0x1000000>;
      no-map;
    };
    dsp_vdev0vring0: vdev0vring0@942f0000 {
      reg = <0x942f0000 0x8000>;
      no-map;
    };
    dsp_vdev0vring1: vdev0vring1@942f8000 {
      reg = <0x942f8000 0x8000>;
      no-map;
    };
    dsp_vdev0buffer: vdev0buffer@94300000 {
      compatible = "shared-dma-pool";
      reg = <0x94300000 0x100000>;
      no-map;
    };

    dsp: dsp@3b6e8000 {
      compatible = "fsl,imx8mp-hifi4";
      reg = <0x3B6E8000 0x88000>;
      clocks = <&audio_blk_ctrl IMX8MP_CLK_AUDIOMIX_OCRAMA_IPG>,
               <&audio_blk_ctrl IMX8MP_CLK_AUDIOMIX_DSP_ROOT>,
               <&audio_blk_ctrl IMX8MP_CLK_AUDIOMIX_DSPDBG_ROOT>;
      clock-names = "dsp_clk1", "dsp_clk2", "dsp_clk3";
      firmware-name = "imx/dsp/hifi4.bin";
      power-domains = <&audiomix_pd>;
      mbox-names = "tx", "rx", "rxdb";
      mboxes = <&mu2 0 0>,
               <&mu2 1 0>,
               <&mu2 3 0>;
      memory-region = <&dsp_vdev0buffer>, <&dsp_vdev0vring0>,
                      <&dsp_vdev0vring1>, <&dsp_reserved>;
      fsl,dsp-ctrl = <&audio_blk_ctrl>;
    };
```

## Documentation/devicetree/bindings/remoteproc/mtk,apu.txt
```
MT8183 Vision Processor Unit (VPU) devices
=======================

DSP Device Node:
================
Each DSP Core sub-system is represented as a single DT node.

Required properties:
--------------------
The following are the mandatory properties:

- compatible:		Should be one of the following,
			    "mediatek,mt8183-apu" for DSPs on MT8183 SoCs
- reg:			Should contain an entry for each value in 'reg-names'.
			Each entry should have the memory region's start address
			and the size of the region, the representation matching
			the parent node's '#address-cells' and '#size-cells' values.
- reg-names:		Should contain strings with the following names, each
			representing a specific internal memory region or a
			specific register space. Should be "mmio".
- interrupts:		The interrupt number used to receive the interrupts
			from the DSP.
- clocks:		Clocks for co-processor (See: ../clock/clock-bindings.txt)
			Three clocks are expected for AXI, IPU and JTAG.
			The JTAG clock seems to be required to run the DSP,
			even when JTAG is not in use.
- clock-names:		The name of clocks, must be ipu, axi and jtag
- iommu:		IOMMU (See: ../iommu/iommu.txt)
- memory-region:	Reserved memory (See: ../reserved-memory/reserved-memory.txt)
- power-domains:	Power domain (see: ../power/power_domain.txt)

Optional properties:
--------------------
pinctrl-0, pinctrl-1:	pinctrl handles, required to configure pins for JTAG.
pinctrl-names:		pinctrl name, must be "default", "jtag".
			"default" must configure the pins when JTAG is disabled.
			"jtag" must configure the pins for JTAG operations.

Example:
--------

	reserved-memory {
		#address-cells = <1>;
		#size-cells = <1>;
		ranges;

		vpu_ram: vpu_ram@0x60000000 {
			compatible = "shared-dma-pool";
			reg = <0 0x60000000 0 0x040000000>;
			no-map;
			linux,cma-default;
		};
	};

	vpu0: vpu@0x19100000 {
		compatible = "mediatek,mt8183-apu";
		reg = <0 0x19180000 0 0x14000>;
		reg-names = "mmio";
		interrupts = <GIC_SPI 292 IRQ_TYPE_LEVEL_LOW>;

		iommus = <&iommu M4U_PORT_IMG_IPUO>,
			 <&iommu M4U_PORT_IMG_IPU3O>,
			 <&iommu M4U_PORT_IMG_IPUI>;

		clocks = <&ipu_core0 CLK_IPU_CORE0_AXI>,
			 <&ipu_core0 CLK_IPU_CORE0_IPU>,
			 <&ipu_core0 CLK_IPU_CORE0_JTAG>;

		clock-names = "axi", "ipu", "jtag";

		power-domains = <&scpsys MT8183_POWER_DOMAIN_VPU_CORE0>;
		memory-region = <&vpu_ram>;
	};
```

## Documentation/devicetree/bindings/remoteproc/nxp,isp-rproc.yaml
```yaml
# SPDX-License-Identifier: (GPL-2.0 OR BSD-2-Clause)
%YAML 1.2
---
$id: http://devicetree.org/schemas/remoteproc/nxp,isp-rproc.yaml#
$schema: http://devicetree.org/meta-schemas/core.yaml#

title: NXP i.MX95 ISP Firmware loader

maintainers:
  - Robert Chiras <robert.chiras@nxp.com>

description: |
  The Camera domain from i.MX95 has an M0 core with an attached OCRAM, where a
  small code can be loaded and booted on M0. This driver handles the loading
  of the firmware binary, configuring the OCRAM and starting/stopping the core.

properties:
  compatible:
    enum:
      - nxp,imx95-isp-rproc

  reg:
    maxItems: 1

  power-domains:
    description:
      List of phandle and PM domain specifier as documented in
      Documentation/devicetree/bindings/power/power_domain.txt
    minItems: 1
    maxItems: 4

  nxp,blk-ctrl:
    $ref: /schemas/types.yaml#/definitions/phandle
    description:
      Phandle to syscon block which provide access for processor enablement.

  nxp,ocram-cfg:
    $ref: /schemas/types.yaml#/definitions/phandle
    description:
      Phandle to syscon block which provide access for OCRAM configuration.

  nxp,isp-firmware:
    description: |
      Default name of the firmware to load to the remote processor.

  mba:
    description:
      node describing the Master Boot Record, that the core will use to boot.

    properties:
      memory-region:
        description:
          phandle to a node describing reserved memory (System RAM memory)
          used by ISP (see bindings/reserved-memory/reserved-memory.txt)
        minItems: 1
        maxItems: 1

        ocram-map:
          description:
            Optional property describing the size of the OCRAM that can be
            used to load the firmware.

            maxItems: 1

required:
  - compatible
  - reg
  - power-domains
  - mba

additionalProperties: false

examples:
  - |

    ocram_c: ocram@4af80000 {
      reg = <0x0 0x4af80000 0x0 0x18000>;
      no-map;
    };

    isp_fw_core: remoteproc {
      compatible = "nxp,imx95-isp-rproc";
      nxp,blk-ctrl = <&cameramix_csr>;
      nxp,ocram-cfg = <&ocram_c_config>;
      nxp,isp-firmware = "imx9xm0p_isp_fw.bin";
      power-domains = <&scmi_devpd IMX95_PD_CAMERA>;

      mba {
        memory-region = <&ocram_c>;
        ocram-map = <0x0 0x14000>;
      };
    };
```

## Documentation/devicetree/bindings/rpmsg/imx-rpmsg.txt
```
i.MX RPMSG platform implementations

Required properties:
- compatible : "fsl,imx7d-rpmsg", "fsl,imx6sx-rpmsg"
- vdev-nums : The number of the remote virtual devices.
- reg : The reserved DDR phisical memory used to store
  vring descriptors.
- multi-core-id: The id number of the remote processors.
  And it is optional for the legacy platforms, since they
  only have one remote processors.
- mub-partition: The partition ID of muB side, that's optional
  and used on i.mx8qm/8qxp for partition reset. The default
  value is 3 in driver without this property.


=====================================================================
message unit module for RPMSG

- mu_rpmsg : The message unit module used to do the communications
  between the asymmetric cores.
- compatible : "fsl,imx8mq-mu", "fsl,imx6sx-mu", "fsl,imx-mu-rpmsg1".
  Different mu module would be used by the different remote processor.
  The "fsl, imx6sx-mu" is used by the first remote processor.
  The "fsl,imx-mu-rpmsg1" is used by the second remote process.
- reg : Should contain MU registers location and length.
- interrupts : interrupt mapping for RPMSG MU IRQ
- interrupt-parent : A single value that points to the interrupt
  parent to which the child domain is being mapped.
  Value must be "&intmux_cm40" or "&intmux_cm41"

Example:
rpmsg: rpmsg{
	compatible = "fsl,imx6sx-rpmsg";
	status = "disabled";
};

&rpmsg{
	vdev-nums = <1>;
	reg = <0xbfff0000 0x10000>;
	status = "okay";
};
```

## Documentation/devicetree/bindings/rtc/nxp,pcf2131.yaml
```yaml
# SPDX-License-Identifier: GPL-2.0-only OR BSD-2-Clause
%YAML 1.2
---
$id: http://devicetree.org/schemas/rtc/nxp,pcf2131.yaml#
$schema: http://devicetree.org/meta-schemas/core.yaml#

title: NXP PCF2131 Real Time Clock

allOf:
  - $ref: "rtc.yaml#"

maintainers:
  - Joy Zou <joy.zou@nxp.com>

properties:
  compatible:
    const: nxp,pcf2131

  reg:
    maxItems: 1

  interrupts:
    maxItems: 1

  start-year: true

  reset-source: true

required:
  - compatible
  - reg

additionalProperties: false

examples:
  - |
    #include <dt-bindings/interrupt-controller/irq.h>
    i2c {
        #address-cells = <1>;
        #size-cells = <0>;

        rtc@53 {
            compatible = "nxp,pcf2131";
            reg = <0x53>;
            pinctrl-0 = <&rtc_nint_pins>;
            interrupts-extended = <&gpio1 16 IRQ_TYPE_LEVEL_LOW>;
            reset-source;
        };
    };

...
```

## Documentation/devicetree/bindings/soc/mediatek/mediatek,hdmirx.yaml
```yaml
# SPDX-License-Identifier: (GPL-2.0-only OR BSD-2-Clause)
%YAML 1.2
---
$id: http://devicetree.org/schemas/display/mediatek/mediatek,hdmirx.yaml#
$schema: http://devicetree.org/meta-schemas/core.yaml#

title: mediatek hdmirx Device Tree Bindings

maintainers:
  - Bo xu <bo.xu@mediatek.com>

description: |
  The MediaTek hdmirx function block is a HDMI2.0 sink and
  Provide maximum 4K60/50 RGB/YUV444/YUV422 24bits and
  4K60/50 YUV420 48bits HDMI input.

properties:
  compatible:
    enum:
      - mediatek,mt8195-hdmirx

  clocks:
    items:
      - description: HDMI bus clock
      - description: HDMI 208mHZ clock
      - description: HDCP engine clock
      - description: HDCP 104mHZ clock
      - description: HDMI clock

  power-domains:
    description: |
      It is the control of hdmirx power domain.

  clock-names:
    items:
      - const: hdmiclksel
      - const: hdmiclk208m
      - const: hdcpclksel
      - const: hdcpclk104m
      - const: hdmisel

  reg:
    maxItems: 9

  interrupts:
    maxItems: 2

required:
  - compatible
  - clocks
  - power-domains
  - clock-names
  - reg
  - interrupts

additionalProperties: false

examples:
  - |
    #include <dt-bindings/interrupt-controller/arm-gic.h>
    #include <dt-bindings/clock/mt8173-clk.h>
    #include <dt-bindings/interrupt-controller/arm-gic.h>
    #include <dt-bindings/interrupt-controller/irq.h>
    hdmirx0: hdmirx@1c400000 {
        compatible = "mediatek,mt8195-hdmirx";
        clocks = <&topckgen CLK_TOP_HDMI_APB>,
             <&topckgen CLK_TOP_MSDCPLL_D2>,
             <&topckgen CLK_TOP_HD20_HDCP_CCLK>,
             <&topckgen CLK_TOP_MSDCPLL_D4>,
             <&topckgen CLK_TOP_HDMI_XTAL>;
        power-domains = <&spm MT8195_POWER_DOMAIN_HDMI_RX>;
        clock-names = "hdmiclksel",
             "hdmiclk208m",
             "hdcpclksel",
             "hdcpclk104m",
             "hdmisel";
        reg = <0 0x1c400000 0 0x1000>,
             <0 0x1c300000 0 0x1000>,
             <0 0x11d5f000 0 0x1000>,
             <0 0x11d60000 0 0x3000>,
             <0 0x10014800 0 0x0400>,
             <0 0x10014400 0 0x0400>,
             <0 0x1000c000 0 0x1000>,
             <0 0x10000000 0 0x1000>,
             <0 0x10007000 0 0x1000>;
        interrupts = <GIC_SPI 678 IRQ_TYPE_LEVEL_HIGH 0>,
             <GIC_SPI 823 IRQ_TYPE_LEVEL_HIGH 0>;
    };

...
```

## Documentation/devicetree/bindings/sound/cs42528.txt
```
CS42518/CS42528 audio CODEC

Required properties:

  - compatible : must contain one of "cirrus,cs42518" and "cirrus,cs42528"

  - reg : the I2C address of the device for I2C

  - VA-supply, VD-supply, VLS-supply, VLC-supply: power supplies for the device,
    as covered in Documentation/devicetree/bindings/regulator/regulator.txt

Example:

codec: cs42528@4C {
	compatible = "cirrus,cs42528";
	#sound-dai-cells = <0>;
	codec_name = "cs425x8";
	reg = <0x1C>;
	reset_pin = <&gpio GPIOZ_17 GPIO_ACTIVE_LOW>;
	status = "okay";
};
```

## Documentation/devicetree/bindings/sound/cs42888.txt
```
CS42888 audio CODEC

This device supports I2C only.

Required properties:

  - compatible: "cirrus,cs42888"
  - reg: the I2C address of the device.
  - clocks: Phandle to the clock node.
  - clock-names: Contains name for each entry in clocks.
		"codec_osc" : the external oscillator.
		"esai" : the hckt clock from esai.
  - <name>-supply: Phandle to the regulator <name>.

Note: cs42888 needs a regulators node and a clocks node.

Example:
In this case, the clock is external oscillator.

codec: cs42888@48 {
	compatible = "cirrus,cs42888";
	reg = <0x048>;
	clocks = <&codec_osc 0>;
	clock-names = "codec_osc";
	VA-supply = <&reg_audio>;
	VD-supply = <&reg_audio>;
	VLS-supply = <&reg_audio>;
	VLC-supply = <&reg_audio>;
};
```

## Documentation/devicetree/bindings/sound/es7243.txt
```
ALSA SoC ES7243 adc driver

The ES7243 serial control bus communicates through the I2C protocol only. The
serial bus is also used for periodic codec fault checking/reporting during
audio playback. For more product information please see the links below:

Required properties:

- compatible : "MicArray_0";
- reg : I2C slave address

Example:
es7243_10: es7243_10@10 {
	compatible = "MicArray_0";
	#sound-dai-cells = <0>;
	reg = <0x10>;
	status = "okay";
};
es7243_12: es7243_12@12 {
	compatible = "MicArray_1";
	#sound-dai-cells = <0>;
	reg = <0x12>;
	status = "okay";
};
es7243_13: es7243_13@13 {
	compatible = "MicArray_2";
	#sound-dai-cells = <0>;
	reg = <0x13>;
	status = "okay";
};
es7243_11: es7243_11@11 {
	compatible = "MicArray_3";
	#sound-dai-cells = <0>;
	reg = <0x11>;
	status = "okay";
};
```
