## Documentation/devicetree/bindings/sound/fsl-easi.txt
```
* Freescale Enhanced Serial Audio Interface (ESAI)

Required properties:
  - compatible: Should be "fsl,<chip>-esai".
  - reg: Offset and length of the register set for the device.
  - interrupts: Contains ESAI interrupt.
  - clocks: Contains an entry for each entry in clock-names.
  - fsl,fifo-depth: The number of elements in the transmit and receive FIFOs.
                    This number is the maximum allowed value for TFCR[TFWM].
  - fsl,esai-dma-events: The dma event of the esai, <a b>, a is the tx dma.
			 b is the rx dma.
  - fsl,flags: <1> is for ESAI network mode, <2> is for ESAI SYNC mode.
	       <3> is for network and SYNC mode.

Example:

esai: esai@02024000 {
	compatible = "fsl,imx6q-esai";
	reg = <0x02024000 0x4000>;
	interrupts = <0 51 0x04>;
	clocks = <&clks 118>;
	fsl,fifo-depth = <128>;
	fsl,esai-dma-events = <24 23>;
	fsl,flags = <1>;
	status = "disabled";
};
```

## Documentation/devicetree/bindings/sound/imx-audio-spdif.txt
```
Freescale i.MX audio complex with S/PDIF

Required properties:
- compatible : "fsl,imx-audio-spdif"
- model : The user-visible name of this sound complex
- spdif-controller : The phandle of the i.MX SPDIF controller

- spdif-tx : switch for spdif playback. 1:enable, 0:disable
- spdif-rx : switch for spdif capture. 1:enable, 0:disable

Example:

	sound-spdif {
		compatible = "fsl,imx-audio-spdif",
			     "fsl,imx-arm2-spdif";
		model = "imx-arm2-spdif";
		spdif-controller = <&spdif_dai>;
		spdif-tx = <1>;		/* 1:enable, 0:disable */
		spdif-rx = <1>;		/* 1:enable, 0:disable */
	};
```

## Documentation/devicetree/bindings/sound/mediatek,mt8390-evk.yaml
```yaml
# SPDX-License-Identifier: (GPL-2.0-only OR BSD-2-Clause)
%YAML 1.2
---
$id: http://devicetree.org/schemas/sound/mediatek,mt8390-evk.yaml#
$schema: http://devicetree.org/meta-schemas/core.yaml#

title: MediaTek MT8188 ASoC sound card

maintainers:
  - Parker Yang <parker.yang@mediatek.com>

properties:
  compatible:
    const: mediatek,mt8390-evk

  model:
    $ref: /schemas/types.yaml#/definitions/string
    description: User specified audio sound card name

  audio-routing:
    $ref: /schemas/types.yaml#/definitions/non-unique-string-array
    description:
      A list of the connections between audio components. Each entry is a
      sink/source pair of strings. Valid names could be the input or output
      widgets of audio components, power supplies, MicBias of codec and the
      software switch.

  mediatek,platform:
    $ref: /schemas/types.yaml#/definitions/phandle
    description: The phandle of MT8188 ASoC platform.

patternProperties:
  "^dai-link-[0-9]+$":
    type: object
    description: |
      Array of dai-links with their corresponding codecs.
    properties:
      sound-dai:
          $ref: "/schemas/types.yaml#/definitions/phandle"
          description: |
            The phandle of the MT8188 ASoC platform.
          maxItems: 1
      dai-link-name:
        description: |
          This property corresponds to the name of the dai-link to which we are
          going to attached the codecs present in this node.
        maxItems: 1
    patternProperties:
      "^codec-[0-9]+$":
        type: object
        description: |
          Array of nodes containing information about a codec to be attached to
          the given dai-link.
        properties:
          sound-dai:
            $ref: /schemas/types.yaml#/definitions/phandle-array
            description: |
              The phandle of the audio codec and the driver id when needed.
            maxItems: 1
    required:
      - dai-link-name

additionalProperties: false

required:
  - compatible
  - mediatek,platform

examples:
  - |

    sound: mt8188-sound {
        compatible = "mediatek,mt8390-evk";
        mediatek,platform = <&afe>;
        model = "mt8188_evk";
        pinctrl-names = "default";
        pinctrl-0 = <&aud_pins_default>;
        audio-routing =
            "Headphone", "Headphone L",
            "Headphone", "Headphone R",
            "AIN1", "Headset Mic",
            "DMIC_INPUT", "AP DMIC",
            "AP DMIC", "MIC_BIAS_0",
            "AP DMIC", "MIC_BIAS_2";

        dai-link-0 {
            sound-dai = <&afe>;
            dai-link-name = "ADDA_BE";

            codec-0 {
                sound-dai = <&pmic 0>;
            };
        };

        dai-link-1 {
            sound-dai = <&afe>;
            dai-link-name = "ETDM3_OUT_BE";

            codec-0 {
                sound-dai = <&hdmi0>;
            };
        };
    };

...
```

## Documentation/devicetree/bindings/sound/mediatek,mt8395-evk.yaml
```yaml
# SPDX-License-Identifier: (GPL-2.0-only OR BSD-2-Clause)
%YAML 1.2
---
$id: http://devicetree.org/schemas/sound/mediatek,mt8395-evk.yaml#
$schema: http://devicetree.org/meta-schemas/core.yaml#

title: MediaTek MT8195 with MT6359 Demo ASoC sound card driver

maintainers:
  - Trevor Wu <trevor.wu@mediatek.com>

description:
  This binding describes the MT8195 demo sound card.

properties:
  compatible:
    const: mediatek,mt8395-evk

  mediatek,platform:
    $ref: "/schemas/types.yaml#/definitions/phandle"
    description: The phandle of the MT8195 ASoC platform.

  model:
    $ref: /schemas/types.yaml#/definitions/string
    description: User specified audio sound card name

patternProperties:
  "^dai-link-[0-9]+$":
    type: object
    description: |
      Array of dai-links with their corresponding codecs.

    properties:
      sound-dai:
        description: |
          The phandle of the MT8195 ASoC platform.
        maxItems: 1

      dai-link-name:
        description: |
          This property corresponds to the name of the dai-link to which we are
          going to attached the codecs present in this node.
        maxItems: 1

    patternProperties:
      "^codec-[0-9]+$":
        type: object
        description: |
          Array of nodes containing information about a codec to be attached to
          the given dai-link.

        properties:
          sound-dai:
            description: |
              The phandle of the audio codec and the driver id when needed.
            maxItems: 1

    required:
      - dai-link-name

additionalProperties: false

required:
  - compatible
  - mediatek,platform

examples:
  - |
    sound {
        compatible = "mediatek,mt8395-evk";
        mediatek,platform = <&afe>;
        model = "mt8195_demo";
        pinctrl-names = "default";
        pinctrl-0 = <&aud_pins_default>;


        dai-link-0 {
            sound-dai = <&afe>;
            dai-link-name = "DL_SRC_BE";

            codec-0 {
                sound-dai = <&pmic 0>;
            };
        };

        dai-link-1 {
            sound-dai = <&afe>;
            dai-link-name = "UL_SRC1_BE";

            codec-0 {
                sound-dai = <&pmic 0>;
            };

            codec-1 {
                sound-dai = <&dmic_codec>;
            };
        };

        dai-link-2 {
            sound-dai = <&afe>;
            dai-link-name = "UL_SRC2_BE";

            codec-0 {
                sound-dai = <&pmic 1>;
            };
        };

        dai-link-3 {
            sound-dai = <&afe>;
            dai-link-name = "ETDM3_OUT_BE";

            codec-0 {
                sound-dai = <&hdmi0>;
            };
        };
    };

...
```

## Documentation/devicetree/bindings/sound/mt6359-accdet.yaml
```yaml
# SPDX-License-Identifier: (GPL-2.0-only OR BSD-2-Clause)
%YAML 1.2
---
$id: http://devicetree.org/schemas/sound/mt6359-accdet.yaml#
$schema: http://devicetree.org/meta-schemas/core.yaml#

title: MediaTek Technologies Inc. MT6359 ASoC accdet jack driver

maintainers:
  - Zoran Zhan <zoran.zhan@mediatek.com>

description: |
  This binding describes the MediaTek Technologies MT6359 ASoC
  accdet jack driver.

properties:
  compatible:
    const: mediatek,mt6359-accdet

  mediatek,accdet-name:
    $ref: /schemas/types.yaml#/definitions/string
    description: named as "mt6359-accdet" jack.

  mediatek,mic-vol:
    $ref: /schemas/types.yaml#/definitions/uint32
    description: |
      Accdet micbias1 voltage.
    enum:
      - 0 # 1.7v - micbias1 volage is 1.7v.
      - 1 # 1.8v - micbias1 volage is 1.8v.
      - 2 # 1.9v - micbias1 volage is 1.9v.
      - 3 # 2.0v - micbias1 volage is 2.0v.
      - 4 # 2.1v - micbias1 volage is 2.1v.
      - 5 # 2.5v - micbias1 volage is 2.5v.
      - 6 # 2.6v - micbias1 volage is 2.6v.
      - 7 # 2.7v - micbias1 volage is 2.7v.
      - 8 # 2.8v - micbias1 volage is 2.8v.
      - 9 # 2.85v - micbias1 volage is 2.85v.

  mediatek,mic-mode:
    $ref: /schemas/types.yaml#/definitions/uint32
    description: |
      Value as 1, 2, 6 to indicate ACC/DCC mode. Default is DCC mode 2.
    enum:
      - 1 # ACC - ACC mode.
      - 2 # DCC - low cost without in bias.
      - 6 # DCC - low cost with in bias.

  mediatek,pwm-deb-setting:
    $ref: /schemas/types.yaml#/definitions/uint32-array
    description: |
       headset-mode-setting : Indicates customized pwm, debounce setting.
       accdet pwm_width, pwm_thresh, fall_delay, rise_delay
       debounce0, debounce1, debounce3, debounce4
       eint pwm_width, eint pwm_thresh
       eint deb(debounce0, debounce1, debounce2, debounce3), inv_debounce.
    minItems: 15
    maxItems: 15

  mediatek,eint-use-ap:
    $ref: /schemas/types.yaml#/definitions/uint32
    description: |
      Indicates to use ap gpio.
    enum:
      - 0 # MT6359 eint detection mode.
      - 1 # SoC GPIO detection mode.

  mediatek,eint-detect-mode:
    $ref: /schemas/types.yaml#/definitions/uint32
    description: |
      Indicates to use ap gpio.
    enum:
      - 0 # detection mode with higher detection power.
      - 1 # detection mode with lower detection power.
      - 2 # detection mode with sw moisture detection mode.
      - 3 # detection mode with hw moisture detection mode1.
      - 4 # detection mode with hw moisture detection mode2.

  mediatek,eint-num:
    $ref: /schemas/types.yaml#/definitions/uint32
    description: |
      Incicates pmic eint usage.
    enum:
      - 0 # PMIC_EINT0 - use pmic eint0 to trigger plug interrupt.
      - 1 # PMIC_EINT1 - use pmic eint1 to trigger plug interrupt.
      - 2 # PMIC_BI_EINT - use pmic eint0/1 to trigger plug interrupt.

  mediatek,eint-trig-mode:
    $ref: /schemas/types.yaml#/definitions/uint32
    description: |
      Incicates pmic eint trigger mode.
    enum:
      - 0 # PMIC_GPIO - use pmic gpio to detect plug status.
      - 1 # PMIC_INVERTER - use pmic inverter to detect plug status.

  mediatek,eint-use-ext-res:
    $ref: /schemas/types.yaml#/definitions/uint32
    description: |
      Select HP_EINT pull up resistance, default 0 use internal resistance.
    enum:
      - 0 # use internal resistor.
      - 1 # use external resistor.

  mediatek,eint-comp-vth:
    $ref: /schemas/types.yaml#/definitions/uint32
    description: |
      Indicates comparator detection voltage.
    enum:
      - 0 # 2.8v.
      - 1 # 2.4v.
      - 2 # 2.0v.
      - 3 # 0.7v.

  mediatek,key-mode:
    $ref: /schemas/types.yaml#/definitions/uint32
    description: |
      Incicates key mode type.
    enum:
      - 0 # THREE_KEY - support 3-key key mode.
      - 1 # FOUR_KEY - support 4-key key mode.
      - 2 # TRI_KEY_CDD - support 3-key google CDD key mode.

  mediatek,three-key-thr:
    description: |
      3 key device detection threshold: 0--MD_MAX--UP_MAX--DW_MAX.
    $ref: /schemas/types.yaml#/definitions/uint32-array
    minItems: 4
    maxItems: 4

  mediatek,tri-key-cdd-thr:
    description: |
      3 key CDD device detection threshold: 0--MD_MAX--UP_MAX--DW_MAX.
    $ref: /schemas/types.yaml#/definitions/uint32-array
    minItems: 4
    maxItems: 4

  mediatek,four-key-thr:
    description: |
      4 key device detection threshold: 0--MD_MAX--VOICE_MAX--UP_MAX--DW_MAX.
    $ref: /schemas/types.yaml#/definitions/uint32-array
    minItems: 5
    maxItems: 5

required:
  - compatible
  - mediatek,accdet-name
  - mediatek,mic-vol
  - mediatek,mic-mode
  - mediatek,pwm-deb-setting
  - mediatek,eint-use-ext-res
  - mediatek,three-key-thr

additionalProperties: false

examples:
  - |
    accdet: accdet {
        mediatek,accdet-name = "mt6359-accdet";
        mediatek,mic-vol = <8>;
        mediatek,mic-mode = <2>;
        mediatek,pwm-deb-setting = <0x500 0x500 1 0x1f0
                                    0x800 0x800 0x20 0x44
                                    0x4 0x1
                                    0x5 0x3 0x3 0x5 0xe>;
        mediatek,eint-use-ap = <0>;
        mediatek,eint-detect-mode = <4>;
        mediatek,eint-num = <0>;
        mediatek,eint-trig-mode = <1>;
        mediatek,eint-use-ext-res = <0>;
        mediatek,eint-comp-vth = <2>;
        mediatek,key-mode = <0>;
        mediatek,three-key-thr = <0 80 220 400>;
        status = "okay";
    };
...
```

## Documentation/devicetree/bindings/sound/mt8183-mt6358.txt
```
MT8183 with MT6358 CODEC

Required properties:
- compatible: "mediatek,mt8183-mt6358-sound"
- mediatek,platform: the phandle of MT8183 ASoC platform

Example:

	sound {
		compatible = "mediatek,mt8183-mt6358-sound";
		mediatek,platform = <&afe>;
	};
```

## Documentation/devicetree/bindings/sound/mt8188-mt6359.yaml
```yaml
# SPDX-License-Identifier: (GPL-2.0-only OR BSD-2-Clause)
%YAML 1.2
---
$id: http://devicetree.org/schemas/sound/mt8188-mt6359.yaml#
$schema: http://devicetree.org/meta-schemas/core.yaml#

title: MediaTek MT8188 ASoC sound card

maintainers:
  - Trevor Wu <trevor.wu@mediatek.com>

properties:
  compatible:
    const: mediatek,mt8188-mt6359-evb

  model:
    $ref: /schemas/types.yaml#/definitions/string
    description: User specified audio sound card name

  audio-routing:
    $ref: /schemas/types.yaml#/definitions/non-unique-string-array
    description:
      A list of the connections between audio components. Each entry is a
      sink/source pair of strings. Valid names could be the input or output
      widgets of audio components, power supplies, MicBias of codec and the
      software switch.

  mediatek,platform:
    $ref: /schemas/types.yaml#/definitions/phandle
    description: The phandle of MT8188 ASoC platform.

  mediatek,dptx-codec:
    $ref: /schemas/types.yaml#/definitions/phandle
    description: The phandle of MT8188 Display Port Tx codec node.

  mediatek,hdmi-codec:
    $ref: /schemas/types.yaml#/definitions/phandle
    description: The phandle of MT8188 HDMI codec node.

additionalProperties: false

required:
  - compatible
  - mediatek,platform

examples:
  - |

    sound: mt8188-sound {
        compatible = "mediatek,mt8188-mt6359-evb";
        mediatek,platform = <&afe>;
        pinctrl-names = "default";
        pinctrl-0 = <&aud_pins_default>;
        audio-routing =
            "Headphone", "Headphone L",
            "Headphone", "Headphone R",
            "AIN1", "Headset Mic";
    };

...
```
