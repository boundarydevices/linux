## Documentation/devicetree/bindings/sound/mt8195-mt6359-demo.yaml
```yaml
# SPDX-License-Identifier: (GPL-2.0-only OR BSD-2-Clause)
%YAML 1.2
---
$id: http://devicetree.org/schemas/sound/mt8195-mt6359-demo.yaml#
$schema: http://devicetree.org/meta-schemas/core.yaml#

title: Mediatek MT8195 with MT6359 Demo ASoC sound card driver

maintainers:
  - Nicolas Belin <nbelin@baylibre.com>

description:
  This binding describes the MT8195 demo sound card.

properties:
  compatible:
    const: mediatek,mt8195_mt6359_demo

  mediatek,platform:
    $ref: "/schemas/types.yaml#/definitions/phandle"
    description: The phandle of the MT8195 ASoC platform.

  model:
    $ref: /schemas/types.yaml#/definitions/string
    description: User specified audio sound card name

additionalProperties: false

required:
  - compatible
  - mediatek,platform
  - model

examples:
  - |

    sound: mt8195-sound {
        compatible = "mediatek,mt8195_mt6359_demo";
        mediatek,platform = <&afe>;
        model = "mt8195_demo";
        pinctrl-names = "default";
        pinctrl-0 = <&aud_pins_default>;
    };

...
```

## Documentation/devicetree/bindings/sound/pcm186x.txt
```
Texas Instruments pcm186x DT bindings

This driver supports the I2C.

Required properties on I2C:
 - compatible: "ti, pcm1864"
 - reg: the I2C address


Examples:

&i2c_c {
	status = "okay";
	pinctrl-names="default";
	pinctrl-0=<&c_i2c_master_pin1>;

    	pcm1864_4a: pcm1864_4a@4a {
	    compatible = "ti, pcm1864";
		#sound-dai-cells = <0>;
		slots_mask = <0x0f>;
		reg = <0x4a>;
		status = "okay";
	};
};

Note:
   Because pcm1864 need to use a fixed frequency,
   So we also need to modify pcm config.
Reference is as follows:

diff --git a/sound/soc/amlogic/auge/tdm.c b/sound/soc/amlogic/auge/tdm.c
index d235a8d..a294e1b 100644
--- a/sound/soc/amlogic/auge/tdm.c
+++ b/sound/soc/amlogic/auge/tdm.c
@@ -451,11 +451,12 @@ static int aml_dai_tdm_trigger(struct snd_pcm_substream *substream, int cmd,
 }

 static int pcm_setting_init(struct pcm_setting *setting, unsigned int rate,
-			unsigned int channels)
+			unsigned int channels, unsigned int fixbclk)
 {
 	unsigned int ratio = 0;
 	setting->lrclk = rate;
-	setting->bclk_lrclk_ratio = setting->slots * setting->slot_width;
+
+	setting->bclk_lrclk_ratio = setting->slots * setting->slot_width * fixbclk;
 	setting->bclk = setting->lrclk * setting->bclk_lrclk_ratio;

 	/* calculate mclk */
@@ -534,8 +535,13 @@ static int aml_dai_tdm_hw_params(struct snd_pcm_substream *substream,
 	unsigned int rate = params_rate(params);
 	unsigned int channels = params_channels(params);
 	int ret;
-
-	ret = pcm_setting_init(setting, rate, channels);
+
+	// FOR PCM1864 TDM BCLK NEED 12.288MHz
+	if (substream->stream == SNDRV_PCM_STREAM_PLAYBACK) {
+		ret = pcm_setting_init(setting, rate, channels, 1);
+	} else {
+		ret = pcm_setting_init(setting, rate, channels, 2);
+	}
 	if (ret)
 		return ret;

diff --git a/sound/soc/amlogic/auge/tdm.c b/sound/soc/amlogic/auge/tdm.c
index a294e1b..a756035 100644
--- a/sound/soc/amlogic/auge/tdm.c
+++ b/sound/soc/amlogic/auge/tdm.c
@@ -455,8 +455,11 @@ static int pcm_setting_init(struct pcm_setting *setting, unsigned int rate,
 {
 	unsigned int ratio = 0;
 	setting->lrclk = rate;
-
-	setting->bclk_lrclk_ratio = setting->slots * setting->slot_width * fixbclk;
+
+	if (fixbclk == 2)
+		setting->bclk_lrclk_ratio = setting->slots * 32 * fixbclk;
+	else
+		setting->bclk_lrclk_ratio = setting->slots * setting->slot_width * fixbclk;
 	setting->bclk = setting->lrclk * setting->bclk_lrclk_ratio;

 	/* calculate mclk */
```

## Documentation/devicetree/bindings/sound/tas5707.txt
```
Texas Instruments TAS5701 Audio amplifier

The TAS5701 serial control bus communicates through the I2C protocol only. The
serial bus is also used for periodic codec fault checking/reporting during
audio playback. For more product information please see the links below:

Required properties:

- compatible : "ti,tas5707"
- reg : I2C slave address

Example:

tas5707: tas5707@6c {
	status = "okay";
	compatible = "ti,tas5707";
	reg = <0x6c>;
};
```

## Documentation/devicetree/bindings/sound/tas5756.txt
```
Texas Instruments TAS5756 Audio amplifier

The TAS5756 serial control bus communicates through the I2C protocol only. The
serial bus is also used for periodic codec fault checking/reporting during
audio playback. For more product information please see the links below:

Required properties:

- compatible : "ti, tas5756"
- reg : I2C slave address

Example:

tas5756: tas5756@7c {
	status = "okay";
	compatible = "ti, tas5756";
	reg = <0x7c>;
};
```

## Documentation/devicetree/bindings/sound/tas5805.txt
```
Texas Instruments TAS5805 Audio amplifier

The TAS5805 serial control bus communicates through the I2C protocol only. The
serial bus is also used for periodic codec fault checking/reporting during
audio playback. For more product information please see the links below:

Required properties:

- compatible : "ti, tas5805"
- reg : I2C slave address

Example:

tas5805: tas5805@7c {
        status = "okay";
        compatible = "ti,tas5805";
        reg = <0x2d>;
};
```

## Documentation/devicetree/bindings/sound/ti,tac5x1x.yaml
```yaml
# SPDX-License-Identifier: GPL-2.0-only OR BSD-2-Clause
# Copyright (C) 2025 Texas Instruments Incorporated
%YAML 1.2
---
$id: http://devicetree.org/schemas/sound/ti,tac5x1x.yaml#
$schema: http://devicetree.org/meta-schemas/core.yaml#

title: Texas Instruments TAC5X1X Codec

description: |
  TAC5X1X are series of low-power and high performance mono or stereo
  audio codecs, as well as multiple inputs and outputs programmable in
  single-ended or fully differential configurations. Device supports both
  Microphone and Line In input on ADC Channel. DAC Output can be configured
  for either Line Out or Head Phone Load.

  The serial control bus supports SPI or I2C protocols, while the serial audio
  data bus is programmable for I2S, left/right-justified, DSP, or TDM modes.

  Specification about the codecs can be found at:
    https://www.ti.com/lit/gpn/taa5212
    https://www.ti.com/lit/gpn/taa5412-q1
    https://www.ti.com/lit/gpn/tac5111
    https://www.ti.com/lit/gpn/tac5112
    https://www.ti.com/lit/gpn/tac5211
    https://www.ti.com/lit/gpn/tac5212
    https://www.ti.com/lit/gpn/tac5311-q1
    https://www.ti.com/lit/gpn/tac5312-q1
    https://www.ti.com/lit/gpn/tac5411-q1
    https://www.ti.com/lit/gpn/tac5412-q1
    https://www.ti.com/lit/gpn/tad5112
    https://www.ti.com/lit/gpn/tad5212

maintainers:
  - Niranjan H Y <niranjan.hy@ti.com>
  - Kevin Lu <kevin-lu@ti.com>

properties:
  compatible:
    enum:
      - ti,taa5212
      - ti,taa5412
      - ti,tac5111
      - ti,tac5112
      - ti,tac5211
      - ti,tac5212
      - ti,tac5311
      - ti,tac5312
      - ti,tac5411
      - ti,tac5412
      - ti,tad5112
      - ti,tad5212

  reg:
    maxItems: 1

  ti,vref:
    description: VREF required voltage. If node is omitted then VREF is powered down.
    $ref: /schemas/types.yaml#/definitions/uint32
    oneOf:
      - const: 0
        description: VREF output is powered to 2.75V.
      - const: 1
        description: VREF output is powered to 2.5V.
      - const: 2
        description: VREF output is powered to 1.375V.

  ti,micbias-vg:
    description: MicBias required voltage. If node is omitted then MicBias is powered down.
    $ref: /schemas/types.yaml#/definitions/uint32
    oneOf:
      - const: 0
        description: MICBIAS output is same as the VREF output
      - const: 1
        description: MICBIAS output is 0.5 times the VREF output
      - const: 3
        description: MICBIAS output is same as the AVDD

  avdd-supply:
    description: Analog DAC voltage.

  iovdd-supply:
    description: I/O voltage.

  ti,gpios-func:
    description: |
      Array indicating the GPIO1, GPIO2, GPO1 Functionality in the same order.
      Each integer elemnent in the array represent the following
      - 0  TAC5X1X_GPIO_DISABLE        - GPIO is Disabled
      - 1  TAC5X1X_GPIO_GPI            - General Purpose Input
      - 2  ADC3XXX_GPIO_GPO            - General Purpose Output
      - 3  TAC5X1X_GPIO_IRQ            - Chip Interrupt
      - 4  TAC5X1X_GPIO_PDMCLK         - PDM CLK Output
      - 5  TAC5X1X_GPIO_P_DOUT         - Primary ASI DOUT
      - 6  TAC5X1X_GPIO_P_DOUT2        - Primary ASI DOUT2
      - 7  TAC5X1X_GPIO_S_DOUT         - Secondary ASI DOUT
      - 8  TAC5X1X_GPIO_S_DOUT2        - Secondary ASI DOUT2
      - 9  TAC5X1X_GPIO_S_BCLK         - Secondary BCLK Output
      - 10 TAC5X1X_GPIO_S_FSYNC       - Secondary FSYNC Output
      - 11 TAC5X1X_GPIO_CLKOUT        - General Purpose Output
      - 12 TAC5X1X_GPIO_DOUT_MUX
      - 13 TAC5X1X_GPIO_DAISY_OUT
    $ref: /schemas/types.yaml#/definitions/uint32-array
    minItems: 3
    maxItems: 3

  ti,gpios-drive:
    description: |
      Array indicating the GPIO1, GPIO2, GPO1 Driver values
      Each number in the array indicate the following driver values.
      - 0 # Hi-Z Output
      - 1 # Drive active low and active High
      - 2 # Drive active low and weak High
      - 3 # Drive acive low and Hi-Z
      - 4 # Drive weak low and active High
      - 5 # Drive Hi-Z and active High
    $ref: /schemas/types.yaml#/definitions/uint32-array
    minItems: 3
    maxItems: 3

  ti,gpi1-func:
    description: GPI1 Functionality
    $ref: /schemas/types.yaml#/definitions/uint32
    enum:
      - 0 # TAC5X1X_GPIO_DISABLE       - I/O buffers powered down and not used
      - 1 # TAC5X1X_GPIO_GPI          - General purpose input
    default: 0

  '#sound-dai-cells':
    const: 0

  clocks:
    maxItems: 1

  ti,gpa-gpio:
    description: GPA using GPIO1 configuration
    $ref: /schemas/types.yaml#/definitions/uint32
    enum:
      - 0 # GPA using GPIO1 is disabled
      - 1 # GPA using GPIO1
    default: 0

  ti,in-ch-en:
    description: Enable Input channel diagnostics for TAC54XX and TAC53XX device.
    $ref: /schemas/types.yaml#/definitions/uint32
    enum:
      - 0 # Disable input channel diagnostics
      - 1 # Enable input channel diagnostics

  ti,out-ch-en:
    description: Enable Output channel diagnostics for TAC54XX and TAC53XX device
    $ref: /schemas/types.yaml#/definitions/uint32
    enum:
      - 0 # Disable Output channel diagnostics
      - 1 # Enable Output channel Diagnostics

  ti,incl-se-inm:
    description: INxM pin Diagnostics Scan Selection for Single Ended Configuration
    $ref: /schemas/types.yaml#/definitions/uint32
    enum:
      - 0 # INxM pin Diagnostics Scan Selection for Single Ended excluded for diagnosis
      - 1 # INxM pin Diagnostics Scan Selection for Single Ended included for diagnosis

  ti,incl-ac-coup:
    description: AC coupled channels pins Scan Selection for Diagnostics
    $ref: /schemas/types.yaml#/definitions/uint32
    enum:
      - 0 # AC coupled channels pins Scan Selection for Diagnostics exluded for diagnosis
      - 1 # AC coupled channels pins Scan Selection for Diagnostics included for diagnosis

  ti,micbias-threshold:
    description: Micbias Low and High threshold values for TAC54XX and TAC53XX series
    $ref: /schemas/types.yaml#/definitions/uint32-array
    maxItems: 2
    minItems: 2
    items:
      minimum: 72
      maximum: 162

  ti,gpa-threshold:
    description: GPA Low and High threshold Values
    $ref: /schemas/types.yaml#/definitions/uint32-array
    maxItems: 2
    minItems: 2
    items:
      minimum: 75
      maximum: 186

required:
  - compatible
  - reg

additionalProperties: false

examples:
  - |
    #include <dt-bindings/gpio/gpio.h>

    i2c {
      #address-cells = <1>;
      #size-cells = <0>;

      tac5x1x: tac5x1x@52 {
        compatible = "ti,tac5212";
        reg = <0x52>;
        #sound-dai-cells = <0>;
        avdd-supply = <&vdd_3v3_reg>;
        iovdd-supply = <&vdd_3v3_reg>;
        ti,vref = <0>;
        ti,micbias-vg = <3>;
        ti,gpi1-func = <0>;
        ti,gpios-func = <4>, <1>, <0>;
        ti,gpios-drive = <0>, <0>, <0>;
        ti,gpa-gpio = <0>;
        ti,in-ch-en = <1>;
        ti,out-ch-en = <1>;
        ti,incl-ac-coup = <0>;
        ti,incl-se-inm = <0>;
        ti,gpa-threshold = <75>, <186>;
      };
    };
...
```

## Documentation/devicetree/bindings/sound/tlv320adc3101.txt
```
Texas Instruments - tlv320adc3101 Codec module

The tlv320adc3101 serial control bus communicates through I2C protocols

Required properties:
 - compatible - "ti,tlv320adc3101"
 - reg: I2C slave address
 - supply-*: Required supply regulators are:
    "iov" - digital IO power supply
    "dv" - Digital core power supply
    "av" - Analog core power supply
 - rst-gpio: Reset-GPIO phandle with args as described in gpio/gpio.txt
 - left-pin-select: default left ADC input selection for left PGA. values are
 defined in sound/soc/codecs/tlv320adc3101.h
 - right-pin-select: default right ADC input selection for right PGA. values are
defined in sound/soc/codecs/tlv320adc3101.h

		sound-name-prefix = "U18_";
		reg = <0x18>;
		rst-gpio = <&pio 34 0>;
		left-pin-select = <1>;
		right-pin-select = <1>;

		av-supply  = <&pcm1865_3v3>;
		dv-supply  = <&pcm1865_3v3>;
		iov-supply = <&pcm1865_3v3>;


Example:

codec: tlv320adc3101@18 {
		reg = <0x18>;
		rst-gpio = <&pio 34 0>;
		left-pin-select = <1>;
		right-pin-select = <1>;

		av-supply  = <&supply_3v3>;
		dv-supply  = <&supply_3v3>;
		iov-supply = <&supply_1v8>;
};
```

## Documentation/devicetree/bindings/sound/wm8962.txt
```
WM8962 audio CODEC

This device supports I2C only.

Required properties:

  - compatible : "wlf,wm8962"

  - reg : the I2C address of the device.

  - clocks : MCLK for wm8962.

  - XXXX-supply : power source for exact pin of wm8962.

Optional properties:

  - interrupts : The interrupt line the codec is connected to.

  - gpio-cfg : A list of GPIO configuration register values. The list must
    be 5 entries long. If absent, no configuration of these registers is
    performed. If any entry has the value 0xffffffff, that GPIO's
    configuration will not be modified.

Example:

codec: wm8962@1a {
	compatible = "fsl,wm8962";
	reg = <0x1a>;
	clocks = <&clks 169>;
	DCVDD-supply = <&vgen4_reg>;	/* 1.8v */
	DBVDD-supply = <&vgen4_reg>;	/* 1.8v */
	AVDD-supply = <&vgen4_reg>;		/* 1.8v */
	CPVDD-supply = <&vgen4_reg>;	/* 1.8v */
	MICVDD-supply = <&vgen6_reg>;	/* 3.3v */
	PLLVDD-supply = <&vgen4_reg>;	/* 1.8v */
	SPKVDD1-supply = <&reg_4p2v>;
	SPKVDD2-supply = <&reg_4p2v>;
	gpio-cfg = <
		0x0000 /* 0:Default */
		0x0000 /* 1:Default */
		0x0013 /* 2:FN_DMICCLK */
		0x0000 /* 3:Default */
		0x8014 /* 4:FN_DMICCDAT */
		0x0000 /* 5:Default */
	>;
};
```
